; This is a port of Microsoft 6800 Basic for the Altair 680
; to my 6800 Single Board Computer.
;
; Notes:
; No official source code is known to exist for Microsoft 6800 Basic.
; There is an annotated disassembly of Microsoft Basic for Altair 680.
; For more info see https://gitlab.com/retroabandon/altair-680-basic
;
; What I did:
; - Started with the fd9asm disassembly output.
; - Modified it for the crasm assembler directives.
; - Had to add some labels to get it to assemble
; - Made a number of manual changes and fixes.
; - Was able to get same binary as original.
;
; A hack was needed to force crasm to use extended addressing mode for
;  some JSR calls.
;
; It does i/o using code for my 6800 SBC.
;
; It starts at address 0 and is not easily relocatable and also has some
; self-modifying code, making it challenging to run from ROM. The solution
; I used is to put the code in ROM but copy it at run time to RAM. See
; the file loader2.asm which does this.
;
; The code size is 6.9K.

; f9dasm: M6800/1/2/3/8/9 / H6309 Binary/OS9/FLEX9 Disassembler V1.79
; Loaded Motorola S file basic680.mot

  CPU    6800
  CODE
; OUTPUT  HEX             ; For Intel hex output
  OUTPUT  SCODE           ; For Motorola S record (RUN) output

; I/O routines. Keep these in sync with addresses in loader2.asm.

MF002   EQU     $DF56           ; Hardware straps - see MikBug
INCH    EQU     $DF3A           ; For Fantom II ACIA version
POLCAT  EQU     $DF35           ; For Fantom II ACIA version
OUTCH   EQU     $DF44           ; For Fantom II ACIA version

;****************************************************
;* Program Code / Data Areas                        *
;****************************************************

        * EQU     $0000

START   SEC                              ;0000: 0D             '.'
        ROR     M00F3                    ;0001: 76 00 F3       'v..'
RDYJSR  JMP     INIT                     ;0004: 7E 18 F9       '~..'   !!! INIT replaces with JSR READY (warm start)
M0007   JMP     Z033C                    ;0007: 7E 03 3C       '~.<'
M000A   DB      $00                      ;000A: 00             '.'
M000B   DB      $00                      ;000B: 00             '.'
M000C   DB      "H"                      ;000C: 48             'H'
M000D   DB      "8"                      ;000D: 38             '8'
M000E   DB      $00                      ;000E: 00             '.'
M000F   DB      ","                      ;000F: 2C             ','
M0010   DB      $00,$00,$00,$00,$00,$00  ;0010: 00 00 00 00 00 00 '......'
        DB      $00,$00,$00,$00,$00,$00  ;0016: 00 00 00 00 00 00 '......'
        DB      $00,$00,$00,$00,$00,$00  ;001C: 00 00 00 00 00 00 '......'
        DB      $00,$00,$00,$00          ;0022: 00 00 00 00    '....'
M0026   DB      $00,$00,$00,$00,$00,$00  ;0026: 00 00 00 00 00 00 '......'
        DB      $00,$00,$00,$00,$00,$00  ;002C: 00 00 00 00 00 00 '......'
        DB      $00,$00,$00              ;0032: 00 00 00       '...'
M0035   DB      $00,$00,$00,$00,$00,$00  ;0035: 00 00 00 00 00 00 '......'
        DB      $00,$00,$00,$00,$00,$00  ;003B: 00 00 00 00 00 00 '......'
        DB      $00,$00                  ;0041: 00 00          '..'
M0043   DB      $00,$00,$00,$00,$00,$00  ;0043: 00 00 00 00 00 00 '......'
        DB      $00,$00,$00,$00,$00,$00  ;0049: 00 00 00 00 00 00 '......'
M004F   DB      $00,$00,$00,$00,$00,$00  ;004F: 00 00 00 00 00 00 '......'
        DB      $00,$00,$00              ;0055: 00 00 00       '...'
CHARAC  DB      $00                      ;0058: 00             '.'
ENDCHR  DB      $00                      ;0059: 00             '.'
M005A   DB      $00                      ;005A: 00             '.'
M005B   DB      $00                      ;005B: 00             '.'
M005C   DB      $00                      ;005C: 00             '.'
M005D   DB      $00                      ;005D: 00             '.'
M005E   DB      $00                      ;005E: 00             '.'
M005F   DB      $00                      ;005F: 00             '.'
M0060   DB      $00                      ;0060: 00             '.'
TEMPPT  DB      $00,$00                  ;0061: 00 00          '..'
M0063   DB      $00,$00                  ;0063: 00 00          '..'
M0065   DB      $00,$00,$00,$00,$00,$00  ;0065: 00 00 00 00 00 00 '......'
        DB      $00,$00,$00,$00,$00,$00  ;006B: 00 00 00 00 00 00 '......'
M0071   DB      $00                      ;0071: 00             '.'
M0072   DB      $00                      ;0072: 00             '.'
M0073   DB      $00                      ;0073: 00             '.'
M0074   DB      $00                      ;0074: 00             '.'
M0075   DB      $00                      ;0075: 00             '.'
M0076   DB      $00                      ;0076: 00             '.'
M0077   DB      $00                      ;0077: 00             '.'
M0078   DB      $00                      ;0078: 00             '.'
M0079   DB      $00                      ;0079: 00             '.'
M007A   DB      $00                      ;007A: 00             '.'
M007B   DB      $00                      ;007B: 00             '.'
M007C   DB      $00                      ;007C: 00             '.'
M007D   DB      $00                      ;007D: 00             '.'
M007E   DB      $00                      ;007E: 00             '.'
M007F   DB      $00                      ;007F: 00             '.'
M0080   DB      $00                      ;0080: 00             '.'
M0081   DB      $00                      ;0081: 00             '.'
M0082   DB      $00                      ;0082: 00             '.'
M0083   DB      $00                      ;0083: 00             '.'
M0084   DB      $00                      ;0084: 00             '.'
M0085   DB      $00                      ;0085: 00             '.'
M0086   DB      $00,$00                  ;0086: 00 00          '..'
M0088   DB      $00                      ;0088: 00             '.'
M0089   DB      $00                      ;0089: 00             '.'
M008A   DB      $00                      ;008A: 00             '.'
M008B   DB      $00                      ;008B: 00             '.'
M008C   DB      $00,$00                  ;008C: 00 00          '..'
M008E   DB      $00                      ;008E: 00             '.'
M008F   DB      $00                      ;008F: 00             '.'
M0090   DB      $00                      ;0090: 00             '.'
M0091   DB      $00                      ;0091: 00             '.'
M0092   DB      $00,$00                  ;0092: 00 00          '..'
M0094   DB      $00                      ;0094: 00             '.'
M0095   DB      $00                      ;0095: 00             '.'
M0096   DB      $00,$00                  ;0096: 00 00          '..'
M0098   DB      $00,$00                  ;0098: 00 00          '..'
M009A   DB      $00                      ;009A: 00             '.'
M009B   DB      $00                      ;009B: 00             '.'
M009C   DB      $00                      ;009C: 00             '.'
M009D   DB      $00                      ;009D: 00             '.'
M009E   DB      $00                      ;009E: 00             '.'
M009F   DB      $00                      ;009F: 00             '.'
M00A0   DB      $00,$00                  ;00A0: 00 00          '..'
M00A2   DB      $00                      ;00A2: 00             '.'
M00A3   DB      $00                      ;00A3: 00             '.'
M00A4   DB      $00                      ;00A4: 00             '.'
M00A5   DB      $00                      ;00A5: 00             '.'
M00A6   DB      $00                      ;00A6: 00             '.'
M00A7   DB      $00                      ;00A7: 00             '.'
M00A8   DB      $00                      ;00A8: 00             '.'
M00A9   DB      $00                      ;00A9: 00             '.'
M00AA   DB      $00                      ;00AA: 00             '.'
M00AB   DB      $00                      ;00AB: 00             '.'
M00AC   DB      $00                      ;00AC: 00             '.'
M00AD   DB      $00                      ;00AD: 00             '.'
M00AE   DB      $00                      ;00AE: 00             '.'
tmpstrlen DB      $00                      ;00AF: 00             '.'
DSCTMP  DB      $00,$00                  ;00B0: 00 00          '..'
M00B2   DB      $00                      ;00B2: 00             '.'
M00B3   DB      $00                      ;00B3: 00             '.'
M00B4   DB      $00                      ;00B4: 00             '.'
M00B5   DB      $00                      ;00B5: 00             '.'
M00B6   DB      $00                      ;00B6: 00             '.'
M00B7   DB      $00                      ;00B7: 00             '.'
M00B8   DB      $00                      ;00B8: 00             '.'
M00B9   DB      $00                      ;00B9: 00             '.'
M00BA   DB      $00                      ;00BA: 00             '.'
STRNG1  DB      $00                      ;00BB: 00             '.'
M00BC   DB      $00                      ;00BC: 00             '.'
STRNG2  DB      $00                      ;00BD: 00             '.'
M00BE   DB      $00                      ;00BE: 00             '.'

CHRGET  INC     $00C9                    ;00BF: 7C 00 C9       '|..'
        BNE     CHRGOT                   ;00C2: 26 03          '&.'
        INC     $00C8                    ;00C4: 7C 00 C8       '|..'
CHRGOT  LDAA    $EA60                    ;00C7: B6 EA 60       '..`'   This abs. address incremented above
        CMPA    #$3A                     ;00CA: 81 3A          '.:'
        BCC     Z00D6                    ;00CC: 24 08          '$.'
        CMPA    #$20                     ;00CE: 81 20          '. '
        BEQ     CHRGET                   ;00D0: 27 ED          ''.'
        SUBA    #$30                     ;00D2: 80 30          '.0'
        SUBA    #$D0                     ;00D4: 80 D0          '..'
Z00D6   RTS                              ;00D6: 39             '9'
Z00D7   STX     $EA60                    ;00D7: FF EA 60       '..`'
        JMP     Z03C7                    ;00DA: 7E 03 C7       '~..'

; Another data section?
        DB      $00,$00,$00,$06,$06,$06  ;00DD: 00 00 00 06 06 06 '......'
        DB      $06,$06,$06,$04,$FF,$FD  ;00E3: 06 06 06 04 FF FD '......'
        DB      $FF,$FD,$FF,$FF,$FF,$FD  ;00E9: FF FD FF FF FF FD '......'
        DB      $FD,$FF,$FD,$FD          ;00EF: FD FF FD FD    '....'
M00F3   DB      $00,$FD,$FF,$FD,$FD,$FD  ;00F3: 00 FD FF FD FD FD '......'
        DB      $FF,$FD,$FF,$FF          ;00F9: FF FD FF FF    '....'
        DB      "d"                      ;00FD: 64             'd'
M00FE   DB      "`"                      ;00FE: 60             '`'
M00FF   DB      $FD                      ;00FF: FD             '.'
M0100   DB      $00,$00,$00,$00,$00,$00  ;0100: 00 00 00 00 00 00 '......'
        DB      $00,$00,$00,$00,$00,$00  ;0106: 00 00 00 00 00 00 '......'
        DB      $00                      ;010C: 00             '.'
M010D   DB      $80                      ;010D: 80             '.'
        DB      "O"                      ;010E: 4F             'O'
        DB      $C7                      ;010F: C7             '.'
        DB      "R"                      ;0110: 52             'R'
M0111   DB      $00                      ;0111: 00             '.'

x0112   JMP     INIT                     ;0112: 7E 18 F9       '~..'   !!! INIT replaces dest with STROUT

        DB      $0C,$D8,$0E              ;0115: 0C D8 0E       '...'
        DB      "4"                      ;0118: 34             '4'

M0119   DB      $14,$90,$15,$04,$14,$AA  ;0119: 14 90 15 04 14 AA '......'
        DB      $0D                      ;011F: 0D             '.'
        DB      "L"                      ;0120: 4C             'L'
        DB      $0E,$15,$0E              ;0121: 0E 15 0E       '...'
        DB      "@"                      ;0124: 40             '@'
        DB      $16,$FC,$17,$DC,$12,$D2  ;0125: 16 FC 17 DC 12 D2 '......'
        DB      $17                      ;012B: 17             '.'
        DB      "h"                      ;012C: 68             'h'
M012D   DB      $18,$12                  ;012D: 18 12          '..'
M012F   DB      $18,$18                  ;012F: 18 18          '..'
M0131   DB      $18                      ;0131: 18             '.'
        DB      "^"                      ;0132: 5E             '^'
M0133   DB      $18,$A2,$11,$8D,$10,$A9  ;0133: 18 A2 11 8D 10 A9 '......'
        DB      $0E,$F1,$11              ;0139: 0E F1 11       '...'
        DB      "J"                      ;013C: 4A             'J'
        DB      $10,$C9,$10,$B5,$10,$D1  ;013D: 10 C9 10 B5 10 D1 '......'
        DB      $10,$EE,$10,$F5          ;0143: 10 EE 10 F5    '....'
M0147   DB      "y"                      ;0147: 79             'y'
        DB      $11,$C7                  ;0148: 11 C7          '..'
        DB      "y"                      ;014A: 79             'y'
        DB      $11,$BC                  ;014B: 11 BC          '..'
        DB      "{"                      ;014D: 7B             '{'
        DB      $13,$0A                  ;014E: 13 0A          '..'
        DB      "{"                      ;0150: 7B             '{'
        DB      $13,$BE,$7F,$17,$05      ;0151: 13 BE 7F 17 05 '.....'
        DB      "P"                      ;0156: 50             'P'
        DB      $0B,$96                  ;0157: 0B 96          '..'
        DB      "F"                      ;0159: 46             'F'
        DB      $0B                      ;015A: 0B             '.'
M015B   DB      $95                      ;015B: 95             '.'

; Reserved word tokens.
; The high bit is set on the last char of each token.
RESLST  DB      'E','N','D'|$80          ;015C: 45 4E C4       'EN.'   END
        DB      'F','O','R'|$80          ;015F: 46 4F D2       'FO.'   FOR
        DB      'N','E','X','T'|$80      ;0162: 4E 45 58 D4    'NEX.'  NEXT
        DB      'D','A','T','A'|$80      ;0166: 44 41 54 C1    'DAT.'  DATA
        DB      'I','N','P','U','T'|$80  ;016A: 49 4E 50 55 D4 'INPU.' INPUT
        DB      'D','I','M'|$80          ;016F: 44 49 CD       'DI.'   DIM
        DB      'R','E','A','D'|$80      ;0172: 52 45 41 C4    'REA.'  READ
        DB      'L','E','T'|$80          ;0176: 4C 45 D4       'LE.'   LET
        DB      'G','O','T','O'|$80      ;0179: 47 4F 54 CF    'GOT.'  GOTO
        DB      'R','U','N'|$80          ;017D: 52 55 CE       'RU.'   RUN
        DB      'I','F'|$80              ;0180: 49 C6          'I.'    IF
        DB      'R','E','S','T','O','R'  ;0182: 52 45 53 54 4F 52 'RESTOR' RESTORE
        DB      'E'|$80                  ;0188: C5             '.'
        DB      'G','O','S','U','B'|$80  ;0189: 47 4F 53 55 C2 'GOSU.' GOSUB
        DB      'R','E','T','U','R','N'|$80 ;018E: 52 45 54 55 52 CE 'RETUR.' RETURN
        DB      'R','E','M'|$80          ;0194: 52 45 CD       'RE.'   REM
        DB      'S','T','O','P'|$80      ;0197: 53 54 4F D0    'STO.'  STOP
        DB      'O','N'|$80              ;019B: 4F CE          'O.'    ON
        DB      'N','U','L','L'|$80      ;019D: 4E 55 4C CC    'NUL.'  NULL
        DB      'W','A','I','T'|$80      ;01A1: 57 41 49 D4    'WAI.'  WAIT
        DB      'D','E','F'|$80          ;01A5: 44 45 C6       'DE.'   DEF
        DB      'P','O','K','E'|$80      ;01A8: 50 4F 4B C5    'POK.'  POKE
        DB      'P','R','I','N','T'|$80  ;01AC: 50 52 49 4E D4 'PRIN.' PRINT
        DB      'C','O','N','T'|$80      ;01B1: 43 4F 4E D4    'CON.'  CONT
        DB      'L','I','S','T'|$80      ;01B5: 4C 49 53 D4    'LIS.'  LIST
        DB      'C','L','E','A','R'|$80  ;01B9: 43 4C 45 41 D2 'CLEA.' CLEAR
        DB      'N','E','W'|$80          ;01BE: 4E 45 D7       'NE.'   NEW
        DB      'T','A','B','('|$80      ;01C1: 54 41 42 A8    'TAB.'  TAB(
        DB      'T','O'|$80              ;01C5: 54 CF          'T.'    TO
        DB      'F','N'|$80              ;01C7: 46 CE          'F.'    FN
        DB      'S','P','C','('|$80      ;01C9: 53 50 43 A8    'SPC.'  SPC(
        DB      'T','H','E','N'|$80      ;01CD: 54 48 45 CE    'THE.'  THEN
        DB      'N','O','T'|$80          ;01D1: 4E 4F D4       'NO.'   NOT
        DB      'S','T','E','P'|$80      ;01D4: 53 54 45 D0    'STE.'  STEP
        DB      '+'|$80                  ;01D8: AB             '.'     +
        DB      '-'|$80                  ;01D9: AD             '.'     -
        DB      '*'|$80                  ;01DA: AA             '.'     *
        DB      '/'|$80                  ;01DB: AF             '.'     /
        DB      '^'|$80                  ;01DC: DE             '.'     ^
        DB      'A','N','D'|$80          ;01DD: 41 4E C4       'AN.'   AND
        DB      'O','R'|$80              ;01E0: 4F D2          'O.'    OR
        DB      '>'|$80                  ;01E2: BE             '.'     >
        DB      '='|$80                  ;01E3: BD             '.'     =
        DB      '<'|$80                  ;01E4: BC             '.'     <
        DB      'S','G','N'|$80          ;01E5: 53 47 CE       'SG.'   SGN
        DB      'I','N','T'|$80          ;01E8: 49 4E D4       'IN.'   INT
        DB      'A','B','S'|$80          ;01EB: 41 42 D3       'AB.'   ABS
        DB      'U','S','R'|$80          ;01EE: 55 53 D2       'US.'   USR
        DB      'F','R','E'|$80          ;01F1: 46 52 C5       'FR.'   FRE
        DB      'P','O','S'|$80          ;01F4: 50 4F D3       'PO.'   POS
        DB      'S','Q','R'|$80          ;01F7: 53 51 D2       'SQ.'   SQR
        DB      'R','N','D'|$80          ;01FA: 52 4E C4       'RN.'   RND
        DB      'L','O','G'|$80          ;01FD: 4C 4F C7       'LO.'   LOG
        DB      'E','X','P'|$80          ;0200: 45 58 D0       'EX.'   EXP
        DB      'C','O','S'|$80          ;0203: 43 4F D3       'CO.'   COS
        DB      'S','I','N'|$80          ;0206: 53 49 CE       'SI.'   SIN
        DB      'T','A','N'|$80          ;0209: 54 41 CE       'TA.'   TAN
        DB      'A','T','N'|$80          ;020C: 41 54 CE       'AT.'   ATN
        DB      'P','E','E','K'|$80      ;020F: 50 45 45 CB    'PEE.'  PEEK
        DB      'L','E','N'|$80          ;0213: 4C 45 CE       'LE.'   LEN
        DB      'S','T','R','$'|$80      ;0216: 53 54 52 A4    'STR.'  STR$
        DB      'V','A','L'|$80          ;021A: 56 41 CC       'VA.'   VAL
        DB      'A','S','C'|$80          ;021D: 41 53 C3       'AS.'   ASK
        DB      'C','H','R','$'|$80      ;0220: 43 48 52 A4    'CHR.'  CHR$
        DB      'L','E','F','T','$'|$80  ;0224: 4C 45 46 54 A4 'LEFT.' LEFT$
        DB      'R','I','G','H','T','$'|$80 ;0229: 52 49 47 48 54 A4 'RIGHT.' RIGHT$
        DB      'M','I','D','$'|$80      ;022F: 4D 49 44 A4    'MID.'  MID$
        DB      $00                      ;0233: 00             '.'     Terminate statement table.

M0234   DB      $06                      ;0234: 06             '.'
        DB      "."                      ;0235: 2E             '.'
        DB      $05                      ;0236: 05             '.'
        DB      "e"                      ;0237: 65             'e'
        DB      $09,$B3,$07,$06,$08,$DA  ;0238: 09 B3 07 06 08 DA '......'

        DB      $0C                      ;023E: 0C             '.'
        DB      " "                      ;023F: 20             ' '
        DB      $09,$00,$07,$91,$06,$C9  ;0240: 09 00 07 91 06 C9 '......'
        DB      $06,$A3,$07              ;0246: 06 A3 07       '...'
        DB      "'"                      ;0249: 27             '''
        DB      $06,$12,$06,$AD,$06,$E0  ;024A: 06 12 06 AD 06 E0 '......'
        DB      $07                      ;0250: 07             '.'
        DB      ":"                      ;0251: 3A             ':'
        TAP                              ;0252: 06             '.'
        BLT     Z025C                    ;0253: 2D 07          '-.'
        ASRA                             ;0255: 47             'G'
        TAP                              ;0256: 06             '.'
        LSR     $11,X                    ;0257: 64 11          'd.'
        ADDA    M000E                    ;0259: 9B 0E          '..'
        CLRA                             ;025B: 4F             'O'
Z025C   CBA                              ;025C: 11             '.'
        ANDA    M0007                    ;025D: 94 07          '..'
        ORAB    M0652                    ;025F: FA 06 52       '..R'
        DB      $05                      ;0262: 05             '.'
        DB      $14                      ;0263: 14             '.'
        TAP                              ;0264: 06             '.'
        DB      $75                      ;0265: 75             'u'
        DB      $04                      ;0266: 04             '.'
        SBCB    $4E,X                    ;0267: E2 4E          '.N'
        LDAB    #$53                     ;0269: C6 53          '.S'
        LDX     #$52C7                   ;026B: CE 52 C7       '.R.'
        CLRA                             ;026E: 4F             'O'
        ANDB    #$46                     ;026F: C4 46          '.F'
        DB      $C3                      ;0271: C3             '.'
        CLRA                             ;0272: 4F             'O'
        LDAB    M004F                    ;0273: D6 4F          '.O'
        DB      $CD                      ;0275: CD             '.'
        DB      $55                      ;0276: 55             'U'
        DB      $D3                      ;0277: D3             '.'
        DB      $42                      ;0278: 42             'B'
        DB      $D3                      ;0279: D3             '.'
        LSRA                             ;027A: 44             'D'
        ANDB    #$2F                     ;027B: C4 2F          './'
        SUBA    $49C4                    ;027D: B0 49 C4       '.I.'
        LSRB                             ;0280: 54             'T'
        DB      $CD                      ;0281: CD             '.'
        CLRA                             ;0282: 4F             'O'
        DB      $D3                      ;0283: D3             '.'
        INCA                             ;0284: 4C             'L'
        DB      $D3                      ;0285: D3             '.'
        COMB                             ;0286: 53             'S'
        ANDB    M0043                    ;0287: D4 43          '.C'
        LDX     #$55C6                   ;0289: CE 55 C6       '.U.'
        DB      $20,$45                  ;028C: 20 45          ' E'
        DB      $52                      ;028E: 52             'R'
        DB      $52                      ;028F: 52             'R'
        CLRA                             ;0290: 4F             'O'
        SBCB    START                    ;0291: D2 00          '..'
        BRA     Z02DE                    ;0293: 20 49          ' I'
        DB      $4E                      ;0295: 4E             'N'
        SUBA    ,X                       ;0296: A0 00          '..'
        SEC                              ;0298: 0D             '.'
        CLV                              ;0299: 0A             '.'
        CLRA                             ;029A: 4F             'O'
        ADDB    #$0D                     ;029B: CB 0D          '..'
        CLV                              ;029D: 0A             '.'
M029E   DB      $00                      ;029E: 00             '.'
        SEC                              ;029F: 0D             '.'
        CLV                              ;02A0: 0A             '.'
        DB      $42                      ;02A1: 42             'B'
        DB      $52                      ;02A2: 52             'R'
        DB      $45                      ;02A3: 45             'E'
        DB      $41                      ;02A4: 41             'A'
        ADDB    #$00                     ;02A5: CB 00          '..'
Z02A7   TSX                              ;02A7: 30             '0'
        INX                              ;02A8: 08             '.'
        INX                              ;02A9: 08             '.'
        INX                              ;02AA: 08             '.'
        INX                              ;02AB: 08             '.'
Z02AC   LDAB    #$10                     ;02AC: C6 10          '..'
        STX     M0071                    ;02AE: DF 71          '.q'
        LDAA    ,X                       ;02B0: A6 00          '..'
        SUBA    #$81                     ;02B2: 80 81          '..'
        BNE     Z02CA                    ;02B4: 26 14          '&.'
        LDX     $01,X                    ;02B6: EE 01          '..'
        STX     M0073                    ;02B8: DF 73          '.s'
        LDX     M009E                    ;02BA: DE 9E          '..'
        BEQ     Z02C6                    ;02BC: 27 08          ''.'
        CPX     M0073                    ;02BE: 9C 73          '.s'
        BEQ     Z02CA                    ;02C0: 27 08          ''.'
        BSR     Z0306                    ;02C2: 8D 42          '.B'
        BRA     Z02AC                    ;02C4: 20 E6          ' .'
Z02C6   LDX     M0073                    ;02C6: DE 73          '.s'
        STX     M009E                    ;02C8: DF 9E          '..'
Z02CA   LDX     M0071                    ;02CA: DE 71          '.q'
        TSTA                             ;02CC: 4D             'M'
        RTS                              ;02CD: 39             '9'
Z02CE   BSR     Z02F0                    ;02CE: 8D 20          '. '
Z02D0   TPA                              ;02D0: 07             '.'
        PSHA                             ;02D1: 36             '6'
        STS     M0078                    ;02D2: 9F 78          '.x'
        SEI                              ;02D4: 0F             '.'
        LDS     M00A3                    ;02D5: 9E A3          '..'
        LDX     M00A5                    ;02D7: DE A5          '..'
        INX                              ;02D9: 08             '.'
Z02DA   DEX                              ;02DA: 09             '.'
        LDAA    ,X                       ;02DB: A6 00          '..'
        PSHA                             ;02DD: 36             '6'
Z02DE   CPX     M00A9                    ;02DE: 9C A9          '..'
        BNE     Z02DA                    ;02E0: 26 F8          '&.'
        INS                              ;02E2: 31             '1'
        STS     M00A7                    ;02E3: 9F A7          '..'
        LDS     M0078                    ;02E5: 9E 78          '.x'
        PULA                             ;02E7: 32             '2'
        TAP                              ;02E8: 06             '.'
        RTS                              ;02E9: 39             '9'
Z02EA   CLRA                             ;02EA: 4F             'O'
        ASLB                             ;02EB: 58             'X'
        ADDB    M0081                    ;02EC: DB 81          '..'
        ADCA    M0080                    ;02EE: 99 80          '..'
Z02F0   ADDB    #$26                     ;02F0: CB 26          '.&'
        ADCA    #$00                     ;02F2: 89 00          '..'
        BCS     Z0311                    ;02F4: 25 1B          '%.'
        STS     M0078                    ;02F6: 9F 78          '.x'
        CMPA    M0078                    ;02F8: 91 78          '.x'
        BCS     Z0302                    ;02FA: 25 06          '%.'
        BHI     Z0311                    ;02FC: 22 13          '".'
        CMPB    M0079                    ;02FE: D1 79          '.y'
        BHI     Z0311                    ;0300: 22 0F          '".'
Z0302   RTS                              ;0302: 39             '9'
Z0303   CLRA                             ;0303: 4F             'O'
Z0304   STX     M0071                    ;0304: DF 71          '.q'
Z0306   ADDB    M0072                    ;0306: DB 72          '.r'
        ADCA    M0071                    ;0308: 99 71          '.q'
        STAA    M0073                    ;030A: 97 73          '.s'
        STAB    M0074                    ;030C: D7 74          '.t'
        LDX     M0073                    ;030E: DE 73          '.s'
        RTS                              ;0310: 39             '9'
Z0311   LDAB    #$0C                     ;0311: C6 0C          '..'
Z0313   JSR     READY                    ;0313: BD 05 00       '...'
        CLR     M0111                    ;0316: 7F 01 11       '...'
        JSR     Z0834                    ;0319: BD 08 34       '..4'
        JSR     Z0892+1                  ;031C: BD 08 93       '...'
        LDX     #$0268                   ;031F: CE 02 68       '..h'
        BSR     Z0303                    ;0322: 8D DF          '..'
        LDAA    ,X                       ;0324: A6 00          '..'
        JSR     OUTDO                    ;0326: BD 08 95       '...'
        LDAA    $01,X                    ;0329: A6 01          '..'
        JSR     OUTDO                    ;032B: BD 08 95       '...'
        LDX     #$028B                   ;032E: CE 02 8B       '...'
Z0331   JSR     STROUT                   ;0331: BD 08 79       '..y'
        LDX     M008A                    ;0334: DE 8A          '..'
        INX                              ;0336: 08             '.'
        BEQ     Z033C                    ;0337: 27 03          ''.'
        JSR     Z15D7                    ;0339: BD 15 D7       '...'
Z033C   CLR     M0111                    ;033C: 7F 01 11       '...'
        LDX     #$0297                   ;033F: CE 02 97       '...'
        JSR     x0112                    ;0342: BD 01 12       '...'
Z0345   LDAA    #$2C                     ;0345: 86 2C          '.,'
        STAA    M000F                    ;0347: 97 0F          '..'
        JSR     Z03EC                    ;0349: BD 03 EC       '...'
        STX     $00C8                    ;034C: DF C8          '..'
;       JSR     Z00BF                    ;034E: BD 00 BF       '...'
        DB      $BD,$00,$BF ; WORKAROUND FOR ASSEMBLER ALWAYS USING DIRECT PAGE ADDRESSING FOR LINE ABOVE
        BEQ     Z0345                    ;0351: 27 F2          ''.'
        BCS     Z0360                    ;0353: 25 0B          '%.'
        LDX     #$FFFF                   ;0355: CE FF FF       '...'
        STX     M008A                    ;0358: DF 8A          '..'
        JSR     Z042E                    ;035A: BD 04 2E       '...'
        JMP     Z05EF                    ;035D: 7E 05 EF       '~..'
Z0360   JSR     Z0767                    ;0360: BD 07 67       '..g'
        LDX     M008E                    ;0363: DE 8E          '..'
        STX     M000E                    ;0365: DF 0E          '..'
        JSR     Z042E                    ;0367: BD 04 2E       '...'
        STAB    M005A                    ;036A: D7 5A          '.Z'
        JSR     Z04C4                    ;036C: BD 04 C4       '...'
        BCS     Z0393                    ;036F: 25 22          '%"'
        LDAB    M00AA                    ;0371: D6 AA          '..'
        SUBB    $01,X                    ;0373: E0 01          '..'
        LDAA    #$FF                     ;0375: 86 FF          '..'
        ADDB    M007D                    ;0377: DB 7D          '.}'
        ADCA    M007C                    ;0379: 99 7C          '.|'
        STAA    M007C                    ;037B: 97 7C          '.|'
        STAB    M007D                    ;037D: D7 7D          '.}'
        TPA                              ;037F: 07             '.'
        PSHA                             ;0380: 36             '6'
        STS     M0078                    ;0381: 9F 78          '.x'
        SEI                              ;0383: 0F             '.'
        LDS     ,X                       ;0384: AE 00          '..'
        DES                              ;0386: 34             '4'
Z0387   PULA                             ;0387: 32             '2'
        STAA    ,X                       ;0388: A7 00          '..'
        INX                              ;038A: 08             '.'
        CPX     M007C                    ;038B: 9C 7C          '.|'
        BNE     Z0387                    ;038D: 26 F8          '&.'
        LDS     M0078                    ;038F: 9E 78          '.x'
        PULA                             ;0391: 32             '2'
        TAP                              ;0392: 06             '.'
Z0393   LDAA    M0010                    ;0393: 96 10          '..'
        BEQ     Z03C2                    ;0395: 27 2B          ''+'
        LDAA    M007C                    ;0397: 96 7C          '.|'
        LDAB    M007D                    ;0399: D6 7D          '.}'
        STAA    M00A5                    ;039B: 97 A5          '..'
        STAB    M00A6                    ;039D: D7 A6          '..'
        ADDB    M005A                    ;039F: DB 5A          '.Z'
        ADCA    #$00                     ;03A1: 89 00          '..'
        STAA    M00A3                    ;03A3: 97 A3          '..'
        STAB    M00A4                    ;03A5: D7 A4          '..'
        JSR     Z02CE                    ;03A7: BD 02 CE       '...'
        TPA                              ;03AA: 07             '.'
        PSHA                             ;03AB: 36             '6'
        STS     M0078                    ;03AC: 9F 78          '.x'
        SEI                              ;03AE: 0F             '.'
        LDS     #M000B                   ;03AF: 8E 00 0B       '...'
Z03B2   PULA                             ;03B2: 32             '2'
        STAA    ,X                       ;03B3: A7 00          '..'
        INX                              ;03B5: 08             '.'
        CPX     M00A7                    ;03B6: 9C A7          '..'
        BNE     Z03B2                    ;03B8: 26 F8          '&.'
        LDS     M0078                    ;03BA: 9E 78          '.x'
Z03BC   PULA                             ;03BC: 32             '2'
        TPA                              ;03BD: 07             '.'
        LDX     M00A3                    ;03BE: DE A3          '..'
        STX     M007C                    ;03C0: DF 7C          '.|'
Z03C2   JSR     Z04EE                    ;03C2: BD 04 EE       '...'
        LDX     M007A                    ;03C5: DE 7A          '.z'
Z03C7   LDAA    ,X                       ;03C7: A6 00          '..'
        ORAA    $01,X                    ;03C9: AA 01          '..'
        BNE     Z03D0                    ;03CB: 26 03          '&.'
        JMP     Z0345                    ;03CD: 7E 03 45       '~.E'
Z03D0   STX     $00D8                    ;03D0: DF D8          '..'
        INX                              ;03D2: 08             '.'
        INX                              ;03D3: 08             '.'
        INX                              ;03D4: 08             '.'
        INX                              ;03D5: 08             '.'
Z03D6   INX                              ;03D6: 08             '.'
        LDAA    ,X                       ;03D7: A6 00          '..'
        BNE     Z03D6                    ;03D9: 26 FB          '&.'
        INX                              ;03DB: 08             '.'
        JMP     Z00D7                    ;03DC: 7E 00 D7       '~..'
Z03DF   JSR     OUTDO                    ;03DF: BD 08 95       '...'
        DEX                              ;03E2: 09             '.'
        DECB                             ;03E3: 5A             'Z'
        BNE     Z03F1                    ;03E4: 26 0B          '&.'
Z03E6   JSR     OUTDO                    ;03E6: BD 08 95       '...'
        JSR     Z0834                    ;03E9: BD 08 34       '..4'
Z03EC   LDX     #M0010                   ;03EC: CE 00 10       '...'
        LDAB    #$01                     ;03EF: C6 01          '..'
Z03F1   BSR     Z041E                    ;03F1: 8D 2B          '.+'
        CMPA    #$07                     ;03F3: 81 07          '..'
        BEQ     Z040B                    ;03F5: 27 14          ''.'
        CMPA    #$0D                     ;03F7: 81 0D          '..'
        BEQ     Z041B                    ;03F9: 27 20          '' '
        CMPA    #$20                     ;03FB: 81 20          '. '
        BCS     Z03F1                    ;03FD: 25 F2          '%.'
        CMPA    #$7D                     ;03FF: 81 7D          '.}'
        BCC     Z03F1                    ;0401: 24 EE          '$.'
        CMPA    #$40                     ;0403: 81 40          '.@'
        BEQ     Z03E6                    ;0405: 27 DF          ''.'
        CMPA    #$5F                     ;0407: 81 5F          '._'
        BEQ     Z03DF                    ;0409: 27 D4          ''.'
Z040B   STAA    ,X                       ;040B: A7 00          '..'
        CMPB    #$48                     ;040D: C1 48          '.H'
        BCC     Z0413+1                  ;040F: 24 03          '$.'
        INX                              ;0411: 08             '.'
        INCB                             ;0412: 5C             '\'
Z0413   CPX     #$8607                   ;0413: 8C 86 07       '...'
        JSR     OUTDO                    ;0416: BD 08 95       '...'
        BRA     Z03F1                    ;0419: 20 D6          ' .'
Z041B   JMP     Z082F                    ;041B: 7E 08 2F       '~./'
Z041E   PSHB                             ;041E: 37             '7'
        JSR     INCH                     ;041F: BD FF 00       '...'   Read char into B (in monitor)
        TBA                              ;0422: 17             '.'
        PULB                             ;0423: 33             '3'
        ANDA    #$7F                     ;0424: 84 7F          '..'
        CMPA    #$0F                     ;0426: 81 0F          '..'
        BNE     Z042D                    ;0428: 26 03          '&.'
        COM     M0111                    ;042A: 73 01 11       's..'
Z042D   RTS                              ;042D: 39             '9'
Z042E   CLR     M005D                    ;042E: 7F 00 5D       '..]'
        DEC     $00C9                    ;0431: 7A 00 C9       'z..'
        LDX     #M000F                   ;0434: CE 00 0F       '...'
        STX     STRNG2                   ;0437: DF BD          '..'
        STS     M0078                    ;0439: 9F 78          '.x'
        TPA                              ;043B: 07             '.'
        STAA    M005F                    ;043C: 97 5F          '._'
Z043E   NOP                              ;043E: 01             '.'
        SEI                              ;043F: 0F             '.'
        LDS     $00C8                    ;0440: 9E C8          '..'
        PULB                             ;0442: 33             '3'
        CMPB    #$20                     ;0443: C1 20          '. '
        BEQ     Z0479                    ;0445: 27 32          ''2'
        STAB    ENDCHR                   ;0447: D7 59          '.Y'
        CMPB    #$22                     ;0449: C1 22          '."'
        BEQ     Z04A2                    ;044B: 27 55          ''U'
        LDAA    M005D                    ;044D: 96 5D          '.]'
        BNE     Z0479                    ;044F: 26 28          '&('
        CMPB    #$3F                     ;0451: C1 3F          '.?'
        BNE     Z0459                    ;0453: 26 04          '&.'
        LDAB    #$95                     ;0455: C6 95          '..'
        BRA     Z0479                    ;0457: 20 20          '  '
Z0459   CMPB    #$30                     ;0459: C1 30          '.0'
        BCS     Z0461                    ;045B: 25 04          '%.'
        CMPB    #$3C                     ;045D: C1 3C          '.<'
        BCS     Z0479                    ;045F: 25 18          '%.'
Z0461   LDX     #M015B                   ;0461: CE 01 5B       '..['
        LDS     $00C8                    ;0464: 9E C8          '..'
        CLRB                             ;0466: 5F             '_'
Z0467   INX                              ;0467: 08             '.'
Z0468   PULA                             ;0468: 32             '2'
        CMPA    #$20                     ;0469: 81 20          '. '
        BEQ     Z0468                    ;046B: 27 FB          ''.'
        SUBA    ,X                       ;046D: A0 00          '..'
        BEQ     Z0467                    ;046F: 27 F6          ''.'
        CMPA    #$80                     ;0471: 81 80          '..'
        BNE     Z04A7                    ;0473: 26 32          '&2'
        ORAB    #$80                     ;0475: CA 80          '..'
Z0477   LDX     STRNG2                   ;0477: DE BD          '..'
Z0479   STS     $00C8                    ;0479: 9F C8          '..'
        LDS     M0078                    ;047B: 9E 78          '.x'
        LDAA    M005F                    ;047D: 96 5F          '._'
        TAP                              ;047F: 06             '.'
        INX                              ;0480: 08             '.'
        STX     STRNG2                   ;0481: DF BD          '..'
        STAB    ,X                       ;0483: E7 00          '..'
        BEQ     Z04B6                    ;0485: 27 2F          ''/'
        SUBB    #$3A                     ;0487: C0 3A          '.:'
        BEQ     Z048F                    ;0489: 27 04          ''.'
        CMPB    #$49                     ;048B: C1 49          '.I'
        BNE     Z0491                    ;048D: 26 02          '&.'
Z048F   STAB    M005D                    ;048F: D7 5D          '.]'
Z0491   SUBB    #$54                     ;0491: C0 54          '.T'
        BNE     Z043E                    ;0493: 26 A9          '&.'
        STAB    ENDCHR                   ;0495: D7 59          '.Y'
        SEI                              ;0497: 0F             '.'
        LDS     $00C8                    ;0498: 9E C8          '..'
Z049A   PULB                             ;049A: 33             '3'
        TSTB                             ;049B: 5D             ']'
        BEQ     Z0479                    ;049C: 27 DB          ''.'
        CMPB    ENDCHR                   ;049E: D1 59          '.Y'
        BEQ     Z0479                    ;04A0: 27 D7          ''.'
Z04A2   INX                              ;04A2: 08             '.'
        STAB    ,X                       ;04A3: E7 00          '..'
        BRA     Z049A                    ;04A5: 20 F3          ' .'
Z04A7   LDS     $00C8                    ;04A7: 9E C8          '..'
        INCB                             ;04A9: 5C             '\'
Z04AA   LDAA    ,X                       ;04AA: A6 00          '..'
        INX                              ;04AC: 08             '.'
        BPL     Z04AA                    ;04AD: 2A FB          '*.'
        LDAA    ,X                       ;04AF: A6 00          '..'
        BNE     Z0468                    ;04B1: 26 B5          '&.'
        PULB                             ;04B3: 33             '3'
        BRA     Z0477                    ;04B4: 20 C1          ' .'
Z04B6   STAB    $01,X                    ;04B6: E7 01          '..'
        STAB    $02,X                    ;04B8: E7 02          '..'
        LDAB    M00BE                    ;04BA: D6 BE          '..'
        SUBB    #$0B                     ;04BC: C0 0B          '..'
        LDX     #M000F                   ;04BE: CE 00 0F       '...'
        STX     $00C8                    ;04C1: DF C8          '..'
Z04C3   RTS                              ;04C3: 39             '9'
Z04C4   LDAA    M008E                    ;04C4: 96 8E          '..'
        LDX     M007A                    ;04C6: DE 7A          '.z'
Z04C8   LDAB    ,X                       ;04C8: E6 00          '..'
        ORAB    $01,X                    ;04CA: EA 01          '..'
        BEQ     Z04DE                    ;04CC: 27 10          ''.'
        CMPA    $02,X                    ;04CE: A1 02          '..'
        BHI     Z04DA                    ;04D0: 22 08          '".'
        BCS     Z04DF                    ;04D2: 25 0B          '%.'
        LDAB    M008F                    ;04D4: D6 8F          '..'
        CMPB    $03,X                    ;04D6: E1 03          '..'
        BLS     Z04DF                    ;04D8: 23 05          '#.'
Z04DA   LDX     ,X                       ;04DA: EE 00          '..'
        BRA     Z04C8                    ;04DC: 20 EA          ' .'
Z04DE   SEC                              ;04DE: 0D             '.'
Z04DF   STX     M00A9                    ;04DF: DF A9          '..'
        RTS                              ;04E1: 39             '9'
        BNE     Z04DF                    ;04E2: 26 FB          '&.'
Z04E4   LDX     M007A                    ;04E4: DE 7A          '.z'
        CLR     ,X                       ;04E6: 6F 00          'o.'
        INX                              ;04E8: 08             '.'
        CLR     ,X                       ;04E9: 6F 00          'o.'
        INX                              ;04EB: 08             '.'
        STX     M007C                    ;04EC: DF 7C          '.|'
Z04EE   LDX     M007A                    ;04EE: DE 7A          '.z'
        DEX                              ;04F0: 09             '.'
        STX     $00C8                    ;04F1: DF C8          '..'
Z04F3   LDX     M0088                    ;04F3: DE 88          '..'
        STX     M0084                    ;04F5: DF 84          '..'
        JSR     Z0612                    ;04F7: BD 06 12       '...'
        LDX     M007C                    ;04FA: DE 7C          '.|'
        STX     M007E                    ;04FC: DF 7E          '.~'
        STX     M0080                    ;04FE: DF 80          '..'

READY   LDX     #M0065                   ;0500: CE 00 65       '..e'
        STX     TEMPPT                   ;0503: DF 61          '.a'
        TSX                              ;0505: 30             '0'
        LDX     ,X                       ;0506: EE 00          '..'
        LDS     M0082                    ;0508: 9E 82          '..'
        CLRA                             ;050A: 4F             'O'
        PSHA                             ;050B: 36             '6'
        STAA    M0090                    ;050C: 97 90          '..'
        STAA    M0091                    ;050E: 97 91          '..'
        STAA    M005E                    ;0510: 97 5E          '.^'
        JMP     ,X                       ;0512: 6E 00          'n.'
        BHI     Z04C3                    ;0514: 22 AD          '".'
        JSR     Z0767                    ;0516: BD 07 67       '..g'
        BNE     Z04C3                    ;0519: 26 A8          '&.'
        PULA                             ;051B: 32             '2'
        PULA                             ;051C: 32             '2'
        BSR     Z04C4                    ;051D: 8D A5          '..'
Z051F   LDAA    ,X                       ;051F: A6 00          '..'
        ORAA    $01,X                    ;0521: AA 01          '..'
        BNE     Z0528                    ;0523: 26 03          '&.'
        JMP     Z033C                    ;0525: 7E 03 3C       '~.<'
Z0528   JSR     Z0618                    ;0528: BD 06 18       '...'
        JSR     Z0834                    ;052B: BD 08 34       '..4'
        LDAA    $02,X                    ;052E: A6 02          '..'
        LDAB    $03,X                    ;0530: E6 03          '..'
        INX                              ;0532: 08             '.'
        INX                              ;0533: 08             '.'
        INX                              ;0534: 08             '.'
        INX                              ;0535: 08             '.'
        STX     M0071                    ;0536: DF 71          '.q'
        JSR     Z15E0                    ;0538: BD 15 E0       '...'
        LDAA    #$20                     ;053B: 86 20          '. '
Z053D   LDX     M0071                    ;053D: DE 71          '.q'
Z053F   JSR     OUTDO                    ;053F: BD 08 95       '...'
        LDAA    ,X                       ;0542: A6 00          '..'
        INX                              ;0544: 08             '.'
        TSTA                             ;0545: 4D             'M'
        BEQ     Z051F                    ;0546: 27 D7          ''.'
        BPL     Z053F                    ;0548: 2A F5          '*.'
        SUBA    #$7F                     ;054A: 80 7F          '..'
        STX     M0071                    ;054C: DF 71          '.q'
        LDX     #RESLST                  ;054E: CE 01 5C       '..\'
Z0551   DECA                             ;0551: 4A             'J'
        BEQ     Z055B                    ;0552: 27 07          ''.'
Z0554   LDAB    ,X                       ;0554: E6 00          '..'
        INX                              ;0556: 08             '.'
        BPL     Z0554                    ;0557: 2A FB          '*.'
        BRA     Z0551                    ;0559: 20 F6          ' .'
Z055B   LDAA    ,X                       ;055B: A6 00          '..'
        BMI     Z053D                    ;055D: 2B DE          '+.'
        INX                              ;055F: 08             '.'
        JSR     OUTDO                    ;0560: BD 08 95       '...'
        BRA     Z055B                    ;0563: 20 F6          ' .'
        LDAA    #$80                     ;0565: 86 80          '..'
        STAA    M005E                    ;0567: 97 5E          '.^'
        JSR     Z0791                    ;0569: BD 07 91       '...'
        JSR     Z02A7                    ;056C: BD 02 A7       '...'
        INS                              ;056F: 31             '1'
        INS                              ;0570: 31             '1'
        BNE     Z0577                    ;0571: 26 04          '&.'
        JSR     Z0306                    ;0573: BD 03 06       '...'
        TXS                              ;0576: 35             '5'
Z0577   LDAB    #$08                     ;0577: C6 08          '..'
        JSR     Z02EA                    ;0579: BD 02 EA       '...'
        JSR     Z070B                    ;057C: BD 07 0B       '...'
        STX     M0071                    ;057F: DF 71          '.q'
        LDAB    M0072                    ;0581: D6 72          '.r'
        PSHB                             ;0583: 37             '7'
        LDAB    M0071                    ;0584: D6 71          '.q'
        PSHB                             ;0586: 37             '7'
        LDAB    M008B                    ;0587: D6 8B          '..'
        PSHB                             ;0589: 37             '7'
        LDAB    M008A                    ;058A: D6 8A          '..'
        PSHB                             ;058C: 37             '7'
        LDAB    #$9B                     ;058D: C6 9B          '..'
        JSR     Z0B3F                    ;058F: BD 0B 3F       '..?'
        JSR     Z0A0D                    ;0592: BD 0A 0D       '...'
        JSR     Z0A0B                    ;0595: BD 0A 0B       '...'
        LDAB    M00B3                    ;0598: D6 B3          '..'
        ORAB    #$7F                     ;059A: CA 7F          '..'
        ANDB    DSCTMP                   ;059C: D4 B0          '..'
        STAB    DSCTMP                   ;059E: D7 B0          '..'
        LDX     #M05A6                   ;05A0: CE 05 A6       '...'
        JMP     Z0AAB                    ;05A3: 7E 0A AB       '~..'
M05A6   LDX     #M12B1                   ;05A6: CE 12 B1       '...'
        JSR     Z1438                    ;05A9: BD 14 38       '..8'
        JSR     CHRGOT                   ;05AC: BD 00 C7       '...'
        CMPA    #$A0                     ;05AF: 81 A0          '..'
        BNE     Z05B9                    ;05B1: 26 06          '&.'
;       JSR     Z00BF                    ;05B3: BD 00 BF       '...'
        DB      $BD,$00,$BF
        JSR     Z0A0B                    ;05B6: BD 0A 0B       '...'
Z05B9   JSR     Z1483                    ;05B9: BD 14 83       '...'
        JSR     Z0AA5                    ;05BC: BD 0A A5       '...'
        LDAB    M009F                    ;05BF: D6 9F          '..'
        PSHB                             ;05C1: 37             '7'
        LDAB    M009E                    ;05C2: D6 9E          '..'
        PSHB                             ;05C4: 37             '7'
        LDAA    #$81                     ;05C5: 86 81          '..'
        PSHA                             ;05C7: 36             '6'
Z05C8   BSR     Z0618                    ;05C8: 8D 4E          '.N'
        LDX     $00C8                    ;05CA: DE C8          '..'
        STX     M0092                    ;05CC: DF 92          '..'
        LDAA    ,X                       ;05CE: A6 00          '..'
        BEQ     Z05D9                    ;05D0: 27 07          ''.'
        CMPA    #$3A                     ;05D2: 81 3A          '.:'
        BEQ     Z05EF                    ;05D4: 27 19          ''.'
Z05D6   JMP     Z0B49                    ;05D6: 7E 0B 49       '~.I'
Z05D9   INX                              ;05D9: 08             '.'
        LDAA    ,X                       ;05DA: A6 00          '..'
        INX                              ;05DC: 08             '.'
        ORAA    ,X                       ;05DD: AA 00          '..'
        CLC                              ;05DF: 0C             '.'
        TPA                              ;05E0: 07             '.'
        BEQ     Z0637                    ;05E1: 27 54          ''T'
        INX                              ;05E3: 08             '.'
        LDAA    ,X                       ;05E4: A6 00          '..'
        STAA    M008A                    ;05E6: 97 8A          '..'
        INX                              ;05E8: 08             '.'
        LDAA    ,X                       ;05E9: A6 00          '..'
        STAA    M008B                    ;05EB: 97 8B          '..'
        STX     $00C8                    ;05ED: DF C8          '..'
;Z05EF  JSR     Z00BF                    ;05EF: BD 00 BF       '...'
Z05EF   DB      $BD,$00,$BF
        BSR     Z05F6                    ;05F2: 8D 02          '..'
        BRA     Z05C8                    ;05F4: 20 D2          ' .'
Z05F6   BEQ     Z0663                    ;05F6: 27 6B          ''k'
Z05F8   SUBA    #$80                     ;05F8: 80 80          '..'
        BCC     Z05FF                    ;05FA: 24 03          '$.'
        JMP     Z0791                    ;05FC: 7E 07 91       '~..'
Z05FF   CMPA    #$1A                     ;05FF: 81 1A          '..'
        BCC     Z05D6                    ;0601: 24 D3          '$.'
        ASLA                             ;0603: 48             'H'
        TAB                              ;0604: 16             '.'
        LDX     #M0234                   ;0605: CE 02 34       '..4'
        JSR     Z0303                    ;0608: BD 03 03       '...'
        LDX     ,X                       ;060B: EE 00          '..'
;       JSR     Z00BF                    ;060D: BD 00 BF       '...'
        DB      $BD,$00,$BF
        JMP     ,X                       ;0610: 6E 00          'n.'
Z0612   LDX     M007A                    ;0612: DE 7A          '.z'
        DEX                              ;0614: 09             '.'
Z0615   STX     M0096                    ;0615: DF 96          '..'
Z0617   RTS                              ;0617: 39             '9'
Z0618   JSR     POLCAT                   ;0618: BD FF 24       '..$'   Poll input; carry set if char avail (in monitor)
        BCC     Z0617                    ;061B: 24 FA          '$.'
        JSR     Z041E                    ;061D: BD 04 1E       '...'
        PSHA                             ;0620: 36             '6'
        LDAA    MF002                    ;0621: B6 F0 02       '...'
        ANDA    #$02                     ;0624: 84 02          '..'
        PULA                             ;0626: 32             '2'
        BEQ     Z062B                    ;0627: 27 02          ''.'
        LDAA    #$03                     ;0629: 86 03          '..'
Z062B   CMPA    #$03                     ;062B: 81 03          '..'
        SEC                              ;062D: 0D             '.'
        BNE     Z0663                    ;062E: 26 33          '&3'
        TPA                              ;0630: 07             '.'
        LDX     $00C8                    ;0631: DE C8          '..'
        STX     M0092                    ;0633: DF 92          '..'
Z0635   INS                              ;0635: 31             '1'
        INS                              ;0636: 31             '1'
Z0637   LDX     M008A                    ;0637: DE 8A          '..'
        INX                              ;0639: 08             '.'
        BEQ     Z0643                    ;063A: 27 07          ''.'
        DEX                              ;063C: 09             '.'
        STX     M008C                    ;063D: DF 8C          '..'
        LDX     M0092                    ;063F: DE 92          '..'
        STX     M0090                    ;0641: DF 90          '..'
Z0643   CLR     M0111                    ;0643: 7F 01 11       '...'
        LDX     #M029E                   ;0646: CE 02 9E       '...'
        TAP                              ;0649: 06             '.'
        BCC     Z064F                    ;064A: 24 03          '$.'
        JMP     Z0331                    ;064C: 7E 03 31       '~.1'
Z064F   JMP     Z033C                    ;064F: 7E 03 3C       '~.<'
M0652   BNE     Z0663                    ;0652: 26 0F          '&.'
        LDAB    #$20                     ;0654: C6 20          '. '
        LDX     M0090                    ;0656: DE 90          '..'
        BNE     Z065D                    ;0658: 26 03          '&.'
        JMP     Z0313                    ;065A: 7E 03 13       '~..'
Z065D   STX     $00C8                    ;065D: DF C8          '..'
        LDX     M008C                    ;065F: DE 8C          '..'
        STX     M008A                    ;0661: DF 8A          '..'
Z0663   RTS                              ;0663: 39             '9'
        JSR     Z113B                    ;0664: BD 11 3B       '..;'
        BNE     Z0663                    ;0667: 26 FA          '&.'
        INCB                             ;0669: 5C             '\'
        CMPB    M000C                    ;066A: D1 0C          '..'
        BCC     Z0672                    ;066C: 24 04          '$.'
        DECB                             ;066E: 5A             'Z'
        STAB    M000A                    ;066F: D7 0A          '..'
        RTS                              ;0671: 39             '9'
Z0672   JMP     Z0D4B+1                  ;0672: 7E 0D 4C       '~.L'
        BEQ     Z06A0                    ;0675: 27 29          '')'
        JSR     Z0CD1                    ;0677: BD 0C D1       '...'
        JSR     CHRGOT                   ;067A: BD 00 C7       '...'
        BNE     Z0663                    ;067D: 26 E4          '&.'
        LDAA    M0088                    ;067F: 96 88          '..'
        LDAB    M0089                    ;0681: D6 89          '..'
        SUBB    M00B2                    ;0683: D0 B2          '..'
        SBCA    DSCTMP+1                 ;0685: 92 B1          '..'
        BCS     Z069D                    ;0687: 25 14          '%.'
        LDX     M0082                    ;0689: DE 82          '..'
        STAA    M0082                    ;068B: 97 82          '..'
        STAB    M0083                    ;068D: D7 83          '..'
        SUBB    #$28                     ;068F: C0 28          '.('
        SBCA    #$00                     ;0691: 82 00          '..'
        BCS     Z069B                    ;0693: 25 06          '%.'
        SUBB    M007D                    ;0695: D0 7D          '.}'
        SBCA    M007C                    ;0697: 92 7C          '.|'
        BCC     Z06A0                    ;0699: 24 05          '$.'
Z069B   STX     M0082                    ;069B: DF 82          '..'
Z069D   JMP     Z0311                    ;069D: 7E 03 11       '~..'
Z06A0   JMP     Z04F3                    ;06A0: 7E 04 F3       '~..'
        BNE     Z06A8                    ;06A3: 26 03          '&.'
        JMP     Z04EE                    ;06A5: 7E 04 EE       '~..'
Z06A8   JSR     Z04F3                    ;06A8: BD 04 F3       '...'
        BRA     Z06C1                    ;06AB: 20 14          ' .'
        LDAB    #$03                     ;06AD: C6 03          '..'
        JSR     Z02EA                    ;06AF: BD 02 EA       '...'
        LDAB    $00C9                    ;06B2: D6 C9          '..'
        PSHB                             ;06B4: 37             '7'
        LDAB    $00C8                    ;06B5: D6 C8          '..'
        PSHB                             ;06B7: 37             '7'
        LDAB    M008B                    ;06B8: D6 8B          '..'
        PSHB                             ;06BA: 37             '7'
        LDAB    M008A                    ;06BB: D6 8A          '..'
        PSHB                             ;06BD: 37             '7'
        LDAA    #$8C                     ;06BE: 86 8C          '..'
        PSHA                             ;06C0: 36             '6'
Z06C1   JSR     CHRGOT                   ;06C1: BD 00 C7       '...'
        BSR     Z06C9                    ;06C4: 8D 03          '..'
        JMP     Z05C8                    ;06C6: 7E 05 C8       '~..'
Z06C9   JSR     Z0767                    ;06C9: BD 07 67       '..g'
        BSR     Z070D+1                  ;06CC: 8D 40          '.@'
        INX                              ;06CE: 08             '.'
        LDAA    M008E                    ;06CF: 96 8E          '..'
        CMPA    M008A                    ;06D1: 91 8A          '..'
        BHI     Z06D7                    ;06D3: 22 02          '".'
        LDX     M007A                    ;06D5: DE 7A          '.z'
Z06D7   JSR     Z04C8                    ;06D7: BD 04 C8       '...'
        BCS     Z06F0+1                  ;06DA: 25 15          '%.'
        DEX                              ;06DC: 09             '.'
        STX     $00C8                    ;06DD: DF C8          '..'
Z06DF   RTS                              ;06DF: 39             '9'
        BNE     Z06DF                    ;06E0: 26 FD          '&.'
        LDAA    #$FF                     ;06E2: 86 FF          '..'
        STAA    M009E                    ;06E4: 97 9E          '..'
        JSR     Z02A7                    ;06E6: BD 02 A7       '...'
        TXS                              ;06E9: 35             '5'
        CMPA    #$0B                     ;06EA: 81 0B          '..'
        BEQ     Z06F9                    ;06EC: 27 0B          ''.'
        LDAB    #$04                     ;06EE: C6 04          '..'
Z06F0   CPX     #$C60E                   ;06F0: 8C C6 0E       '...'
        JMP     Z0313                    ;06F3: 7E 03 13       '~..'
Z06F6   JMP     Z0B49                    ;06F6: 7E 0B 49       '~.I'
Z06F9   PULA                             ;06F9: 32             '2'
        PULB                             ;06FA: 33             '3'
        STAB    M008A                    ;06FB: D7 8A          '..'
        PULB                             ;06FD: 33             '3'
        STAB    M008B                    ;06FE: D7 8B          '..'
        PULB                             ;0700: 33             '3'
        STAB    $00C8                    ;0701: D7 C8          '..'
        PULB                             ;0703: 33             '3'
        STAB    $00C9                    ;0704: D7 C9          '..'
Z0706   BSR     Z070B                    ;0706: 8D 03          '..'
        STX     $00C8                    ;0708: DF C8          '..'
Z070A   RTS                              ;070A: 39             '9'
Z070B   LDAB    #$3A                     ;070B: C6 3A          '.:'
Z070D   LDAA    #$5F                     ;070D: 86 5F          '._'
        STAB    CHARAC                   ;070F: D7 58          '.X'
        CLRB                             ;0711: 5F             '_'
        LDX     $00C8                    ;0712: DE C8          '..'
Z0714   TBA                              ;0714: 17             '.'
        LDAB    CHARAC                   ;0715: D6 58          '.X'
        STAA    CHARAC                   ;0717: 97 58          '.X'
Z0719   LDAA    ,X                       ;0719: A6 00          '..'
        BEQ     Z070A                    ;071B: 27 ED          ''.'
        CBA                              ;071D: 11             '.'
        BEQ     Z070A                    ;071E: 27 EA          ''.'
        INX                              ;0720: 08             '.'
        CMPA    #$22                     ;0721: 81 22          '."'
        BEQ     Z0714                    ;0723: 27 EF          ''.'
        BRA     Z0719                    ;0725: 20 F2          ' .'
        JSR     Z0A19                    ;0727: BD 0A 19       '...'
        JSR     CHRGOT                   ;072A: BD 00 C7       '...'
        CMPA    #$88                     ;072D: 81 88          '..'
        BEQ     Z0736                    ;072F: 27 05          ''.'
        LDAB    #$9E                     ;0731: C6 9E          '..'
        JSR     Z0B3F                    ;0733: BD 0B 3F       '..?'
Z0736   LDAA    tmpstrlen                ;0736: 96 AF          '..'
        BNE     Z073F                    ;0738: 26 05          '&.'
        BSR     Z070D+1                  ;073A: 8D D2          '..'
        STX     $00C8                    ;073C: DF C8          '..'
        RTS                              ;073E: 39             '9'
Z073F   JSR     CHRGOT                   ;073F: BD 00 C7       '...'
        BCS     Z06C9                    ;0742: 25 85          '%.'
        JMP     Z05F6                    ;0744: 7E 05 F6       '~..'
        JSR     Z113B                    ;0747: BD 11 3B       '..;'
        PSHA                             ;074A: 36             '6'
        CMPA    #$8C                     ;074B: 81 8C          '..'
        BEQ     Z0753                    ;074D: 27 04          ''.'
        CMPA    #$88                     ;074F: 81 88          '..'
Z0751   BNE     Z06F6                    ;0751: 26 A3          '&.'
Z0753   DEC     M00B2                    ;0753: 7A 00 B2       'z..'
        BNE     Z075C                    ;0756: 26 04          '&.'
        PULA                             ;0758: 32             '2'
        JMP     Z05F8                    ;0759: 7E 05 F8       '~..'
;Z075C  JSR     Z00BF                    ;075C: BD 00 BF       '...'
Z075C   DB      $BD,$00,$BF
        BSR     Z0767                    ;075F: 8D 06          '..'
        CMPA    #$2C                     ;0761: 81 2C          '.,'
        BEQ     Z0753                    ;0763: 27 EE          ''.'
        INS                              ;0765: 31             '1'
Z0766   RTS                              ;0766: 39             '9'
Z0767   LDX     #START                   ;0767: CE 00 00       '...'
        STX     M008E                    ;076A: DF 8E          '..'
Z076C   BCC     Z0766                    ;076C: 24 F8          '$.'
        SUBA    #$30                     ;076E: 80 30          '.0'
        STAA    CHARAC                   ;0770: 97 58          '.X'
        LDAA    M008E                    ;0772: 96 8E          '..'
        LDAB    M008F                    ;0774: D6 8F          '..'
        CMPA    #$18                     ;0776: 81 18          '..'
        BHI     Z0751                    ;0778: 22 D7          '".'
        ASLB                             ;077A: 58             'X'
        ROLA                             ;077B: 49             'I'
        ASLB                             ;077C: 58             'X'
        ROLA                             ;077D: 49             'I'
        ADDB    M008F                    ;077E: DB 8F          '..'
        ADCA    M008E                    ;0780: 99 8E          '..'
        ASLB                             ;0782: 58             'X'
        ROLA                             ;0783: 49             'I'
        ADDB    CHARAC                   ;0784: DB 58          '.X'
        ADCA    #$00                     ;0786: 89 00          '..'
        STAA    M008E                    ;0788: 97 8E          '..'
        STAB    M008F                    ;078A: D7 8F          '..'
;       JSR     Z00BF                    ;078C: BD 00 BF       '...'
        DB      $BD,$00,$BF
        BRA     Z076C                    ;078F: 20 DB          ' .'
Z0791   JSR     Z0C29                    ;0791: BD 0C 29       '..)'
        STX     M009E                    ;0794: DF 9E          '..'
        LDAB    #$A9                     ;0796: C6 A9          '..'
        JSR     Z0B3F                    ;0798: BD 0B 3F       '..?'
        LDAA    M005C                    ;079B: 96 5C          '.\'
        PSHA                             ;079D: 36             '6'
        JSR     Z0A19                    ;079E: BD 0A 19       '...'
        PULA                             ;07A1: 32             '2'
        RORA                             ;07A2: 46             'F'
        JSR     Z0A0F                    ;07A3: BD 0A 0F       '...'
        BEQ     Z07F1                    ;07A6: 27 49          ''I'
Z07A8   LDX     DSCTMP+1                 ;07A8: DE B1          '..'
        LDAA    M0082                    ;07AA: 96 82          '..'
        CMPA    $02,X                    ;07AC: A1 02          '..'
        BHI     Z07D3                    ;07AE: 22 23          '"#'
        BCS     Z07B8                    ;07B0: 25 06          '%.'
        LDAB    M0083                    ;07B2: D6 83          '..'
        CMPB    $03,X                    ;07B4: E1 03          '..'
        BCC     Z07D3                    ;07B6: 24 1B          '$.'
Z07B8   LDAA    M007C                    ;07B8: 96 7C          '.|'
        CMPA    DSCTMP+1                 ;07BA: 91 B1          '..'
        BHI     Z07D3                    ;07BC: 22 15          '".'
        BCS     Z07C6                    ;07BE: 25 06          '%.'
        LDAB    M007C                    ;07C0: D6 7C          '.|'
        CMPB    M00B2                    ;07C2: D1 B2          '..'
        BHI     Z07D3                    ;07C4: 22 0D          '".'
Z07C6   LDAB    ,X                       ;07C6: E6 00          '..'
        JSR     STRINI                   ;07C8: BD 0F 01       '...'
        LDX     M00AD                    ;07CB: DE AD          '..'
        JSR     Z105F                    ;07CD: BD 10 5F       '.._'
        LDX     #tmpstrlen               ;07D0: CE 00 AF       '...'
Z07D3   STX     M00AD                    ;07D3: DF AD          '..'
        JSR     Z109B                    ;07D5: BD 10 9B       '...'
        TPA                              ;07D8: 07             '.'
        PSHA                             ;07D9: 36             '6'
        STS     M0078                    ;07DA: 9F 78          '.x'
        SEI                              ;07DC: 0F             '.'
        LDX     M00AD                    ;07DD: DE AD          '..'
        TXS                              ;07DF: 35             '5'
        LDX     M009E                    ;07E0: DE 9E          '..'
        PULA                             ;07E2: 32             '2'
        STAA    ,X                       ;07E3: A7 00          '..'
        PULA                             ;07E5: 32             '2'
        PULA                             ;07E6: 32             '2'
        STAA    $02,X                    ;07E7: A7 02          '..'
        PULA                             ;07E9: 32             '2'
        STAA    $03,X                    ;07EA: A7 03          '..'
        LDS     M0078                    ;07EC: 9E 78          '.x'
        PULA                             ;07EE: 32             '2'
        TAP                              ;07EF: 06             '.'
        RTS                              ;07F0: 39             '9'
Z07F1   JMP     Z1451+1                  ;07F1: 7E 14 52       '~.R'
Z07F4   JSR     STRPRT                   ;07F4: BD 08 7C       '..|'
Z07F7   JSR     CHRGOT                   ;07F7: BD 00 C7       '...'
        BEQ     Z0834                    ;07FA: 27 38          ''8'
Z07FC   BEQ     PRTRTS                   ;07FC: 27 4E          ''N'
        CMPA    #$9A                     ;07FE: 81 9A          '..'
        BEQ     Z085E                    ;0800: 27 5C          ''\'
        CMPA    #$9D                     ;0802: 81 9D          '..'
        BEQ     Z085E                    ;0804: 27 58          ''X'
        CMPA    #$2C                     ;0806: 81 2C          '.,'
        BEQ     Z084D                    ;0808: 27 43          ''C'
        CMPA    #$3B                     ;080A: 81 3B          '.;'
        BEQ     Z0874                    ;080C: 27 66          ''f'
        JSR     Z0A19                    ;080E: BD 0A 19       '...'
        LDX     DSCTMP+1                 ;0811: DE B1          '..'
        LDAA    M005C                    ;0813: 96 5C          '.\'
        BNE     Z07F4                    ;0815: 26 DD          '&.'
        JSR     Z15EF                    ;0817: BD 15 EF       '...'
        JSR     dstrlit                  ;081A: BD 0F 0A       '...'
        LDX     DSCTMP+1                 ;081D: DE B1          '..'
        LDAA    M000B                    ;081F: 96 0B          '..'
        ADDA    ,X                       ;0821: AB 00          '..'
        CMPA    M000C                    ;0823: 91 0C          '..'
        BLS     Z0829                    ;0825: 23 02          '#.'
        BSR     Z0834                    ;0827: 8D 0B          '..'
Z0829   BSR     STRPRT                   ;0829: 8D 51          '.Q'
        BSR     OUTSPC                   ;082B: 8D 63          '.c'
        BRA     Z07F7                    ;082D: 20 C8          ' .'
Z082F   CLR     ,X                       ;082F: 6F 00          'o.'
        LDX     #M000F                   ;0831: CE 00 0F       '...'
Z0834   LDAA    #$0D                     ;0834: 86 0D          '..'
        STAA    M000B                    ;0836: 97 0B          '..'
        BSR     OUTDO                    ;0838: 8D 5B          '.['
        LDAA    #$0A                     ;083A: 86 0A          '..'
        BSR     OUTDO                    ;083C: 8D 57          '.W'
CRFIN   PSHB                             ;083E: 37             '7'
        LDAB    M000A                    ;083F: D6 0A          '..'
        BEQ     Z0849                    ;0841: 27 06          ''.'
        CLRA                             ;0843: 4F             'O'
Z0844   BSR     OUTDO                    ;0844: 8D 4F          '.O'
        DECB                             ;0846: 5A             'Z'
        BNE     Z0844                    ;0847: 26 FB          '&.'
Z0849   STAB    M000B                    ;0849: D7 0B          '..'
        PULB                             ;084B: 33             '3'
PRTRTS  RTS                              ;084C: 39             '9'
Z084D   LDAB    M000B                    ;084D: D6 0B          '..'
        CMPB    M000D                    ;084F: D1 0D          '..'
        BCS     Z0857                    ;0851: 25 04          '%.'
        BSR     Z0834                    ;0853: 8D DF          '..'
        BRA     Z0874                    ;0855: 20 1D          ' .'
Z0857   SUBB    #$0E                     ;0857: C0 0E          '..'
        BCC     Z0857                    ;0859: 24 FC          '$.'
        NEGB                             ;085B: 50             'P'
        BRA     Z086F                    ;085C: 20 11          ' .'
Z085E   PSHA                             ;085E: 36             '6'
        JSR     Z1138                    ;085F: BD 11 38       '..8'
        CMPA    #$29                     ;0862: 81 29          '.)'
        BNE     Z08CD                    ;0864: 26 67          '&g'
        PULA                             ;0866: 32             '2'
        CMPA    #$9D                     ;0867: 81 9D          '..'
        BEQ     Z086F                    ;0869: 27 04          ''.'
        SUBB    M000B                    ;086B: D0 0B          '..'
        BLS     Z0874                    ;086D: 23 05          '#.'
Z086F   BSR     OUTSPC                   ;086F: 8D 1F          '..'
        DECB                             ;0871: 5A             'Z'
        BNE     Z086F                    ;0872: 26 FB          '&.'
;Z0874  JSR     Z00BF                    ;0874: BD 00 BF       '...'
Z0874   DB      $BD,$00,$BF
        BRA     Z07FC                    ;0877: 20 83          ' .'
;
; XXX This is a little strange in that IX appears to be
; loaded with the location one BEFORE the start of the
; string....
;
; PRINT THE STRING POINTED TO BY IX-1 WHICH ENDS WITH A ZERO.
; XXX ??? IF THE STRING IS BELOW DSCTMP IT WILL BE COPIED INTO STRING SPACE.
;
STROUT  JSR     STRLIT                   ;0879: BD 0F 0B       '...'   GET A STRING LITERAL
;
; PRINT THE STRING WHOSE DESCRIPTOR IS POINTED TO BY FACMO.
;
STRPRT  JSR     FREFAC                   ;087C: BD 10 7D       '..}'   RETURN TEMP POINTER.
        INCB                             ;087F: 5C             '\'
STRPR2  DECB                             ;0880: 5A             'Z'
        BEQ     PRTRTS                   ;0881: 27 C9          ''.'
        LDAA    ,X                       ;0883: A6 00          '..'
        BSR     OUTDO                    ;0885: 8D 0E          '..'
        INX                              ;0887: 08             '.'
        CMPA    #$0D                     ;0888: 81 0D          '..'
        BNE     STRPR2                   ;088A: 26 F4          '&.'
        BSR     CRFIN                    ;088C: 8D B0          '..'    TYPE REST OF CARRIAGE RETURN.
        BRA     STRPR2                   ;088E: 20 F0          ' .'    AND ON AND ON.
;
; OUTDO OUTPUTS THE CHARACTER IN ACCA, USING CNTWFL
; (SUPPRESS OR NOT), TRMPOS (PRINT HEAD POSITION),
; TIMING, ETC. NO REGISTERS ARE CHANGED.
;
OUTSPC  LDAA    #$20                     ;0890: 86 20          '. '
Z0892   CPX     #$863F                   ;0892: 8C 86 3F       '..?'
OUTDO   TST     M0111                    ;0895: 7D 01 11       '}..'
        BNE     Z08B1                    ;0898: 26 17          '&.'
        PSHA                             ;089A: 36             '6'
        CMPA    #$20                     ;089B: 81 20          '. '
        BCS     Z08AA                    ;089D: 25 0B          '%.'
        LDAA    M000B                    ;089F: 96 0B          '..'
        CMPA    M000C                    ;08A1: 91 0C          '..'
        BNE     Z08A7                    ;08A3: 26 02          '&.'
        BSR     Z0834                    ;08A5: 8D 8D          '..'
Z08A7   INCA                             ;08A7: 4C             'L'
        STAA    M000B                    ;08A8: 97 0B          '..'
Z08AA   PULA                             ;08AA: 32             '2'
        PSHB                             ;08AB: 37             '7'
        TAB                              ;08AC: 16             '.'
        JSR     OUTCH                    ;08AD: BD FF 81       '...'   Output char in B (in monitor)
        PULB                             ;08B0: 33             '3'
Z08B1   RTS                              ;08B1: 39             '9'
        SWI                              ;08B2: 3F             '?'
        DB      $52                      ;08B3: 52             'R'
        DB      $45                      ;08B4: 45             'E'
        LSRA                             ;08B5: 44             'D'
        CLRA                             ;08B6: 4F             'O'
        DB      $20,$46                  ;08B7: 20 46          ' F'
        DB      $52                      ;08B9: 52             'R'
        CLRA                             ;08BA: 4F             'O'
        TSTA                             ;08BB: 4D             'M'
        BRA     Z0911                    ;08BC: 20 53          ' S'
        LSRB                             ;08BE: 54             'T'
        DB      $41                      ;08BF: 41             'A'
        DB      $52                      ;08C0: 52             'R'
        ANDB    M000D                    ;08C1: D4 0D          '..'
        CLV                              ;08C3: 0A             '.'
        DB      $00                      ;08C4: 00             '.'
Z08C5   LDAA    M005F                    ;08C5: 96 5F          '._'
        BEQ     Z08D0                    ;08C7: 27 07          ''.'
        LDX     M0094                    ;08C9: DE 94          '..'
        STX     M008A                    ;08CB: DF 8A          '..'
Z08CD   JMP     Z0B49                    ;08CD: 7E 0B 49       '~.I'
Z08D0   LDX     #Z08B1                   ;08D0: CE 08 B1       '...'
        BSR     STROUT                   ;08D3: 8D A4          '..'
        LDX     M0092                    ;08D5: DE 92          '..'
        STX     $00C8                    ;08D7: DF C8          '..'
        RTS                              ;08D9: 39             '9'
        CLR     M0111                    ;08DA: 7F 01 11       '...'
        CMPA    #$22                     ;08DD: 81 22          '."'
        BNE     Z08EB                    ;08DF: 26 0A          '&.'
        JSR     Z0B0A                    ;08E1: BD 0B 0A       '...'
        LDAB    #$3B                     ;08E4: C6 3B          '.;'
        JSR     Z0B3F                    ;08E6: BD 0B 3F       '..?'
        BSR     STRPRT                   ;08E9: 8D 91          '..'
Z08EB   JSR     Z0E45                    ;08EB: BD 0E 45       '..E'
        BSR     Z08F9                    ;08EE: 8D 09          '..'
        LDAA    M0010                    ;08F0: 96 10          '..'
        BNE     Z0902+1                  ;08F2: 26 0F          '&.'
        CLC                              ;08F4: 0C             '.'
        TPA                              ;08F5: 07             '.'
        JMP     Z0635                    ;08F6: 7E 06 35       '~.5'
Z08F9   BSR     Z0892+1                  ;08F9: 8D 98          '..'
        BSR     OUTSPC                   ;08FB: 8D 93          '..'
        JMP     Z03EC                    ;08FD: 7E 03 EC       '~..'
        LDX     M0096                    ;0900: DE 96          '..'
Z0902   LDAA    #$4F                     ;0902: 86 4F          '.O'
        STAA    M005F                    ;0904: 97 5F          '._'
        STX     M0098                    ;0906: DF 98          '..'
Z0908   JSR     Z0C29                    ;0908: BD 0C 29       '..)'
        STX     M009E                    ;090B: DF 9E          '..'
        LDX     $00C8                    ;090D: DE C8          '..'
        STX     M008E                    ;090F: DF 8E          '..'
Z0911   LDX     M0098                    ;0911: DE 98          '..'
        LDAA    ,X                       ;0913: A6 00          '..'
        BNE     Z0920                    ;0915: 26 09          '&.'
        LDAA    M005F                    ;0917: 96 5F          '._'
        BNE     Z0969                    ;0919: 26 4E          '&N'
        JSR     Z0892+1                  ;091B: BD 08 93       '...'
        BSR     Z08F9                    ;091E: 8D D9          '..'
Z0920   STX     $00C8                    ;0920: DF C8          '..'
;       JSR     Z00BF                    ;0922: BD 00 BF       '...'
        DB      $BD,$00,$BF
        LDAB    M005C                    ;0925: D6 5C          '.\'
        BEQ     Z0945                    ;0927: 27 1C          ''.'
        LDX     $00C8                    ;0929: DE C8          '..'
        STAA    CHARAC                   ;092B: 97 58          '.X'
        CMPA    #$22                     ;092D: 81 22          '."'
        BEQ     Z0938                    ;092F: 27 07          ''.'
        DEX                              ;0931: 09             '.'
        LDAA    #$3A                     ;0932: 86 3A          '.:'
        STAA    CHARAC                   ;0934: 97 58          '.X'
        LDAA    #$2C                     ;0936: 86 2C          '.,'
Z0938   STAA    ENDCHR                   ;0938: 97 59          '.Y'
        JSR     STRLIT2                  ;093A: BD 0F 11       '...'
        JSR     Z116C                    ;093D: BD 11 6C       '..l'
        JSR     Z07A8                    ;0940: BD 07 A8       '...'
        BRA     Z094B                    ;0943: 20 06          ' .'
Z0945   JSR     Z1526                    ;0945: BD 15 26       '..&'
        JSR     Z1451+1                  ;0948: BD 14 52       '..R'
Z094B   JSR     CHRGOT                   ;094B: BD 00 C7       '...'
        BEQ     Z0957                    ;094E: 27 07          ''.'
        CMPA    #$2C                     ;0950: 81 2C          '.,'
        BEQ     Z0957                    ;0952: 27 03          ''.'
        JMP     Z08C5                    ;0954: 7E 08 C5       '~..'
Z0957   LDX     $00C8                    ;0957: DE C8          '..'
        STX     M0098                    ;0959: DF 98          '..'
        LDX     M008E                    ;095B: DE 8E          '..'
        STX     $00C8                    ;095D: DF C8          '..'
        JSR     CHRGOT                   ;095F: BD 00 C7       '...'
        BEQ     Z098E                    ;0962: 27 2A          ''*'
        JSR     Z0B3C+1                  ;0964: BD 0B 3D       '..='
        BRA     Z0908                    ;0967: 20 9F          ' .'
Z0969   STX     $00C8                    ;0969: DF C8          '..'
        JSR     Z070B                    ;096B: BD 07 0B       '...'
        TSTA                             ;096E: 4D             'M'
        BNE     Z0985                    ;096F: 26 14          '&.'
        LDAA    $01,X                    ;0971: A6 01          '..'
        LDAB    #$06                     ;0973: C6 06          '..'
        ORAA    $02,X                    ;0975: AA 02          '..'
        BEQ     Z09C6                    ;0977: 27 4D          ''M'
        LDAA    $03,X                    ;0979: A6 03          '..'
        STAA    M0094                    ;097B: 97 94          '..'
        LDAA    $04,X                    ;097D: A6 04          '..'
        STAA    M0095                    ;097F: 97 95          '..'
        INX                              ;0981: 08             '.'
        INX                              ;0982: 08             '.'
        INX                              ;0983: 08             '.'
        INX                              ;0984: 08             '.'
Z0985   INX                              ;0985: 08             '.'
        LDAA    ,X                       ;0986: A6 00          '..'
        CMPA    #$83                     ;0988: 81 83          '..'
        BNE     Z0969                    ;098A: 26 DD          '&.'
        BRA     Z0920                    ;098C: 20 92          ' .'
Z098E   LDX     M0098                    ;098E: DE 98          '..'
        LDAB    M005F                    ;0990: D6 5F          '._'
        BEQ     Z0997                    ;0992: 27 03          ''.'
        JMP     Z0615                    ;0994: 7E 06 15       '~..'
Z0997   LDAA    ,X                       ;0997: A6 00          '..'
        BEQ     Z09A1                    ;0999: 27 06          ''.'
        LDX     #Z09A1                   ;099B: CE 09 A1       '...'
        JMP     STROUT                   ;099E: 7E 08 79       '~.y'
Z09A1   RTS                              ;09A1: 39             '9'
        SWI                              ;09A2: 3F             '?'
        DB      $45                      ;09A3: 45             'E'
        ASLB                             ;09A4: 58             'X'
        LSRB                             ;09A5: 54             'T'
        DB      $52                      ;09A6: 52             'R'
        DB      $41                      ;09A7: 41             'A'
        DB      $20,$49                  ;09A8: 20 49          ' I'
        ASRA                             ;09AA: 47             'G'
        DB      $4E                      ;09AB: 4E             'N'
        CLRA                             ;09AC: 4F             'O'
        DB      $52                      ;09AD: 52             'R'
        DB      $45                      ;09AE: 45             'E'
        ANDB    #$0D                     ;09AF: C4 0D          '..'
        CLV                              ;09B1: 0A             '.'
        DB      $00                      ;09B2: 00             '.'
        BNE     Z09BA                    ;09B3: 26 05          '&.'
        LDX     #START                   ;09B5: CE 00 00       '...'
        BRA     Z09BD                    ;09B8: 20 03          ' .'
Z09BA   JSR     Z0C29                    ;09BA: BD 0C 29       '..)'
Z09BD   STX     M009E                    ;09BD: DF 9E          '..'
        JSR     Z02A7                    ;09BF: BD 02 A7       '...'
        BEQ     Z09C8                    ;09C2: 27 04          ''.'
        LDAB    #$00                     ;09C4: C6 00          '..'
Z09C6   BRA     Z0A16                    ;09C6: 20 4E          ' N'
Z09C8   TXS                              ;09C8: 35             '5'
        INX                              ;09C9: 08             '.'
        INX                              ;09CA: 08             '.'
        INX                              ;09CB: 08             '.'
        STX     M0071                    ;09CC: DF 71          '.q'
        JSR     Z1438                    ;09CE: BD 14 38       '..8'
        TSX                              ;09D1: 30             '0'
        LDAA    $07,X                    ;09D2: A6 07          '..'
        STAA    M00B3                    ;09D4: 97 B3          '..'
        LDX     M009E                    ;09D6: DE 9E          '..'
        JSR     Z11C4                    ;09D8: BD 11 C4       '...'
        JSR     Z1451+1                  ;09DB: BD 14 52       '..R'
        LDX     M0071                    ;09DE: DE 71          '.q'
        INX                              ;09E0: 08             '.'
        INX                              ;09E1: 08             '.'
        INX                              ;09E2: 08             '.'
        INX                              ;09E3: 08             '.'
        INX                              ;09E4: 08             '.'
        JSR     Z14AE                    ;09E5: BD 14 AE       '...'
        TSX                              ;09E8: 30             '0'
        SUBB    $07,X                    ;09E9: E0 07          '..'
        BEQ     Z09F9                    ;09EB: 27 0C          ''.'
        LDX     $0C,X                    ;09ED: EE 0C          '..'
        STX     M008A                    ;09EF: DF 8A          '..'
        TSX                              ;09F1: 30             '0'
        LDX     $0E,X                    ;09F2: EE 0E          '..'
        STX     $00C8                    ;09F4: DF C8          '..'
Z09F6   JMP     Z05C8                    ;09F6: 7E 05 C8       '~..'
Z09F9   LDAB    #$10                     ;09F9: C6 10          '..'
        JSR     Z0303                    ;09FB: BD 03 03       '...'
        TXS                              ;09FE: 35             '5'
        JSR     CHRGOT                   ;09FF: BD 00 C7       '...'
        CMPA    #$2C                     ;0A02: 81 2C          '.,'
        BNE     Z09F6                    ;0A04: 26 F0          '&.'
;       JSR     Z00BF                    ;0A06: BD 00 BF       '...'
        DB      $BD,$00,$BF
        BSR     Z09BA                    ;0A09: 8D AF          '..'
Z0A0B   BSR     Z0A19                    ;0A0B: 8D 0C          '..'
Z0A0D   DB      $6D                      ;0A0D: 6D             'm'
Z0A0E   SEC                              ;0A0E: 0D             '.'
Z0A0F   ROR     M005C                    ;0A0F: 76 00 5C       'v.\'
        BVC     Z09A1                    ;0A12: 28 8D          '(.'
        LDAB    #$18                     ;0A14: C6 18          '..'
Z0A16   JMP     Z0313                    ;0A16: 7E 03 13       '~..'
Z0A19   LDX     $00C8                    ;0A19: DE C8          '..'
        DEX                              ;0A1B: 09             '.'
        STX     $00C8                    ;0A1C: DF C8          '..'
        CLRA                             ;0A1E: 4F             'O'
Z0A1F   LDAB    #$37                     ;0A1F: C6 37          '.7'
        PSHA                             ;0A21: 36             '6'
        LDAB    #$01                     ;0A22: C6 01          '..'
        JSR     Z02EA                    ;0A24: BD 02 EA       '...'
        JSR     Z0AEB                    ;0A27: BD 0A EB       '...'
        CLR     M00A2                    ;0A2A: 7F 00 A2       '...'
Z0A2D   JSR     CHRGOT                   ;0A2D: BD 00 C7       '...'
Z0A30   SUBA    #$A8                     ;0A30: 80 A8          '..'
        BCS     Z0A48                    ;0A32: 25 14          '%.'
        CMPA    #$03                     ;0A34: 81 03          '..'
        BCC     Z0A48                    ;0A36: 24 10          '$.'
        CMPA    #$01                     ;0A38: 81 01          '..'
        ROLA                             ;0A3A: 49             'I'
        EORA    M00A2                    ;0A3B: 98 A2          '..'
        CMPA    M00A2                    ;0A3D: 91 A2          '..'
        BCS     Z0A9E                    ;0A3F: 25 5D          '%]'
        STAA    M00A2                    ;0A41: 97 A2          '..'
;       JSR     Z00BF                    ;0A43: BD 00 BF       '...'
        DB      $BD,$00,$BF
        BRA     Z0A30                    ;0A46: 20 E8          ' .'
Z0A48   LDAB    M00A2                    ;0A48: D6 A2          '..'
        BNE     Z0A79                    ;0A4A: 26 2D          '&-'
        BCC     Z0AB9                    ;0A4C: 24 6B          '$k'
        ADDA    #$07                     ;0A4E: 8B 07          '..'
        BCC     Z0AB9                    ;0A50: 24 67          '$g'
        ADCA    M005C                    ;0A52: 99 5C          '.\'
        BNE     Z0A59                    ;0A54: 26 03          '&.'
        JMP     Z1025                    ;0A56: 7E 10 25       '~.%'
Z0A59   ADCA    #$FF                     ;0A59: 89 FF          '..'
        TAB                              ;0A5B: 16             '.'
        ASLA                             ;0A5C: 48             'H'
        ABA                              ;0A5D: 1B             '.'
        TAB                              ;0A5E: 16             '.'
        LDX     #M0147                   ;0A5F: CE 01 47       '..G'
        JSR     Z0303                    ;0A62: BD 03 03       '...'
Z0A65   PULA                             ;0A65: 32             '2'
        CMPA    ,X                       ;0A66: A1 00          '..'
        BCC     Z0AC0                    ;0A68: 24 56          '$V'
        BSR     Z0A0D                    ;0A6A: 8D A1          '..'
Z0A6C   PSHA                             ;0A6C: 36             '6'
        BSR     Z0A92                    ;0A6D: 8D 23          '.#'
        LDX     M00A0                    ;0A6F: DE A0          '..'
        PULA                             ;0A71: 32             '2'
        BNE     Z0A8B+1                  ;0A72: 26 18          '&.'
        TSTA                             ;0A74: 4D             'M'
        BEQ     Z0AE8                    ;0A75: 27 71          ''q'
        BRA     Z0AC9                    ;0A77: 20 50          ' P'
Z0A79   ASL     M005C                    ;0A79: 78 00 5C       'x.\'
        ROLB                             ;0A7C: 59             'Y'
        LDX     $00C8                    ;0A7D: DE C8          '..'
        DEX                              ;0A7F: 09             '.'
        STX     $00C8                    ;0A80: DF C8          '..'
        LDX     #M0A89                   ;0A82: CE 0A 89       '...'
        STAB    M00A2                    ;0A85: D7 A2          '..'
        BRA     Z0A65                    ;0A87: 20 DC          ' .'
M0A89   LSR     $0B,X                    ;0A89: 64 0B          'd.'
Z0A8B   CPX     $A100                    ;0A8B: BC A1 00       '...'
        BCC     Z0AC9                    ;0A8E: 24 39          '$9'
        BRA     Z0A6C                    ;0A90: 20 DA          ' .'
Z0A92   LDAA    $02,X                    ;0A92: A6 02          '..'
        PSHA                             ;0A94: 36             '6'
        LDAA    $01,X                    ;0A95: A6 01          '..'
        PSHA                             ;0A97: 36             '6'
        BSR     Z0AA1                    ;0A98: 8D 07          '..'
        LDAB    M00A2                    ;0A9A: D6 A2          '..'
        BRA     Z0A1F+1                  ;0A9C: 20 82          ' .'
Z0A9E   JMP     Z0B49                    ;0A9E: 7E 0B 49       '~.I'
Z0AA1   LDAB    M00B3                    ;0AA1: D6 B3          '..'
        LDAA    ,X                       ;0AA3: A6 00          '..'
Z0AA5   TSX                              ;0AA5: 30             '0'
        LDX     ,X                       ;0AA6: EE 00          '..'
        INS                              ;0AA8: 31             '1'
        INS                              ;0AA9: 31             '1'
        PSHB                             ;0AAA: 37             '7'
Z0AAB   LDAB    M00B2                    ;0AAB: D6 B2          '..'
        PSHB                             ;0AAD: 37             '7'
        LDAB    DSCTMP+1                 ;0AAE: D6 B1          '..'
        PSHB                             ;0AB0: 37             '7'
        LDAB    DSCTMP                   ;0AB1: D6 B0          '..'
        PSHB                             ;0AB3: 37             '7'
        LDAB    tmpstrlen                ;0AB4: D6 AF          '..'
        PSHB                             ;0AB6: 37             '7'
        JMP     ,X                       ;0AB7: 6E 00          'n.'
Z0AB9   LDX     #START                   ;0AB9: CE 00 00       '...'
        PULA                             ;0ABC: 32             '2'
        TSTA                             ;0ABD: 4D             'M'
        BEQ     Z0AE8                    ;0ABE: 27 28          ''('
Z0AC0   CMPA    #$64                     ;0AC0: 81 64          '.d'
        BEQ     Z0AC7                    ;0AC2: 27 03          ''.'
        JSR     Z0A0D                    ;0AC4: BD 0A 0D       '...'
Z0AC7   STX     M00A0                    ;0AC7: DF A0          '..'
Z0AC9   PULB                             ;0AC9: 33             '3'
        CMPA    #$5A                     ;0ACA: 81 5A          '.Z'
        BEQ     Z0AEA                    ;0ACC: 27 1C          ''.'
        CMPA    #$7D                     ;0ACE: 81 7D          '.}'
        BEQ     Z0AEA                    ;0AD0: 27 18          ''.'
        LSRB                             ;0AD2: 54             'T'
        STAB    M0060                    ;0AD3: D7 60          '.`'
        PULA                             ;0AD5: 32             '2'
        STAA    M00B6                    ;0AD6: 97 B6          '..'
        PULB                             ;0AD8: 33             '3'
        STAB    M00B7                    ;0AD9: D7 B7          '..'
        PULB                             ;0ADB: 33             '3'
        STAB    M00B8                    ;0ADC: D7 B8          '..'
        PULB                             ;0ADE: 33             '3'
        STAB    M00B9                    ;0ADF: D7 B9          '..'
        PULB                             ;0AE1: 33             '3'
        STAB    M00BA                    ;0AE2: D7 BA          '..'
        EORB    M00B3                    ;0AE4: D8 B3          '..'
        STAB    STRNG1                   ;0AE6: D7 BB          '..'
Z0AE8   LDAB    tmpstrlen                ;0AE8: D6 AF          '..'
Z0AEA   RTS                              ;0AEA: 39             '9'
Z0AEB   CLR     M005C                    ;0AEB: 7F 00 5C       '..\'
Z0AEE   BSR     Z0B46                    ;0AEE: 8D 56          '.V'
        BCC     Z0AF5                    ;0AF0: 24 03          '$.'
Z0AF2   JMP     Z1526                    ;0AF2: 7E 15 26       '~.&'
Z0AF5   JSR     Z0C85                    ;0AF5: BD 0C 85       '...'
        BCC     Z0B56                    ;0AF8: 24 5C          '$\'
        CMPA    #$2E                     ;0AFA: 81 2E          '..'
        BEQ     Z0AF2                    ;0AFC: 27 F4          ''.'
        CMPA    #$A2                     ;0AFE: 81 A2          '..'
        BEQ     Z0B4E                    ;0B00: 27 4C          ''L'
        CMPA    #$A1                     ;0B02: 81 A1          '..'
        BEQ     Z0AEE                    ;0B04: 27 E8          ''.'
        CMPA    #$22                     ;0B06: 81 22          '."'
        BNE     Z0B12                    ;0B08: 26 08          '&.'
Z0B0A   LDX     $00C8                    ;0B0A: DE C8          '..'
        JSR     STRLIT                   ;0B0C: BD 0F 0B       '...'
        JMP     Z116C                    ;0B0F: 7E 11 6C       '~.l'
Z0B12   CMPA    #$9F                     ;0B12: 81 9F          '..'
        BNE     Z0B27                    ;0B14: 26 11          '&.'
        LDAA    #$5A                     ;0B16: 86 5A          '.Z'
        JSR     Z0A1F+1                  ;0B18: BD 0A 20       '.. '
        JSR     Z0CD8                    ;0B1B: BD 0C D8       '...'
        LDAA    DSCTMP+1                 ;0B1E: 96 B1          '..'
        LDAB    M00B2                    ;0B20: D6 B2          '..'
        COMA                             ;0B22: 43             'C'
        COMB                             ;0B23: 53             'S'
        JMP     Z0E34                    ;0B24: 7E 0E 34       '~.4'
Z0B27   CMPA    #$9C                     ;0B27: 81 9C          '..'
        BNE     Z0B2E                    ;0B29: 26 03          '&.'
        JMP     Z0E8D                    ;0B2B: 7E 0E 8D       '~..'
Z0B2E   SUBA    #$AB                     ;0B2E: 80 AB          '..'
        BCC     Z0B62                    ;0B30: 24 30          '$0'
Z0B32   BSR     Z0B39+1                  ;0B32: 8D 06          '..'
        JSR     Z0A19                    ;0B34: BD 0A 19       '...'
Z0B37   LDAB    #$29                     ;0B37: C6 29          '.)'
Z0B39   CPX     #$C628                   ;0B39: 8C C6 28       '..('
Z0B3C   CPX     #$C62C                   ;0B3C: 8C C6 2C       '..,'
Z0B3F   LDX     $00C8                    ;0B3F: DE C8          '..'
        LDAA    ,X                       ;0B41: A6 00          '..'
        CBA                              ;0B43: 11             '.'
        BNE     Z0B49                    ;0B44: 26 03          '&.'
Z0B46   JMP     $00BF                    ;0B46: 7E 00 BF       '~..'
Z0B49   LDAB    #$02                     ;0B49: C6 02          '..'
        JMP     Z0313                    ;0B4B: 7E 03 13       '~..'
Z0B4E   LDAA    #$7D                     ;0B4E: 86 7D          '.}'
        JSR     Z0A1F+1                  ;0B50: BD 0A 20       '.. '
        JMP     Z173B                    ;0B53: 7E 17 3B       '~.;'
Z0B56   JSR     Z0C29                    ;0B56: BD 0C 29       '..)'
        STX     DSCTMP+1                 ;0B59: DF B1          '..'
        LDAA    M005C                    ;0B5B: 96 5C          '.\'
        BNE     Z0AEA                    ;0B5D: 26 8B          '&.'
        JMP     Z1438                    ;0B5F: 7E 14 38       '~.8'
Z0B62   TAB                              ;0B62: 16             '.'
        ASLB                             ;0B63: 58             'X'
        BSR     Z0B46                    ;0B64: 8D E0          '..'
        PSHB                             ;0B66: 37             '7'
        CMPB    #$27                     ;0B67: C1 27          '.''
        BCS     Z0B85                    ;0B69: 25 1A          '%.'
        BSR     Z0B39+1                  ;0B6B: 8D CD          '..'
        JSR     Z0A19                    ;0B6D: BD 0A 19       '...'
        BSR     Z0B3C+1                  ;0B70: 8D CB          '..'
        JSR     Z0A0E                    ;0B72: BD 0A 0E       '...'
        PULA                             ;0B75: 32             '2'
        LDAB    M00B2                    ;0B76: D6 B2          '..'
        PSHB                             ;0B78: 37             '7'
        LDAB    DSCTMP+1                 ;0B79: D6 B1          '..'
        PSHB                             ;0B7B: 37             '7'
        PSHA                             ;0B7C: 36             '6'
        JSR     Z113B                    ;0B7D: BD 11 3B       '..;'
        PULA                             ;0B80: 32             '2'
        PSHB                             ;0B81: 37             '7'
        TAB                              ;0B82: 16             '.'
        BRA     Z0B88                    ;0B83: 20 03          ' .'
Z0B85   BSR     Z0B32                    ;0B85: 8D AB          '..'
        PULB                             ;0B87: 33             '3'
Z0B88   LDX     #M0119                   ;0B88: CE 01 19       '...'
        JSR     Z0303                    ;0B8B: BD 03 03       '...'
        LDX     ,X                       ;0B8E: EE 00          '..'
        JSR     ,X                       ;0B90: AD 00          '..'
        JMP     Z0A0D                    ;0B92: 7E 0A 0D       '~..'
        LDAA    #$4F                     ;0B95: 86 4F          '.O'
        STAA    M005A                    ;0B97: 97 5A          '.Z'
        JSR     Z0CD8                    ;0B99: BD 0C D8       '...'
        LDX     DSCTMP+1                 ;0B9C: DE B1          '..'
        STX     CHARAC                   ;0B9E: DF 58          '.X'
        JSR     Z1469                    ;0BA0: BD 14 69       '..i'
        JSR     Z0CD8                    ;0BA3: BD 0C D8       '...'
        LDAA    CHARAC                   ;0BA6: 96 58          '.X'
        LDAB    ENDCHR                   ;0BA8: D6 59          '.Y'
        TST     M005A                    ;0BAA: 7D 00 5A       '}.Z'
        BNE     Z0BB5                    ;0BAD: 26 06          '&.'
        ANDA    DSCTMP+1                 ;0BAF: 94 B1          '..'
        ANDB    M00B2                    ;0BB1: D4 B2          '..'
        BRA     Z0BB9                    ;0BB3: 20 04          ' .'
Z0BB5   ORAA    DSCTMP+1                 ;0BB5: 9A B1          '..'
        ORAB    M00B2                    ;0BB7: DA B2          '..'
Z0BB9   JMP     Z0E34                    ;0BB9: 7E 0E 34       '~.4'
        JSR     Z0A0F                    ;0BBC: BD 0A 0F       '...'
        BNE     Z0BD1                    ;0BBF: 26 10          '&.'
        LDAA    M00BA                    ;0BC1: 96 BA          '..'
        ORAA    #$7F                     ;0BC3: 8A 7F          '..'
        ANDA    M00B7                    ;0BC5: 94 B7          '..'
        STAA    M00B7                    ;0BC7: 97 B7          '..'
        LDX     #M00B6                   ;0BC9: CE 00 B6       '...'
        JSR     Z14AE                    ;0BCC: BD 14 AE       '...'
        BRA     Z0C11                    ;0BCF: 20 40          ' @'
Z0BD1   CLR     M005C                    ;0BD1: 7F 00 5C       '..\'
        DEC     M00A2                    ;0BD4: 7A 00 A2       'z..'
        JSR     FREFAC                   ;0BD7: BD 10 7D       '..}'
        STAB    tmpstrlen                ;0BDA: D7 AF          '..'
        STX     DSCTMP+1                 ;0BDC: DF B1          '..'
        LDX     M00B8                    ;0BDE: DE B8          '..'
        JSR     Z107F                    ;0BE0: BD 10 7F       '...'
        LDAA    tmpstrlen                ;0BE3: 96 AF          '..'
        SBA                              ;0BE5: 10             '.'
        BEQ     Z0BEF                    ;0BE6: 27 07          ''.'
        LDAA    #$01                     ;0BE8: 86 01          '..'
        BCC     Z0BEF                    ;0BEA: 24 03          '$.'
        LDAB    tmpstrlen                ;0BEC: D6 AF          '..'
        NEGA                             ;0BEE: 40             '@'
Z0BEF   STAA    M00B3                    ;0BEF: 97 B3          '..'
        TPA                              ;0BF1: 07             '.'
        PSHA                             ;0BF2: 36             '6'
        STS     M0078                    ;0BF3: 9F 78          '.x'
        SEI                              ;0BF5: 0F             '.'
        TXS                              ;0BF6: 35             '5'
        LDX     DSCTMP+1                 ;0BF7: DE B1          '..'
        INCB                             ;0BF9: 5C             '\'
        DEX                              ;0BFA: 09             '.'
Z0BFB   DECB                             ;0BFB: 5A             'Z'
        BNE     Z0C02                    ;0BFC: 26 04          '&.'
        LDAB    M00B3                    ;0BFE: D6 B3          '..'
        BRA     Z0C0D                    ;0C00: 20 0B          ' .'
Z0C02   PULA                             ;0C02: 32             '2'
        INX                              ;0C03: 08             '.'
        CMPA    ,X                       ;0C04: A1 00          '..'
        BEQ     Z0BFB                    ;0C06: 27 F3          ''.'
        LDAB    #$FF                     ;0C08: C6 FF          '..'
        BCC     Z0C0D                    ;0C0A: 24 01          '$.'
        NEGB                             ;0C0C: 50             'P'
Z0C0D   LDS     M0078                    ;0C0D: 9E 78          '.x'
        PULA                             ;0C0F: 32             '2'
        TAP                              ;0C10: 06             '.'
Z0C11   ADDB    #$01                     ;0C11: CB 01          '..'
        ROLB                             ;0C13: 59             'Y'
        ANDB    M0060                    ;0C14: D4 60          '.`'
        BEQ     Z0C1A                    ;0C16: 27 02          ''.'
        LDAB    #$FF                     ;0C18: C6 FF          '..'
Z0C1A   JMP     Z1492                    ;0C1A: 7E 14 92       '~..'
Z0C1D   JSR     Z0B3C+1                  ;0C1D: BD 0B 3D       '..='
        TAB                              ;0C20: 16             '.'
        BSR     Z0C2D                    ;0C21: 8D 0A          '..'
        JSR     CHRGOT                   ;0C23: BD 00 C7       '...'
        BNE     Z0C1D                    ;0C26: 26 F5          '&.'
        RTS                              ;0C28: 39             '9'
Z0C29   CLRB                             ;0C29: 5F             '_'
        JSR     CHRGOT                   ;0C2A: BD 00 C7       '...'
Z0C2D   STAB    M005B                    ;0C2D: D7 5B          '.['
Z0C2F   STAA    M009A                    ;0C2F: 97 9A          '..'
        JSR     CHRGOT                   ;0C31: BD 00 C7       '...'
        BSR     Z0C85                    ;0C34: 8D 4F          '.O'
        BCC     Z0C3B                    ;0C36: 24 03          '$.'
        JMP     Z0B49                    ;0C38: 7E 0B 49       '~.I'
Z0C3B   CLRB                             ;0C3B: 5F             '_'
        STAB    M005C                    ;0C3C: D7 5C          '.\'
;       JSR     Z00BF                    ;0C3E: BD 00 BF       '...'
        DB      $BD,$00,$BF
        BCS     Z0C47                    ;0C41: 25 04          '%.'
        BSR     Z0C85                    ;0C43: 8D 40          '.@'
        BCS     Z0C51                    ;0C45: 25 0A          '%.'
Z0C47   TAB                              ;0C47: 16             '.'
;Z0C48  JSR     Z00BF                    ;0C48: BD 00 BF       '...'
Z0C48   DB      $BD,$00,$BF
        BCS     Z0C48                    ;0C4B: 25 FB          '%.'
        BSR     Z0C85                    ;0C4D: 8D 36          '.6'
        BCC     Z0C48                    ;0C4F: 24 F7          '$.'
Z0C51   CMPA    #$24                     ;0C51: 81 24          '.$'
        BNE     Z0C5D                    ;0C53: 26 08          '&.'
        COM     M005C                    ;0C55: 73 00 5C       's.\'
        ADDB    #$80                     ;0C58: CB 80          '..'
;       JSR     Z00BF                    ;0C5A: BD 00 BF       '...'
        DB      $BD,$00,$BF
Z0C5D   STAB    M009B                    ;0C5D: D7 9B          '..'
        ADDA    M005E                    ;0C5F: 9B 5E          '.^'
        SUBA    #$28                     ;0C61: 80 28          '.('
        BNE     Z0C68                    ;0C63: 26 03          '&.'
        JMP     Z0CE9                    ;0C65: 7E 0C E9       '~..'
Z0C68   CLR     M005E                    ;0C68: 7F 00 5E       '..^'
        LDX     M007C                    ;0C6B: DE 7C          '.|'
        LDAA    M009A                    ;0C6D: 96 9A          '..'
        LDAB    M009B                    ;0C6F: D6 9B          '..'
Z0C71   CPX     M007E                    ;0C71: 9C 7E          '.~'
        BEQ     Z0C8E                    ;0C73: 27 19          ''.'
        CMPA    ,X                       ;0C75: A1 00          '..'
        BNE     Z0C7D                    ;0C77: 26 04          '&.'
        CMPB    $01,X                    ;0C79: E1 01          '..'
        BEQ     Z0CC5                    ;0C7B: 27 48          ''H'
Z0C7D   INX                              ;0C7D: 08             '.'
        INX                              ;0C7E: 08             '.'
        INX                              ;0C7F: 08             '.'
        INX                              ;0C80: 08             '.'
        INX                              ;0C81: 08             '.'
        INX                              ;0C82: 08             '.'
        BRA     Z0C71                    ;0C83: 20 EC          ' .'
Z0C85   CMPA    #$41                     ;0C85: 81 41          '.A'
        BCS     Z0C8D                    ;0C87: 25 04          '%.'
        SUBA    #$5B                     ;0C89: 80 5B          '.['
        SUBA    #$A5                     ;0C8B: 80 A5          '..'
Z0C8D   RTS                              ;0C8D: 39             '9'
Z0C8E   PULA                             ;0C8E: 32             '2'
        PSHA                             ;0C8F: 36             '6'
        CMPA    #$0B                     ;0C90: 81 0B          '..'
        BNE     Z0C98                    ;0C92: 26 04          '&.'
        LDX     #$0D05                   ;0C94: CE 0D 05       '...'
        RTS                              ;0C97: 39             '9'
Z0C98   LDX     M0080                    ;0C98: DE 80          '..'
        STX     M00A5                    ;0C9A: DF A5          '..'
        LDAB    #$06                     ;0C9C: C6 06          '..'
        JSR     Z0303                    ;0C9E: BD 03 03       '...'
        STX     M00A3                    ;0CA1: DF A3          '..'
        LDX     M007E                    ;0CA3: DE 7E          '.~'
        STX     M00A9                    ;0CA5: DF A9          '..'
        JSR     Z02CE                    ;0CA7: BD 02 CE       '...'
        LDX     M00A3                    ;0CAA: DE A3          '..'
        STX     M0080                    ;0CAC: DF 80          '..'
        LDX     M00A7                    ;0CAE: DE A7          '..'
        STX     M007E                    ;0CB0: DF 7E          '.~'
        LDX     M00A9                    ;0CB2: DE A9          '..'
        LDAA    M009A                    ;0CB4: 96 9A          '..'
        LDAB    M009B                    ;0CB6: D6 9B          '..'
        STAA    ,X                       ;0CB8: A7 00          '..'
        STAB    $01,X                    ;0CBA: E7 01          '..'
        CLRA                             ;0CBC: 4F             'O'
        STAA    $02,X                    ;0CBD: A7 02          '..'
        STAA    $03,X                    ;0CBF: A7 03          '..'
        STAA    $04,X                    ;0CC1: A7 04          '..'
        STAA    $05,X                    ;0CC3: A7 05          '..'
Z0CC5   INX                              ;0CC5: 08             '.'
        INX                              ;0CC6: 08             '.'
        STX     M009C                    ;0CC7: DF 9C          '..'
        RTS                              ;0CC9: 39             '9'
M0CCA   SUBA    M0080                    ;0CCA: 90 80          '..'
        DB      $00                      ;0CCC: 00             '.'
        DB      $00                      ;0CCD: 00             '.'
;Z0CCE  JSR     Z00BF                    ;0CCE: BD 00 BF       '...'
Z0CCE   DB      $BD,$00,$BF
Z0CD1   JSR     Z0A0B                    ;0CD1: BD 0A 0B       '...'
Z0CD4   LDAA    M00B3                    ;0CD4: 96 B3          '..'
        BMI     Z0D4B+1                  ;0CD6: 2B 74          '+t'
Z0CD8   LDAA    tmpstrlen                ;0CD8: 96 AF          '..'
        CMPA    #$90                     ;0CDA: 81 90          '..'
        BCS     Z0CE6                    ;0CDC: 25 08          '%.'
        LDX     #M0CCA                   ;0CDE: CE 0C CA       '...'
        JSR     Z14AE                    ;0CE1: BD 14 AE       '...'
        BNE     Z0D4B+1                  ;0CE4: 26 66          '&f'
Z0CE6   JMP     Z14DA                    ;0CE6: 7E 14 DA       '~..'
Z0CE9   LDAA    M005B                    ;0CE9: 96 5B          '.['
        PSHA                             ;0CEB: 36             '6'
        LDAA    M005C                    ;0CEC: 96 5C          '.\'
        PSHA                             ;0CEE: 36             '6'
        CLRB                             ;0CEF: 5F             '_'
Z0CF0   PSHB                             ;0CF0: 37             '7'
        LDAB    M009B                    ;0CF1: D6 9B          '..'
        PSHB                             ;0CF3: 37             '7'
        LDAB    M009A                    ;0CF4: D6 9A          '..'
        PSHB                             ;0CF6: 37             '7'
        BSR     Z0CCE                    ;0CF7: 8D D5          '..'
        PULB                             ;0CF9: 33             '3'
        STAB    M009A                    ;0CFA: D7 9A          '..'
        PULB                             ;0CFC: 33             '3'
        STAB    M009B                    ;0CFD: D7 9B          '..'
        PULB                             ;0CFF: 33             '3'
        TSX                              ;0D00: 30             '0'
        LDAA    $01,X                    ;0D01: A6 01          '..'
        PSHA                             ;0D03: 36             '6'
        LDAA    ,X                       ;0D04: A6 00          '..'
        PSHA                             ;0D06: 36             '6'
        LDAA    DSCTMP+1                 ;0D07: 96 B1          '..'
        STAA    ,X                       ;0D09: A7 00          '..'
        LDAA    M00B2                    ;0D0B: 96 B2          '..'
        STAA    $01,X                    ;0D0D: A7 01          '..'
        INCB                             ;0D0F: 5C             '\'
        JSR     CHRGOT                   ;0D10: BD 00 C7       '...'
        CMPA    #$2C                     ;0D13: 81 2C          '.,'
        BEQ     Z0CF0                    ;0D15: 27 D9          ''.'
        STAB    M005A                    ;0D17: D7 5A          '.Z'
        JSR     Z0B37                    ;0D19: BD 0B 37       '..7'
        PULA                             ;0D1C: 32             '2'
        STAA    M005C                    ;0D1D: 97 5C          '.\'
        PULA                             ;0D1F: 32             '2'
        STAA    M005B                    ;0D20: 97 5B          '.['
        LDX     M007E                    ;0D22: DE 7E          '.~'
Z0D24   CPX     M0080                    ;0D24: 9C 80          '..'
        BEQ     Z0D51                    ;0D26: 27 29          '')'
        LDAA    M009A                    ;0D28: 96 9A          '..'
        CMPA    ,X                       ;0D2A: A1 00          '..'
        BNE     Z0D34                    ;0D2C: 26 06          '&.'
        LDAA    M009B                    ;0D2E: 96 9B          '..'
        CMPA    $01,X                    ;0D30: A1 01          '..'
        BEQ     Z0D3D                    ;0D32: 27 09          ''.'
Z0D34   LDAA    $02,X                    ;0D34: A6 02          '..'
        LDAB    $03,X                    ;0D36: E6 03          '..'
        JSR     Z0304                    ;0D38: BD 03 04       '...'
        BRA     Z0D24                    ;0D3B: 20 E7          ' .'
Z0D3D   LDAB    #$12                     ;0D3D: C6 12          '..'
        LDAA    M005B                    ;0D3F: 96 5B          '.['
        BNE     Z0D4E                    ;0D41: 26 0B          '&.'
        LDAB    M005A                    ;0D43: D6 5A          '.Z'
        CMPB    $04,X                    ;0D45: E1 04          '..'
        BEQ     Z0DB0                    ;0D47: 27 67          ''g'
Z0D49   LDAB    #$10                     ;0D49: C6 10          '..'
Z0D4B   CPX     #$C608                   ;0D4B: 8C C6 08       '...'
Z0D4E   JMP     Z0313                    ;0D4E: 7E 03 13       '~..'
Z0D51   LDAA    #$04                     ;0D51: 86 04          '..'
        STAA    M00BE                    ;0D53: 97 BE          '..'
        CLR     STRNG2                   ;0D55: 7F 00 BD       '...'
        LDAA    M009A                    ;0D58: 96 9A          '..'
        STAA    ,X                       ;0D5A: A7 00          '..'
        LDAA    M009B                    ;0D5C: 96 9B          '..'
        STAA    $01,X                    ;0D5E: A7 01          '..'
        LDAB    M005A                    ;0D60: D6 5A          '.Z'
        STAB    $04,X                    ;0D62: E7 04          '..'
        JSR     Z02EA                    ;0D64: BD 02 EA       '...'
        STX     M00A3                    ;0D67: DF A3          '..'
Z0D69   LDAB    #$0B                     ;0D69: C6 0B          '..'
        CLRA                             ;0D6B: 4F             'O'
        TST     M005B                    ;0D6C: 7D 00 5B       '}.['
        BEQ     Z0D77                    ;0D6F: 27 06          ''.'
        PULA                             ;0D71: 32             '2'
        PULB                             ;0D72: 33             '3'
        ADDB    #$01                     ;0D73: CB 01          '..'
        ADCA    #$00                     ;0D75: 89 00          '..'
Z0D77   STAA    $05,X                    ;0D77: A7 05          '..'
        STAB    $06,X                    ;0D79: E7 06          '..'
        BSR     Z0DEC                    ;0D7B: 8D 6F          '.o'
        STAA    STRNG2                   ;0D7D: 97 BD          '..'
        STAB    M00BE                    ;0D7F: D7 BE          '..'
        INX                              ;0D81: 08             '.'
        INX                              ;0D82: 08             '.'
        DEC     M005A                    ;0D83: 7A 00 5A       'z.Z'
        BNE     Z0D69                    ;0D86: 26 E1          '&.'
        JSR     Z0304                    ;0D88: BD 03 04       '...'
        BCS     Z0D49                    ;0D8B: 25 BC          '%.'
        JSR     Z02F0                    ;0D8D: BD 02 F0       '...'
        SUBB    #$21                     ;0D90: C0 21          '.!'
        SBCA    #$00                     ;0D92: 82 00          '..'
        STAA    M0080                    ;0D94: 97 80          '..'
        STAB    M0081                    ;0D96: D7 81          '..'
        CLRA                             ;0D98: 4F             'O'
Z0D99   DEX                              ;0D99: 09             '.'
        STAA    $05,X                    ;0D9A: A7 05          '..'
        CPX     M0071                    ;0D9C: 9C 71          '.q'
        BNE     Z0D99                    ;0D9E: 26 F9          '&.'
        LDX     M00A3                    ;0DA0: DE A3          '..'
        LDAA    M0080                    ;0DA2: 96 80          '..'
        SUBB    M00A4                    ;0DA4: D0 A4          '..'
        STAB    $03,X                    ;0DA6: E7 03          '..'
        SBCA    M00A3                    ;0DA8: 92 A3          '..'
        STAA    $02,X                    ;0DAA: A7 02          '..'
        LDAA    M005B                    ;0DAC: 96 5B          '.['
        BNE     Z0DEB                    ;0DAE: 26 3B          '&;'
Z0DB0   LDAB    $04,X                    ;0DB0: E6 04          '..'
        STAB    M005A                    ;0DB2: D7 5A          '.Z'
        CLRA                             ;0DB4: 4F             'O'
        CLRB                             ;0DB5: 5F             '_'
Z0DB6   STAA    STRNG2                   ;0DB6: 97 BD          '..'
        STAB    M00BE                    ;0DB8: D7 BE          '..'
        PULA                             ;0DBA: 32             '2'
        STAA    DSCTMP+1                 ;0DBB: 97 B1          '..'
        PULB                             ;0DBD: 33             '3'
        STAB    M00B2                    ;0DBE: D7 B2          '..'
        CMPA    $05,X                    ;0DC0: A1 05          '..'
        BCS     Z0DCA                    ;0DC2: 25 06          '%.'
        BHI     Z0E12                    ;0DC4: 22 4C          '"L'
        CMPB    $06,X                    ;0DC6: E1 06          '..'
        BCC     Z0E12                    ;0DC8: 24 48          '$H'
Z0DCA   LDAA    M00BE                    ;0DCA: 96 BE          '..'
        ORAA    STRNG2                   ;0DCC: 9A BD          '..'
        CLC                              ;0DCE: 0C             '.'
        BEQ     Z0DD5                    ;0DCF: 27 04          ''.'
        BSR     Z0DEC                    ;0DD1: 8D 19          '..'
        ADDB    M00B2                    ;0DD3: DB B2          '..'
Z0DD5   ADCA    DSCTMP+1                 ;0DD5: 99 B1          '..'
        INX                              ;0DD7: 08             '.'
        INX                              ;0DD8: 08             '.'
        DEC     M005A                    ;0DD9: 7A 00 5A       'z.Z'
        BNE     Z0DB6                    ;0DDC: 26 D8          '&.'
        ASLB                             ;0DDE: 58             'X'
        ROLA                             ;0DDF: 49             'I'
        ASLB                             ;0DE0: 58             'X'
        ROLA                             ;0DE1: 49             'I'
        ADDB    #$05                     ;0DE2: CB 05          '..'
        ADCA    #$00                     ;0DE4: 89 00          '..'
        JSR     Z0304                    ;0DE6: BD 03 04       '...'
        STX     M009C                    ;0DE9: DF 9C          '..'
Z0DEB   RTS                              ;0DEB: 39             '9'
Z0DEC   LDAA    #$10                     ;0DEC: 86 10          '..'
        STAA    M00A7                    ;0DEE: 97 A7          '..'
        LDAA    $05,X                    ;0DF0: A6 05          '..'
        STAA    M0078                    ;0DF2: 97 78          '.x'
        LDAA    $06,X                    ;0DF4: A6 06          '..'
        STAA    M0079                    ;0DF6: 97 79          '.y'
        CLRA                             ;0DF8: 4F             'O'
        CLRB                             ;0DF9: 5F             '_'
Z0DFA   ASLB                             ;0DFA: 58             'X'
        ROLA                             ;0DFB: 49             'I'
        BCS     Z0E12                    ;0DFC: 25 14          '%.'
        ASL     M00BE                    ;0DFE: 78 00 BE       'x..'
        ROL     STRNG2                   ;0E01: 79 00 BD       'y..'
        BCC     Z0E0C                    ;0E04: 24 06          '$.'
        ADDB    M0079                    ;0E06: DB 79          '.y'
        ADCA    M0078                    ;0E08: 99 78          '.x'
        BCS     Z0E12                    ;0E0A: 25 06          '%.'
Z0E0C   DEC     M00A7                    ;0E0C: 7A 00 A7       'z..'
        BNE     Z0DFA                    ;0E0F: 26 E9          '&.'
        RTS                              ;0E11: 39             '9'
Z0E12   JMP     Z0D49                    ;0E12: 7E 0D 49       '~.I'
        STS     M0078                    ;0E15: 9F 78          '.x'
        LDAA    M0078                    ;0E17: 96 78          '.x'
        LDAB    M0079                    ;0E19: D6 79          '.y'
        LDX     #M0080                   ;0E1B: CE 00 80       '...'
        TST     M005C                    ;0E1E: 7D 00 5C       '}.\'
        BEQ     Z0E30                    ;0E21: 27 0D          ''.'
        JSR     FREFAC                   ;0E23: BD 10 7D       '..}'
        JSR     Z0F86                    ;0E26: BD 0F 86       '...'
        LDX     #M0082                   ;0E29: CE 00 82       '...'
        LDAA    M0084                    ;0E2C: 96 84          '..'
        LDAB    M0085                    ;0E2E: D6 85          '..'
Z0E30   SUBB    $01,X                    ;0E30: E0 01          '..'
        SBCA    ,X                       ;0E32: A2 00          '..'
Z0E34   CLR     M005C                    ;0E34: 7F 00 5C       '..\'
        STAA    DSCTMP                   ;0E37: 97 B0          '..'
        STAB    DSCTMP+1                 ;0E39: D7 B1          '..'
        LDAB    #$90                     ;0E3B: C6 90          '..'
        JMP     Z1499                    ;0E3D: 7E 14 99       '~..'
        LDAB    M000B                    ;0E40: D6 0B          '..'
Z0E42   CLRA                             ;0E42: 4F             'O'
        BRA     Z0E34                    ;0E43: 20 EF          ' .'
Z0E45   LDX     M008A                    ;0E45: DE 8A          '..'
        INX                              ;0E47: 08             '.'
        BNE     Z0DEB                    ;0E48: 26 A1          '&.'
        LDAB    #$16                     ;0E4A: C6 16          '..'
Z0E4C   JMP     Z0313                    ;0E4C: 7E 03 13       '~..'
        BSR     Z0E7A                    ;0E4F: 8D 29          '.)'
        BSR     Z0E45                    ;0E51: 8D F2          '..'
        JSR     Z0B39+1                  ;0E53: BD 0B 3A       '..:'
        LDAB    #$80                     ;0E56: C6 80          '..'
        STAB    M005E                    ;0E58: D7 5E          '.^'
        JSR     Z0C29                    ;0E5A: BD 0C 29       '..)'
        BSR     Z0E8A                    ;0E5D: 8D 2B          '.+'
        JSR     Z0B37                    ;0E5F: BD 0B 37       '..7'
        LDAB    #$A9                     ;0E62: C6 A9          '..'
        JSR     Z0B3F                    ;0E64: BD 0B 3F       '..?'
        LDX     M00AB                    ;0E67: DE AB          '..'
        LDAA    $00C8                    ;0E69: 96 C8          '..'
        LDAB    $00C9                    ;0E6B: D6 C9          '..'
        STAA    ,X                       ;0E6D: A7 00          '..'
        STAB    $01,X                    ;0E6F: E7 01          '..'
        LDAA    M009C                    ;0E71: 96 9C          '..'
        LDAB    M009D                    ;0E73: D6 9D          '..'
        BSR     Z0EEC                    ;0E75: 8D 75          '.u'
        JMP     Z0706                    ;0E77: 7E 07 06       '~..'
Z0E7A   LDAB    #$9C                     ;0E7A: C6 9C          '..'
        JSR     Z0B3F                    ;0E7C: BD 0B 3F       '..?'
        LDAB    #$80                     ;0E7F: C6 80          '..'
        STAB    M005E                    ;0E81: D7 5E          '.^'
        ORAA    #$80                     ;0E83: 8A 80          '..'
        JSR     Z0C2F                    ;0E85: BD 0C 2F       '../'
        STX     M00AB                    ;0E88: DF AB          '..'
Z0E8A   JMP     Z0A0D                    ;0E8A: 7E 0A 0D       '~..'
Z0E8D   BSR     Z0E7A                    ;0E8D: 8D EB          '..'
        LDAB    M00AC                    ;0E8F: D6 AC          '..'
        PSHB                             ;0E91: 37             '7'
        LDAB    M00AB                    ;0E92: D6 AB          '..'
        PSHB                             ;0E94: 37             '7'
        JSR     Z0B32                    ;0E95: BD 0B 32       '..2'
        BSR     Z0E8A                    ;0E98: 8D F0          '..'
        PULB                             ;0E9A: 33             '3'
        STAB    M00AB                    ;0E9B: D7 AB          '..'
        PULB                             ;0E9D: 33             '3'
        STAB    M00AC                    ;0E9E: D7 AC          '..'
        LDX     M00AB                    ;0EA0: DE AB          '..'
        LDAB    #$22                     ;0EA2: C6 22          '."'
        LDX     $02,X                    ;0EA4: EE 02          '..'
        BEQ     Z0E4C                    ;0EA6: 27 A4          ''.'
        STX     M009C                    ;0EA8: DF 9C          '..'
        LDAA    $03,X                    ;0EAA: A6 03          '..'
        PSHA                             ;0EAC: 36             '6'
        LDAA    $02,X                    ;0EAD: A6 02          '..'
        PSHA                             ;0EAF: 36             '6'
        LDAA    $01,X                    ;0EB0: A6 01          '..'
        PSHA                             ;0EB2: 36             '6'
        LDAA    ,X                       ;0EB3: A6 00          '..'
        PSHA                             ;0EB5: 36             '6'
        JSR     Z1454                    ;0EB6: BD 14 54       '..T'
        LDX     M00AB                    ;0EB9: DE AB          '..'
        LDAB    $00C9                    ;0EBB: D6 C9          '..'
        PSHB                             ;0EBD: 37             '7'
        LDAB    $00C8                    ;0EBE: D6 C8          '..'
        PSHB                             ;0EC0: 37             '7'
        LDX     ,X                       ;0EC1: EE 00          '..'
        STX     $00C8                    ;0EC3: DF C8          '..'
        LDAB    M009D                    ;0EC5: D6 9D          '..'
        PSHB                             ;0EC7: 37             '7'
        LDAB    M009C                    ;0EC8: D6 9C          '..'
        PSHB                             ;0ECA: 37             '7'
        JSR     Z0A0B                    ;0ECB: BD 0A 0B       '...'
        PULB                             ;0ECE: 33             '3'
        STAB    M009C                    ;0ECF: D7 9C          '..'
        PULB                             ;0ED1: 33             '3'
        STAB    M009D                    ;0ED2: D7 9D          '..'
        JSR     CHRGOT                   ;0ED4: BD 00 C7       '...'
        BEQ     Z0EDC                    ;0ED7: 27 03          ''.'
        JMP     Z0B49                    ;0ED9: 7E 0B 49       '~.I'
Z0EDC   PULB                             ;0EDC: 33             '3'
        STAB    $00C8                    ;0EDD: D7 C8          '..'
        PULB                             ;0EDF: 33             '3'
        STAB    $00C9                    ;0EE0: D7 C9          '..'
        LDX     M009C                    ;0EE2: DE 9C          '..'
        PULA                             ;0EE4: 32             '2'
        STAA    ,X                       ;0EE5: A7 00          '..'
        PULA                             ;0EE7: 32             '2'
        STAA    $01,X                    ;0EE8: A7 01          '..'
        PULA                             ;0EEA: 32             '2'
        PULB                             ;0EEB: 33             '3'
Z0EEC   STAA    $02,X                    ;0EEC: A7 02          '..'
        STAB    $03,X                    ;0EEE: E7 03          '..'
        RTS                              ;0EF0: 39             '9'
        JSR     Z0A0D                    ;0EF1: BD 0A 0D       '...'
        LDX     #M00FF                   ;0EF4: CE 00 FF       '...'
        JSR     Z15F2                    ;0EF7: BD 15 F2       '...'
        INS                              ;0EFA: 31             '1'
        INS                              ;0EFB: 31             '1'
        LDX     #M00FE                   ;0EFC: CE 00 FE       '...'
        BRA     STRLIT                   ;0EFF: 20 0A          ' .'
;
; "STRINI" GET STRING SPACE FOR THE CREATION OF A STRING AND
; CREATES A DESCRIPTOR FOR IT IN "DSCTMP".
;
STRINI  STX     M00AD                    ;0F01: DF AD          '..'
Z0F03   BSR     GETSPA                   ;0F03: 8D 53          '.S'
Z0F05   STX     DSCTMP+1                 ;0F05: DF B1          '..'
        STAB    tmpstrlen                ;0F07: D7 AF          '..'
        RTS                              ;0F09: 39             '9'

; This entry point takes IX pointing to string value, instead of IX-1
dstrlit DEX                              ;0F0A: 09             '.'
;
; "STRLT2" TAKES THE STRING LITERAL WHOSE FIRST CHARACTER
; IS POINTED TO BY IX-1 AND BUILDS A DESCRIPTOR FOR IT.
; THE DESCRIPTOR IS INITIALLY BUILT IN "DSCTMP", BUT "PUTNEW"
; TRANSFERS IT INTO A TEMPORARY AND LEAVES A POINTER
; AT THE TEMPORARY IN FACMO&LO. THE CHARACTERS OTHER THAN
; ZERO THAT TERMINATE THE STRING SHOULD BE SET UP IN "CHARAC"
; AND "ENDCHR". IF THE TERMINATOR IS A QUOTE, THE QUOTE IS SKIPPED
; OVER. LEADING QUOTES SHOULD BE SKIPPED BEFORE JSR. ON RETURN
; THE CHARACTER AFTER THE STRING LITERAL IS POINTED TO
; BY [STRNG2].
;
; DSCTMP is temporary storage for a string descriptor,
; one byte of length and two bytes of address.
;
STRLIT  LDAA    #'"'                     ;0F0B: 86 22          '."'    ASSUME STRING ENDS ON QUOTE.
        STAA    CHARAC                   ;0F0D: 97 58          '.X'
        STAA    ENDCHR                   ;0F0F: 97 59          '.Y'
STRLIT2 INX                              ;0F11: 08             '.'
        STX     STRNG1                   ;0F12: DF BB          '..'    SAVE POINTER TO STRING.
        STX     DSCTMP+1                 ;0F14: DF B1          '..'    IN CASE NO STRCPY.
        LDAB    #$FF                     ;0F16: C6 FF          '..'    INITIALIZE CHARACTER COUNT.
STRGET  INCB                             ;0F18: 5C             '\'     find 00 terminator or char after CHARAC or ENDCHR
        LDAA    ,X                       ;0F19: A6 00          '..'    GET CHARACTER.
        BEQ     STRFI2                   ;0F1B: 27 0E          ''.'    IF ZERO.
        INX                              ;0F1D: 08             '.'
        CMPA    CHARAC                   ;0F1E: 91 58          '.X'    THIS TERMINATOR?
        BEQ     STRFIN                   ;0F20: 27 04          ''.'    YES
        CMPA    ENDCHR                   ;0F22: 91 59          '.Y'
        BNE     STRGET                   ;0F24: 26 F2          '&.'    LOOK FURTHER.
STRFIN  CMPA    #'"'                     ;0F26: 81 22          '."'
        BEQ     STRFI2                   ;0F28: 27 01          ''.'
        DEX                              ;0F2A: 09             '.'     terminator not quote; back up to remove it
STRFI2  STX     STRNG2                   ;0F2B: DF BD          '..'
        STAB    tmpstrlen                ;0F2D: D7 AF          '..'    ??? RETAIN COUNT
        LDAA    STRNG1                   ;0F2F: 96 BB          '..'
        BNE     PUTNEW                   ;0F31: 26 07          '&.'
        BSR     STRINI                   ;0F33: 8D CC          '..'
        LDX     STRNG1                   ;0F35: DE BB          '..'
        JSR     MOVSTR                   ;0F37: BD 10 61       '..a'
PUTNEW  LDX     TEMPPT                   ;0F3A: DE 61          '.a'
        CPX     #M0071                   ;0F3C: 8C 00 71       '..q'
        BNE     PUTNW1                   ;0F3F: 26 05          '&.'
        LDAB    #$1E                     ;0F41: C6 1E          '..'
ERRGO2  JMP     Z0313                    ;0F43: 7E 03 13       '~..'
PUTNW1  JSR     Z1454                    ;0F46: BD 14 54       '..T'
        LDAA    #$FF                     ;0F49: 86 FF          '..'
        STAA    M005C                    ;0F4B: 97 5C          '.\'
        STX     M0063                    ;0F4D: DF 63          '.c'
        STX     DSCTMP+1                 ;0F4F: DF B1          '..'
        INX                              ;0F51: 08             '.'
        INX                              ;0F52: 08             '.'
        INX                              ;0F53: 08             '.'
        INX                              ;0F54: 08             '.'
        STX     TEMPPT                   ;0F55: DF 61          '.a'
        RTS                              ;0F57: 39             '9'

;
; GETSPA - GET SPACE FOR CHARACTER STRING.
; MAY FORCE GARBAGE COLLECTION.
;
; # OF CHARACTERS (BYTES) IN ACCA.
; RETURNS WITH POINTER IN [Y,X]. OTHERWISE (IF CAN'T GET
; SPACE) BLOWS OFF TO "OUT OF STRING SPACE" TYPE ERROR.
; ALSO PRESERVES [ACCA] AND SETS [FRESPC]=[Y,X]=PNTR AT SPACE.
;
GETSPA  CLR     M005D                    ;0F58: 7F 00 5D       '..]'   SIGNAL NO GARBAGE COLLECTION YET.
TRYAG2  PSHB                             ;0F5B: 37             '7'     SAVE FOR LATER.
        COMB                             ;0F5C: 53             'S'
        LDAA    #$FF                     ;0F5D: 86 FF          '..'
        ADCB    M0085                    ;0F5F: D9 85          '..'
        ADCA    M0084                    ;0F61: 99 84          '..'
        CMPA    M0082                    ;0F63: 91 82          '..'
        BCS     Z0F78                    ;0F65: 25 11          '%.'
        BHI     Z0F6D                    ;0F67: 22 04          '".'
        CMPB    M0083                    ;0F69: D1 83          '..'
        BCS     Z0F78                    ;0F6B: 25 0B          '%.'
Z0F6D   STAA    M0084                    ;0F6D: 97 84          '..'
        STAB    M0085                    ;0F6F: D7 85          '..'
        LDX     M0084                    ;0F71: DE 84          '..'
        INX                              ;0F73: 08             '.'
        STX     M0086                    ;0F74: DF 86          '..'
        PULB                             ;0F76: 33             '3'
        RTS                              ;0F77: 39             '9'
Z0F78   LDAB    #$1A                     ;0F78: C6 1A          '..'
        LDAA    M005D                    ;0F7A: 96 5D          '.]'
        BNE     ERRGO2                   ;0F7C: 26 C5          '&.'
        BSR     Z0F86                    ;0F7E: 8D 06          '..'
        COM     M005D                    ;0F80: 73 00 5D       's.]'
        PULB                             ;0F83: 33             '3'
        BRA     TRYAG2                   ;0F84: 20 D5          ' .'
Z0F86   LDX     M0088                    ;0F86: DE 88          '..'
Z0F88   STX     M0084                    ;0F88: DF 84          '..'
        LDX     #START                   ;0F8A: CE 00 00       '...'
        STX     M00AB                    ;0F8D: DF AB          '..'
        LDX     M0082                    ;0F8F: DE 82          '..'
        STX     M00A9                    ;0F91: DF A9          '..'
        LDX     #M0065                   ;0F93: CE 00 65       '..e'
Z0F96   CPX     TEMPPT                   ;0F96: 9C 61          '.a'
        BEQ     Z0F9E                    ;0F98: 27 04          ''.'
        BSR     Z0FD7                    ;0F9A: 8D 3B          '.;'
        BRA     Z0F96                    ;0F9C: 20 F8          ' .'
Z0F9E   LDX     M007C                    ;0F9E: DE 7C          '.|'
Z0FA0   CPX     M007E                    ;0FA0: 9C 7E          '.~'
        BEQ     Z0FA8                    ;0FA2: 27 04          ''.'
        BSR     Z0FD1                    ;0FA4: 8D 2B          '.+'
        BRA     Z0FA0                    ;0FA6: 20 F8          ' .'
Z0FA8   STX     M00A3                    ;0FA8: DF A3          '..'
Z0FAA   LDX     M00A3                    ;0FAA: DE A3          '..'
Z0FAC   CPX     M0080                    ;0FAC: 9C 80          '..'
        BEQ     Z0FFE                    ;0FAE: 27 4E          ''N'
        LDAA    $02,X                    ;0FB0: A6 02          '..'
        LDAB    $03,X                    ;0FB2: E6 03          '..'
        ADDB    M00A4                    ;0FB4: DB A4          '..'
        ADCA    M00A3                    ;0FB6: 99 A3          '..'
        STAA    M00A3                    ;0FB8: 97 A3          '..'
        STAB    M00A4                    ;0FBA: D7 A4          '..'
        LDAA    $01,X                    ;0FBC: A6 01          '..'
        BPL     Z0FAA                    ;0FBE: 2A EA          '*.'
        LDAB    $04,X                    ;0FC0: E6 04          '..'
        CLRA                             ;0FC2: 4F             'O'
        ASLB                             ;0FC3: 58             'X'
        ADDB    #$05                     ;0FC4: CB 05          '..'
        JSR     Z0304                    ;0FC6: BD 03 04       '...'
Z0FC9   CPX     M00A3                    ;0FC9: 9C A3          '..'
        BEQ     Z0FAC                    ;0DB : 27 DF          ''.'
        BSR     Z0FD7                    ;0FCD: 8D 08          '..'
        BRA     Z0FC9                    ;0FCF: 20 F8          ' .'
Z0FD1   LDAA    $01,X                    ;0FD1: A6 01          '..'
        INX                              ;0FD3: 08             '.'
        INX                              ;0FD4: 08             '.'
        BPL     Z0FF9                    ;0FD5: 2A 22          '*"'
Z0FD7   LDAB    ,X                       ;0FD7: E6 00          '..'
        BEQ     Z0FF9                    ;0FD9: 27 1E          ''.'
        LDAA    $02,X                    ;0FDB: A6 02          '..'
        CMPA    M0084                    ;0FDD: 91 84          '..'
        BHI     Z0FF9                    ;0FDF: 22 18          '".'
        LDAB    $03,X                    ;0FE1: E6 03          '..'
        BCS     Z0FE9                    ;0FE3: 25 04          '%.'
        CMPB    M0085                    ;0FE5: D1 85          '..'
        BCC     Z0FF9                    ;0FE7: 24 10          '$.'
Z0FE9   CMPA    M00A9                    ;0FE9: 91 A9          '..'
        BCS     Z0FF9                    ;0FEB: 25 0C          '%.'
        BHI     Z0FF3                    ;0FED: 22 04          '".'
        CMPB    M00AA                    ;0FEF: D1 AA          '..'
        BLS     Z0FF9                    ;0FF1: 23 06          '#.'
Z0FF3   STX     M00AB                    ;0FF3: DF AB          '..'
        STAA    M00A9                    ;0FF5: 97 A9          '..'
        STAB    M00AA                    ;0FF7: D7 AA          '..'
Z0FF9   INX                              ;0FF9: 08             '.'
        INX                              ;0FFA: 08             '.'
        INX                              ;0FFB: 08             '.'
        INX                              ;0FFC: 08             '.'
Z0FFD   RTS                              ;0FFD: 39             '9'
Z0FFE   LDX     M00AB                    ;0FFE: DE AB          '..'
        BEQ     Z0FFD                    ;1000: 27 FB          ''.'
        CLRA                             ;1002: 4F             'O'
        LDAB    ,X                       ;1003: E6 00          '..'
        DECB                             ;1005: 5A             'Z'
        ADDB    M00AA                    ;1006: DB AA          '..'
        ADCA    M00A9                    ;1008: 99 A9          '..'
        STAA    M00A5                    ;100A: 97 A5          '..'
        STAB    M00A6                    ;100C: D7 A6          '..'
        LDX     M0084                    ;100E: DE 84          '..'
        STX     M00A3                    ;1010: DF A3          '..'
        JSR     Z02D0                    ;1012: BD 02 D0       '...'
        LDX     M00AB                    ;1015: DE AB          '..'
        LDAA    M00A7                    ;1017: 96 A7          '..'
        LDAB    M00A8                    ;1019: D6 A8          '..'
        STAA    $02,X                    ;101B: A7 02          '..'
        STAB    $03,X                    ;101D: E7 03          '..'
        LDX     M00A7                    ;101F: DE A7          '..'
        DEX                              ;1021: 09             '.'
        JMP     Z0F88                    ;1022: 7E 0F 88       '~..'
Z1025   LDAA    M00B2                    ;1025: 96 B2          '..'
        PSHA                             ;1027: 36             '6'
        LDAA    DSCTMP+1                 ;1028: 96 B1          '..'
        PSHA                             ;102A: 36             '6'
        JSR     Z0AEB                    ;102B: BD 0A EB       '...'
        JSR     Z0A0E                    ;102E: BD 0A 0E       '...'
        PULA                             ;1031: 32             '2'
        STAA    STRNG1                   ;1032: 97 BB          '..'
        PULA                             ;1034: 32             '2'
        STAA    M00BC                    ;1035: 97 BC          '..'
        LDX     STRNG1                   ;1037: DE BB          '..'
        LDAB    ,X                       ;1039: E6 00          '..'
        LDX     DSCTMP+1                 ;103B: DE B1          '..'
        ADDB    ,X                       ;103D: EB 00          '..'
        BCC     Z1046                    ;103F: 24 05          '$.'
        LDAB    #$1C                     ;1041: C6 1C          '..'
        JMP     Z0313                    ;1043: 7E 03 13       '~..'
Z1046   JSR     STRINI                   ;1046: BD 0F 01       '...'
        LDX     STRNG1                   ;1049: DE BB          '..'
        LDAB    ,X                       ;104B: E6 00          '..'
        BSR     Z105F                    ;104D: 8D 10          '..'
        LDX     M00AD                    ;104F: DE AD          '..'
        BSR     Z107F                    ;1051: 8D 2C          '.,'
        BSR     MOVSTR                   ;1053: 8D 0C          '..'
        LDX     STRNG1                   ;1055: DE BB          '..'
        BSR     Z107F                    ;1057: 8D 26          '.&'
        JSR     PUTNEW                   ;1059: BD 0F 3A       '..:'
        JMP     Z0A2D                    ;105C: 7E 0A 2D       '~.-'
Z105F   LDX     $02,X                    ;105F: EE 02          '..'
MOVSTR  TPA                              ;1061: 07             '.'
        PSHA                             ;1062: 36             '6'
        STS     M0078                    ;1063: 9F 78          '.x'
        SEI                              ;1065: 0F             '.'
        TXS                              ;1066: 35             '5'
        LDX     M0086                    ;1067: DE 86          '..'
        INCB                             ;1069: 5C             '\'
        BRA     Z1070                    ;106A: 20 04          ' .'
Z106C   PULA                             ;106C: 32             '2'
        STAA    ,X                       ;106D: A7 00          '..'
        INX                              ;106F: 08             '.'
Z1070   DECB                             ;1070: 5A             'Z'
        BNE     Z106C                    ;1071: 26 F9          '&.'
        STX     M0086                    ;1073: DF 86          '..'
        LDS     M0078                    ;1075: 9E 78          '.x'
        PULA                             ;1077: 32             '2'
        TAP                              ;1078: 06             '.'
        RTS                              ;1079: 39             '9'
Z107A   JSR     Z0A0E                    ;107A: BD 0A 0E       '...'
FREFAC  LDX     DSCTMP+1                 ;107D: DE B1          '..'
Z107F   LDAB    ,X                       ;107F: E6 00          '..'
        BSR     Z109B                    ;1081: 8D 18          '..'
        BNE     Z1098                    ;1083: 26 13          '&.'
        LDX     $06,X                    ;1085: EE 06          '..'
        DEX                              ;1087: 09             '.'
        CPX     M0084                    ;1088: 9C 84          '..'
        BNE     Z1096                    ;108A: 26 0A          '&.'
        PSHB                             ;108C: 37             '7'
        ADDB    M0085                    ;108D: DB 85          '..'
        ADCA    M0084                    ;108F: 99 84          '..'
        STAA    M0084                    ;1091: 97 84          '..'
        STAB    M0085                    ;1093: D7 85          '..'
        PULB                             ;1095: 33             '3'
Z1096   INX                              ;1096: 08             '.'
        RTS                              ;1097: 39             '9'
Z1098   LDX     $02,X                    ;1098: EE 02          '..'
        RTS                              ;109A: 39             '9'
Z109B   CPX     M0063                    ;109B: 9C 63          '.c'
        BNE     Z10A8                    ;109D: 26 09          '&.'
        STX     TEMPPT                   ;109F: DF 61          '.a'
        DEX                              ;10A1: 09             '.'
        DEX                              ;10A2: 09             '.'
        DEX                              ;10A3: 09             '.'
        DEX                              ;10A4: 09             '.'
        STX     M0063                    ;10A5: DF 63          '.c'
        CLRA                             ;10A7: 4F             'O'
Z10A8   RTS                              ;10A8: 39             '9'
        BSR     Z10AE                    ;10A9: 8D 03          '..'
Z10AB   JMP     Z0E42                    ;10AB: 7E 0E 42       '~.B'
Z10AE   BSR     Z107A                    ;10AE: 8D CA          '..'
        CLR     M005C                    ;10B0: 7F 00 5C       '..\'
        TSTB                             ;10B3: 5D             ']'
        RTS                              ;10B4: 39             '9'
        JSR     Z113E                    ;10B5: BD 11 3E       '..>'
        LDAB    #$01                     ;10B8: C6 01          '..'
        JSR     GETSPA                   ;10BA: BD 0F 58       '..X'
        LDAA    M00B2                    ;10BD: 96 B2          '..'
        JSR     Z0F05                    ;10BF: BD 0F 05       '...'
        STAA    ,X                       ;10C2: A7 00          '..'
        INS                              ;10C4: 31             '1'
        INS                              ;10C5: 31             '1'
Z10C6   JMP     PUTNEW                   ;10C6: 7E 0F 3A       '~.:'
        BSR     Z10AE                    ;10C9: 8D E3          '..'
        BEQ     Z1135                    ;10CB: 27 68          ''h'
        LDAB    ,X                       ;10CD: E6 00          '..'
        BRA     Z10AB                    ;10CF: 20 DA          ' .'
        BSR     Z1118                    ;10D1: 8D 45          '.E'
        CLRA                             ;10D3: 4F             'O'
Z10D4   CMPB    ,X                       ;10D4: E1 00          '..'
        BLS     Z10DB                    ;10D6: 23 03          '#.'
        LDAB    ,X                       ;10D8: E6 00          '..'
        CLRA                             ;10DA: 4F             'O'
Z10DB   PSHB                             ;10DB: 37             '7'
        PSHA                             ;10DC: 36             '6'
        JSR     Z0F03                    ;10DD: BD 0F 03       '...'
        LDX     M00AD                    ;10E0: DE AD          '..'
        BSR     Z107F                    ;10E2: 8D 9B          '..'
        PULB                             ;10E4: 33             '3'
        JSR     Z0303                    ;10E5: BD 03 03       '...'
        PULB                             ;10E8: 33             '3'
        JSR     MOVSTR                   ;10E9: BD 10 61       '..a'
        BRA     Z10C6                    ;10EC: 20 D8          ' .'
        BSR     Z1118                    ;10EE: 8D 28          '.('
        LDAA    ,X                       ;10F0: A6 00          '..'
        SBA                              ;10F2: 10             '.'
        BRA     Z10D4                    ;10F3: 20 DF          ' .'
        LDAB    #$FF                     ;10F5: C6 FF          '..'
        STAB    M00B2                    ;10F7: D7 B2          '..'
        BSR     Z1147                    ;10F9: 8D 4C          '.L'
        CMPA    #$29                     ;10FB: 81 29          '.)'
        BEQ     Z1104                    ;10FD: 27 05          ''.'
        JSR     Z0B3C+1                  ;10FF: BD 0B 3D       '..='
        BSR     Z113B                    ;1102: 8D 37          '.7'
Z1104   BSR     Z1118                    ;1104: 8D 12          '..'
        CLRB                             ;1106: 5F             '_'
        DECA                             ;1107: 4A             'J'
        CMPA    ,X                       ;1108: A1 00          '..'
        BCC     Z10DB                    ;110A: 24 CF          '$.'
        TAB                              ;110C: 16             '.'
        SUBB    ,X                       ;110D: E0 00          '..'
        NEGB                             ;110F: 50             'P'
        CMPB    M00B2                    ;1110: D1 B2          '..'
        BLS     Z10DB                    ;1112: 23 C7          '#.'
        LDAB    M00B2                    ;1114: D6 B2          '..'
        BRA     Z10DB                    ;1116: 20 C3          ' .'
Z1118   JSR     Z0B37                    ;1118: BD 0B 37       '..7'
        PULB                             ;111B: 33             '3'
        STAB    M0078                    ;111C: D7 78          '.x'
        PULB                             ;111E: 33             '3'
        STAB    M0079                    ;111F: D7 79          '.y'
        INS                              ;1121: 31             '1'
        INS                              ;1122: 31             '1'
        PULA                             ;1123: 32             '2'
        PULB                             ;1124: 33             '3'
        STAB    M00AD                    ;1125: D7 AD          '..'
        PULB                             ;1127: 33             '3'
        STAB    M00AE                    ;1128: D7 AE          '..'
        LDX     M00AD                    ;112A: DE AD          '..'
        LDAB    M0079                    ;112C: D6 79          '.y'
        PSHB                             ;112E: 37             '7'
        LDAB    M0078                    ;112F: D6 78          '.x'
        PSHB                             ;1131: 37             '7'
        TAB                              ;1132: 16             '.'
        BNE     Z1170                    ;1133: 26 3B          '&;'
Z1135   JMP     Z0D4B+1                  ;1135: 7E 0D 4C       '~.L'
;Z1138  JSR     Z00BF                    ;1138: BD 00 BF       '...'
Z1138   DB      $BD,$00,$BF
Z113B   JSR     Z0A0B                    ;113B: BD 0A 0B       '...'
Z113E   JSR     Z0CD4                    ;113E: BD 0C D4       '...'
        LDAA    DSCTMP+1                 ;1141: 96 B1          '..'
        BNE     Z1135                    ;1143: 26 F0          '&.'
        LDAB    M00B2                    ;1145: D6 B2          '..'
Z1147   JMP     CHRGOT                   ;1147: 7E 00 C7       '~..'
        JSR     Z10AE                    ;114A: BD 10 AE       '...'
        BNE     Z1152                    ;114D: 26 03          '&.'
        JMP     Z122F                    ;114F: 7E 12 2F       '~./'
Z1152   JSR     Z0303                    ;1152: BD 03 03       '...'
        LDAA    ,X                       ;1155: A6 00          '..'
        PSHA                             ;1157: 36             '6'
        CLR     ,X                       ;1158: 6F 00          'o.'
        LDX     $00C8                    ;115A: DE C8          '..'
        STX     STRNG2                   ;115C: DF BD          '..'
        LDX     M0071                    ;115E: DE 71          '.q'
        STX     $00C8                    ;1160: DF C8          '..'
        BSR     Z1147                    ;1162: 8D E3          '..'
        JSR     Z1526                    ;1164: BD 15 26       '..&'
        PULA                             ;1167: 32             '2'
        LDX     M0073                    ;1168: DE 73          '.s'
        STAA    ,X                       ;116A: A7 00          '..'
Z116C   LDX     STRNG2                   ;116C: DE BD          '..'
        STX     $00C8                    ;116E: DF C8          '..'
Z1170   RTS                              ;1170: 39             '9'
Z1171   JSR     Z0A0B                    ;1171: BD 0A 0B       '...'
        BSR     Z117D                    ;1174: 8D 07          '..'
        STX     M008E                    ;1176: DF 8E          '..'
Z1178   JSR     Z0B3C+1                  ;1178: BD 0B 3D       '..='
        BRA     Z113B                    ;117B: 20 BE          ' .'
Z117D   LDAA    M00B3                    ;117D: 96 B3          '..'
        BMI     Z1135                    ;117F: 2B B4          '+.'
        LDAA    tmpstrlen                ;1181: 96 AF          '..'
        CMPA    #$90                     ;1183: 81 90          '..'
        BHI     Z1135                    ;1185: 22 AE          '".'
        JSR     Z14DA                    ;1187: BD 14 DA       '...'
        LDX     DSCTMP+1                 ;118A: DE B1          '..'
        RTS                              ;118C: 39             '9'
        BSR     Z117D                    ;118D: 8D EE          '..'
        LDAB    ,X                       ;118F: E6 00          '..'
        JMP     Z0E42                    ;1191: 7E 0E 42       '~.B'
        BSR     Z1171                    ;1194: 8D DB          '..'
        LDX     M008E                    ;1196: DE 8E          '..'
        STAB    ,X                       ;1198: E7 00          '..'
        RTS                              ;119A: 39             '9'
        BSR     Z1171                    ;119B: 8D D4          '..'
        STAB    M009E                    ;119D: D7 9E          '..'
        CLRB                             ;119F: 5F             '_'
        JSR     CHRGOT                   ;11A0: BD 00 C7       '...'
        BEQ     Z11A7                    ;11A3: 27 02          ''.'
        BSR     Z1178                    ;11A5: 8D D1          '..'
Z11A7   STAB    M009F                    ;11A7: D7 9F          '..'
        LDX     M008E                    ;11A9: DE 8E          '..'
Z11AB   LDAA    ,X                       ;11AB: A6 00          '..'
        EORA    M009F                    ;11AD: 98 9F          '..'
        ANDA    M009E                    ;11AF: 94 9E          '..'
        BEQ     Z11AB                    ;11B1: 27 F8          ''.'
        RTS                              ;11B3: 39             '9'
Z11B4   LDX     #M16E6                   ;11B4: CE 16 E6       '...'
        BRA     Z11C4                    ;11B7: 20 0B          ' .'
Z11B9   JSR     Z1355                    ;11B9: BD 13 55       '..U'
Z11BC   COM     M00B3                    ;11BC: 73 00 B3       's..'
        COM     STRNG1                   ;11BF: 73 00 BB       's..'
        BRA     Z11C7                    ;11C2: 20 03          ' .'
Z11C4   JSR     Z1355                    ;11C4: BD 13 55       '..U'
Z11C7   TSTB                             ;11C7: 5D             ']'
        BNE     Z11CD                    ;11C8: 26 03          '&.'
        JMP     Z1469                    ;11CA: 7E 14 69       '~.i'
Z11CD   LDX     #M00B6                   ;11CD: CE 00 B6       '...'
Z11D0   TAB                              ;11D0: 16             '.'
        BEQ     Z1234                    ;11D1: 27 61          ''a'
        SUBB    tmpstrlen                ;11D3: D0 AF          '..'
        BEQ     Z1235                    ;11D5: 27 5E          ''^'
        BMI     Z11E3                    ;11D7: 2B 0A          '+.'
        STAA    tmpstrlen                ;11D9: 97 AF          '..'
        LDAA    M00BA                    ;11DB: 96 BA          '..'
        STAA    M00B3                    ;11DD: 97 B3          '..'
        LDX     #tmpstrlen               ;11DF: CE 00 AF       '...'
        NEGB                             ;11E2: 50             'P'
Z11E3   CMPB    #$F8                     ;11E3: C1 F8          '..'
        BLE     Z1235                    ;11E5: 2F 4E          '/N'
        CLRA                             ;11E7: 4F             'O'
        LSR     $01,X                    ;11E8: 64 01          'd.'
        JSR     Z12A8                    ;11EA: BD 12 A8       '...'
Z11ED   LDAB    STRNG1                   ;11ED: D6 BB          '..'
        BPL     Z11FA                    ;11EF: 2A 09          '*.'
        COM     $01,X                    ;11F1: 63 01          'c.'
        COM     $02,X                    ;11F3: 63 02          'c.'
        COM     $03,X                    ;11F5: 63 03          'c.'
        COMA                             ;11F7: 43             'C'
        ADCA    #$00                     ;11F8: 89 00          '..'
Z11FA   STAA    M00BC                    ;11FA: 97 BC          '..'
        LDAA    M00B2                    ;11FC: 96 B2          '..'
        ADCA    M00B9                    ;11FE: 99 B9          '..'
        STAA    M00B2                    ;1200: 97 B2          '..'
        LDAA    DSCTMP+1                 ;1202: 96 B1          '..'
        ADCA    M00B8                    ;1204: 99 B8          '..'
        STAA    DSCTMP+1                 ;1206: 97 B1          '..'
        LDAA    DSCTMP                   ;1208: 96 B0          '..'
        ADCA    M00B7                    ;120A: 99 B7          '..'
        STAA    DSCTMP                   ;120C: 97 B0          '..'
        TBA                              ;120E: 17             '.'
        BPL     Z1250+1                  ;120F: 2A 40          '*@'
Z1211   BCS     Z1215                    ;1211: 25 02          '%.'
        BSR     Z126D                    ;1213: 8D 58          '.X'
Z1215   CLRB                             ;1215: 5F             '_'
Z1216   LDAA    DSCTMP                   ;1216: 96 B0          '..'
        BNE     Z1247                    ;1218: 26 2D          '&-'
        LDAA    DSCTMP+1                 ;121A: 96 B1          '..'
        STAA    DSCTMP                   ;121C: 97 B0          '..'
        LDAA    M00B2                    ;121E: 96 B2          '..'
        STAA    DSCTMP+1                 ;1220: 97 B1          '..'
        LDAA    M00BC                    ;1222: 96 BC          '..'
        STAA    M00B2                    ;1224: 97 B2          '..'
        CLR     M00BC                    ;1226: 7F 00 BC       '...'
        ADDB    #$08                     ;1229: CB 08          '..'
        CMPB    #$20                     ;122B: C1 20          '. '
        BLT     Z1216                    ;122D: 2D E7          '-.'
Z122F   CLRA                             ;122F: 4F             'O'
Z1230   STAA    tmpstrlen                ;1230: 97 AF          '..'
Z1232   STAA    M00B3                    ;1232: 97 B3          '..'
Z1234   RTS                              ;1234: 39             '9'
Z1235   BSR     Z129C                    ;1235: 8D 65          '.e'
        CLC                              ;1237: 0C             '.'
        BRA     Z11ED                    ;1238: 20 B3          ' .'
Z123A   INCB                             ;123A: 5C             '\'
        ASL     M00BC                    ;123B: 78 00 BC       'x..'
        ROL     M00B2                    ;123E: 79 00 B2       'y..'
        ROL     DSCTMP+1                 ;1241: 79 00 B1       'y..'
        ROL     DSCTMP                   ;1244: 79 00 B0       'y..'
Z1247   BPL     Z123A                    ;1247: 2A F1          '*.'
        LDAA    tmpstrlen                ;1249: 96 AF          '..'
        SBA                              ;124B: 10             '.'
        STAA    tmpstrlen                ;124C: 97 AF          '..'
        BLS     Z122F                    ;124E: 23 DF          '#.'
Z1250   CPX     #$2505                   ;1250: 8C 25 05       '.%.'
        ASL     M00BC                    ;1253: 78 00 BC       'x..'
        BRA     Z1266                    ;1256: 20 0E          ' .'
Z1258   INC     tmpstrlen                ;1258: 7C 00 AF       '|..'
        BEQ     Z1284                    ;125B: 27 27          ''''
        ROR     DSCTMP                   ;125D: 76 00 B0       'v..'
        ROR     DSCTMP+1                 ;1260: 76 00 B1       'v..'
        ROR     M00B2                    ;1263: 76 00 B2       'v..'
Z1266   BCC     Z126C                    ;1266: 24 04          '$.'
        BSR     Z1279                    ;1268: 8D 0F          '..'
        BEQ     Z1258                    ;126A: 27 EC          ''.'
Z126C   RTS                              ;126C: 39             '9'
Z126D   COM     M00B3                    ;126D: 73 00 B3       's..'
Z1270   COM     DSCTMP                   ;1270: 73 00 B0       's..'
        COM     DSCTMP+1                 ;1273: 73 00 B1       's..'
        COM     M00B2                    ;1276: 73 00 B2       's..'
Z1279   LDX     DSCTMP+1                 ;1279: DE B1          '..'
        INX                              ;127B: 08             '.'
        STX     DSCTMP+1                 ;127C: DF B1          '..'
        BNE     Z1283                    ;127E: 26 03          '&.'
        INC     DSCTMP                   ;1280: 7C 00 B0       '|..'
Z1283   RTS                              ;1283: 39             '9'
Z1284   LDAB    #$0A                     ;1284: C6 0A          '..'
        JMP     Z0313                    ;1286: 7E 03 13       '~..'
Z1289   LDX     #M0074                   ;1289: CE 00 74       '..t'
Z128C   LDAA    $03,X                    ;128C: A6 03          '..'
        STAA    M00BC                    ;128E: 97 BC          '..'
        LDAA    $02,X                    ;1290: A6 02          '..'
        STAA    $03,X                    ;1292: A7 03          '..'
        LDAA    $01,X                    ;1294: A6 01          '..'
        STAA    $02,X                    ;1296: A7 02          '..'
        LDAA    M00B5                    ;1298: 96 B5          '..'
        STAA    $01,X                    ;129A: A7 01          '..'
Z129C   ADDB    #$08                     ;129C: CB 08          '..'
        BLE     Z128C                    ;129E: 2F EC          '/.'
        LDAA    M00BC                    ;12A0: 96 BC          '..'
        SUBB    #$08                     ;12A2: C0 08          '..'
        BEQ     Z12B0                    ;12A4: 27 0A          ''.'
Z12A6   ASR     $01,X                    ;12A6: 67 01          'g.'
Z12A8   ROR     $02,X                    ;12A8: 66 02          'f.'
        ROR     $03,X                    ;12AA: 66 03          'f.'
        RORA                             ;12AC: 46             'F'
        INCB                             ;12AD: 5C             '\'
        BNE     Z12A6                    ;12AE: 26 F6          '&.'
Z12B0   RTS                              ;12B0: 39             '9'
M12B1   CMPA    #$00                     ;12B1: 81 00          '..'
        DB      $00                      ;12B3: 00             '.'
        DB      $00                      ;12B4: 00             '.'
M12B5   DB      $02                      ;12B5: 02             '.'
        SUBA    #$19                     ;12B6: 80 19          '..'
        RORB                             ;12B8: 56             'V'
        ORAA    $80,X                    ;12B9: AA 80          '..'
        ROR     $22F1                    ;12BB: 76 22 F1       'v".'
        SBCA    #$38                     ;12BE: 82 38          '.8'
        ORAA    $45,X                    ;12C0: AA 45          '.E'
M12C2   SUBA    #$35                     ;12C2: 80 35          '.5'
        DB      $04                      ;12C4: 04             '.'
        DB      $F3                      ;12C5: F3             '.'
M12C6   CMPA    #$35                     ;12C6: 81 35          '.5'
        DB      $04                      ;12C8: 04             '.'
        DB      $F3                      ;12C9: F3             '.'
M12CA   SUBA    #$80                     ;12CA: 80 80          '..'
        DB      $00                      ;12CC: 00             '.'
        DB      $00                      ;12CD: 00             '.'
M12CE   SUBA    #$31                     ;12CE: 80 31          '.1'
        DB      $72                      ;12D0: 72             'r'
        DB      $18                      ;12D1: 18             '.'
Z12D2   JSR     Z1483                    ;12D2: BD 14 83       '...'
        BGT     Z12DA                    ;12D5: 2E 03          '..'
        JMP     Z0D4B+1                  ;12D7: 7E 0D 4C       '~.L'
Z12DA   LDX     #M12C2                   ;12DA: CE 12 C2       '...'
        LDAA    tmpstrlen                ;12DD: 96 AF          '..'
        SUBA    #$80                     ;12DF: 80 80          '..'
        PSHA                             ;12E1: 36             '6'
        LDAA    #$80                     ;12E2: 86 80          '..'
        STAA    tmpstrlen                ;12E4: 97 AF          '..'
        JSR     Z11C4                    ;12E6: BD 11 C4       '...'
        LDX     #M12C6                   ;12E9: CE 12 C6       '...'
        JSR     Z13BB+1                  ;12EC: BD 13 BC       '...'
        LDX     #M12B1                   ;12EF: CE 12 B1       '...'
        JSR     Z11B9                    ;12F2: BD 11 B9       '...'
        LDX     #M12B5                   ;12F5: CE 12 B5       '...'
        JSR     Z17A1                    ;12F8: BD 17 A1       '...'
        LDX     #M12CA                   ;12FB: CE 12 CA       '...'
        JSR     Z11C4                    ;12FE: BD 11 C4       '...'
        PULB                             ;1301: 33             '3'
        JSR     Z15B1                    ;1302: BD 15 B1       '...'
Z1305   LDX     #M12CE                   ;1305: CE 12 CE       '...'
Z1308   BSR     Z1355                    ;1308: 8D 4B          '.K'
        BEQ     Z1354                    ;130A: 27 48          ''H'
        BSR     Z1371                    ;130C: 8D 63          '.c'
        LDAA    #$00                     ;130E: 86 00          '..'
        STAA    M0075                    ;1310: 97 75          '.u'
        STAA    M0076                    ;1312: 97 76          '.v'
        STAA    M0077                    ;1314: 97 77          '.w'
        LDAB    M00B2                    ;1316: D6 B2          '..'
        BSR     Z1328                    ;1318: 8D 0E          '..'
        LDAB    DSCTMP+1                 ;131A: D6 B1          '..'
        BSR     Z1328                    ;131C: 8D 0A          '..'
        LDAB    DSCTMP                   ;131E: D6 B0          '..'
        BSR     Z132D                    ;1320: 8D 0B          '..'
        JSR     Z142F                    ;1322: BD 14 2F       '../'
        JMP     Z1215                    ;1325: 7E 12 15       '~..'
Z1328   BNE     Z132D                    ;1328: 26 03          '&.'
        JMP     Z1289                    ;132A: 7E 12 89       '~..'
Z132D   SEC                              ;132D: 0D             '.'
Z132E   LDAA    M0075                    ;132E: 96 75          '.u'
        RORB                             ;1330: 56             'V'
        BEQ     Z1354                    ;1331: 27 21          ''!'
        BCC     Z1345                    ;1333: 24 10          '$.'
        LDAA    M0077                    ;1335: 96 77          '.w'
        ADDA    M00B9                    ;1337: 9B B9          '..'
        STAA    M0077                    ;1339: 97 77          '.w'
        LDAA    M0076                    ;133B: 96 76          '.v'
        ADCA    M00B8                    ;133D: 99 B8          '..'
        STAA    M0076                    ;133F: 97 76          '.v'
        LDAA    M0075                    ;1341: 96 75          '.u'
        ADCA    M00B7                    ;1343: 99 B7          '..'
Z1345   RORA                             ;1345: 46             'F'
        STAA    M0075                    ;1346: 97 75          '.u'
        ROR     M0076                    ;1348: 76 00 76       'v.v'
        ROR     M0077                    ;134B: 76 00 77       'v.w'
        ROR     M00BC                    ;134E: 76 00 BC       'v..'
        CLC                              ;1351: 0C             '.'
        BRA     Z132E                    ;1352: 20 DA          ' .'
Z1354   RTS                              ;1354: 39             '9'
Z1355   LDAA    $01,X                    ;1355: A6 01          '..'
        STAA    M00BA                    ;1357: 97 BA          '..'
        TAB                              ;1359: 16             '.'
        ORAA    #$80                     ;135A: 8A 80          '..'
        STAA    M00B7                    ;135C: 97 B7          '..'
        EORB    M00B3                    ;135E: D8 B3          '..'
        STAB    STRNG1                   ;1360: D7 BB          '..'
        LDAA    $02,X                    ;1362: A6 02          '..'
        STAA    M00B8                    ;1364: 97 B8          '..'
        LDAA    $03,X                    ;1366: A6 03          '..'
        STAA    M00B9                    ;1368: 97 B9          '..'
        LDAA    ,X                       ;136A: A6 00          '..'
        STAA    M00B6                    ;136C: 97 B6          '..'
        LDAB    tmpstrlen                ;136E: D6 AF          '..'
        RTS                              ;1370: 39             '9'
Z1371   TSTA                             ;1371: 4D             'M'
        BEQ     Z138D                    ;1372: 27 19          ''.'
        ADDA    tmpstrlen                ;1374: 9B AF          '..'
        RORA                             ;1376: 46             'F'
        ROLA                             ;1377: 49             'I'
        BVC     Z138D                    ;1378: 28 13          '(.'
        ADDA    #$80                     ;137A: 8B 80          '..'
        STAA    tmpstrlen                ;137C: 97 AF          '..'
        BNE     Z1383                    ;137E: 26 03          '&.'
        JMP     Z1232                    ;1380: 7E 12 32       '~.2'
Z1383   LDAA    STRNG1                   ;1383: 96 BB          '..'
        STAA    M00B3                    ;1385: 97 B3          '..'
        RTS                              ;1387: 39             '9'
Z1388   LDAA    M00B3                    ;1388: 96 B3          '..'
        COMA                             ;138A: 43             'C'
        BRA     Z138F                    ;138B: 20 02          ' .'
Z138D   PULA                             ;138D: 32             '2'
        PULA                             ;138E: 32             '2'
Z138F   BMI     Z1394                    ;138F: 2B 03          '+.'
        JMP     Z122F                    ;1391: 7E 12 2F       '~./'
Z1394   JMP     Z1284                    ;1394: 7E 12 84       '~..'
Z1397   JSR     Z1476                    ;1397: BD 14 76       '..v'
        BEQ     Z13AB                    ;139A: 27 0F          ''.'
        ADDA    #$02                     ;139C: 8B 02          '..'
        BCS     Z1394                    ;139E: 25 F4          '%.'
        CLR     STRNG1                   ;13A0: 7F 00 BB       '...'
        JSR     Z11D0                    ;13A3: BD 11 D0       '...'
        INC     tmpstrlen                ;13A6: 7C 00 AF       '|..'
        BEQ     Z1394                    ;13A9: 27 E9          ''.'
Z13AB   RTS                              ;13AB: 39             '9'
M13AC   ANDA    #$20                     ;13AC: 84 20          '. '
        DB      $00                      ;13AE: 00             '.'
        DB      $00                      ;13AF: 00             '.'
Z13B0   JSR     Z1476                    ;13B0: BD 14 76       '..v'
        LDX     #M13AC                   ;13B3: CE 13 AC       '...'
        CLRB                             ;13B6: 5F             '_'
Z13B7   STAB    STRNG1                   ;13B7: D7 BB          '..'
        BSR     Z1438                    ;13B9: 8D 7D          '.}'
Z13BB   CPX     #$8D97                   ;13BB: 8C 8D 97       '...'
        BEQ     Z142A                    ;13BE: 27 6A          ''j'
        NEG     tmpstrlen                ;13C0: 70 00 AF       'p..'
        BSR     Z1371                    ;13C3: 8D AC          '..'
        INC     tmpstrlen                ;13C5: 7C 00 AF       '|..'
        BEQ     Z1394                    ;13C8: 27 CA          ''.'
        LDX     #M0075                   ;13CA: CE 00 75       '..u'
        LDAB    #$03                     ;13CD: C6 03          '..'
        STAB    M005A                    ;13CF: D7 5A          '.Z'
        LDAB    #$01                     ;13D1: C6 01          '..'
Z13D3   LDAA    DSCTMP                   ;13D3: 96 B0          '..'
        CMPA    M00B7                    ;13D5: 91 B7          '..'
        BNE     Z13E6                    ;13D7: 26 0D          '&.'
        LDAA    DSCTMP+1                 ;13D9: 96 B1          '..'
        CMPA    M00B8                    ;13DB: 91 B8          '..'
        BNE     Z13E6                    ;13DD: 26 07          '&.'
        LDAA    M00B2                    ;13DF: 96 B2          '..'
        CMPA    M00B9                    ;13E1: 91 B9          '..'
        BNE     Z13E6                    ;13E3: 26 01          '&.'
        SEC                              ;13E5: 0D             '.'
Z13E6   TPA                              ;13E6: 07             '.'
        ROLB                             ;13E7: 59             'Y'
        BCC     Z13F6                    ;13E8: 24 0C          '$.'
        STAB    ,X                       ;13EA: E7 00          '..'
        INX                              ;13EC: 08             '.'
        DEC     M005A                    ;13ED: 7A 00 5A       'z.Z'
        BMI     Z1420                    ;13F0: 2B 2E          '+.'
        BEQ     Z141C                    ;13F2: 27 28          ''('
        LDAB    #$01                     ;13F4: C6 01          '..'
Z13F6   TAP                              ;13F6: 06             '.'
        BCS     Z1408                    ;13F7: 25 0F          '%.'
Z13F9   ASL     M00B9                    ;13F9: 78 00 B9       'x..'
        ROL     M00B8                    ;13FC: 79 00 B8       'y..'
        ROL     M00B7                    ;13FF: 79 00 B7       'y..'
        BCS     Z13E6                    ;1402: 25 E2          '%.'
        BMI     Z13D3                    ;1404: 2B CD          '+.'
        BRA     Z13E6                    ;1406: 20 DE          ' .'
Z1408   LDAA    M00B9                    ;1408: 96 B9          '..'
        SUBA    M00B2                    ;140A: 90 B2          '..'
        STAA    M00B9                    ;140C: 97 B9          '..'
        LDAA    M00B8                    ;140E: 96 B8          '..'
        SBCA    DSCTMP+1                 ;1410: 92 B1          '..'
        STAA    M00B8                    ;1412: 97 B8          '..'
        LDAA    M00B7                    ;1414: 96 B7          '..'
        SBCA    DSCTMP                   ;1416: 92 B0          '..'
        STAA    M00B7                    ;1418: 97 B7          '..'
        BRA     Z13F9                    ;141A: 20 DD          ' .'
Z141C   LDAB    #$40                     ;141C: C6 40          '.@'
        BRA     Z13F6                    ;141E: 20 D6          ' .'
Z1420   RORB                             ;1420: 56             'V'
        RORB                             ;1421: 56             'V'
        RORB                             ;1422: 56             'V'
        STAB    M00BC                    ;1423: D7 BC          '..'
        BSR     Z142F                    ;1425: 8D 08          '..'
        JMP     Z1215                    ;1427: 7E 12 15       '~..'
Z142A   LDAB    #$14                     ;142A: C6 14          '..'
        JMP     Z0313                    ;142C: 7E 03 13       '~..'
Z142F   LDX     M0075                    ;142F: DE 75          '.u'
        STX     DSCTMP                   ;1431: DF B0          '..'
        LDAA    M0077                    ;1433: 96 77          '.w'
        STAA    M00B2                    ;1435: 97 B2          '..'
        RTS                              ;1437: 39             '9'
Z1438   LDAB    $01,X                    ;1438: E6 01          '..'
        STAB    M00B3                    ;143A: D7 B3          '..'
        ORAB    #$80                     ;143C: CA 80          '..'
        STAB    DSCTMP                   ;143E: D7 B0          '..'
        LDAB    ,X                       ;1440: E6 00          '..'
        LDX     $02,X                    ;1442: EE 02          '..'
        STX     DSCTMP+1                 ;1444: DF B1          '..'
        STAB    tmpstrlen                ;1446: D7 AF          '..'
        RTS                              ;1448: 39             '9'
Z1449   LDX     #M00A7                   ;1449: CE 00 A7       '...'
        BRA     Z1454                    ;144C: 20 06          ' .'
Z144E   LDX     #M00A3                   ;144E: CE 00 A3       '...'
Z1451   CPX     #$DE9E                   ;1451: 8C DE 9E       '...'
Z1454   LDAA    tmpstrlen                ;1454: 96 AF          '..'
        STAA    ,X                       ;1456: A7 00          '..'
        LDAA    M00B3                    ;1458: 96 B3          '..'
        ORAA    #$7F                     ;145A: 8A 7F          '..'
        ANDA    DSCTMP                   ;145C: 94 B0          '..'
        STAA    $01,X                    ;145E: A7 01          '..'
        LDAA    DSCTMP+1                 ;1460: 96 B1          '..'
        STAA    $02,X                    ;1462: A7 02          '..'
        LDAA    M00B2                    ;1464: 96 B2          '..'
        STAA    $03,X                    ;1466: A7 03          '..'
        RTS                              ;1468: 39             '9'
Z1469   LDAA    M00BA                    ;1469: 96 BA          '..'
Z146B   STAA    M00B3                    ;146B: 97 B3          '..'
        LDX     M00B6                    ;146D: DE B6          '..'
        STX     tmpstrlen                ;146F: DF AF          '..'
        LDX     M00B8                    ;1471: DE B8          '..'
        STX     DSCTMP+1                 ;1473: DF B1          '..'
        RTS                              ;1475: 39             '9'
Z1476   LDX     DSCTMP                   ;1476: DE B0          '..'
        STX     M00B7                    ;1478: DF B7          '..'
        LDX     M00B2                    ;147A: DE B2          '..'
        STX     M00B9                    ;147C: DF B9          '..'
        LDAA    tmpstrlen                ;147E: 96 AF          '..'
        STAA    M00B6                    ;1480: 97 B6          '..'
        RTS                              ;1482: 39             '9'
Z1483   LDAB    tmpstrlen                ;1483: D6 AF          '..'
        BEQ     Z148F                    ;1485: 27 08          ''.'
Z1487   LDAB    M00B3                    ;1487: D6 B3          '..'
Z1489   ROLB                             ;1489: 59             'Y'
        LDAB    #$FF                     ;148A: C6 FF          '..'
        BCS     Z148F                    ;148C: 25 01          '%.'
        NEGB                             ;148E: 50             'P'
Z148F   RTS                              ;148F: 39             '9'
        BSR     Z1483                    ;1490: 8D F1          '..'
Z1492   STAB    DSCTMP                   ;1492: D7 B0          '..'
        CLR     DSCTMP+1                 ;1494: 7F 00 B1       '...'
        LDAB    #$88                     ;1497: C6 88          '..'
Z1499   LDAA    DSCTMP                   ;1499: 96 B0          '..'
        SUBA    #$80                     ;149B: 80 80          '..'
Z149D   STAB    tmpstrlen                ;149D: D7 AF          '..'
        LDAA    #$00                     ;149F: 86 00          '..'
        STAA    M00B2                    ;14A1: 97 B2          '..'
        STAA    M00BC                    ;14A3: 97 BC          '..'
        STAA    M00B3                    ;14A5: 97 B3          '..'
        JMP     Z1211                    ;14A7: 7E 12 11       '~..'
        CLR     M00B3                    ;14AA: 7F 00 B3       '...'
        RTS                              ;14AD: 39             '9'
Z14AE   LDAB    ,X                       ;14AE: E6 00          '..'
        BEQ     Z1483                    ;14B0: 27 D1          ''.'
        LDAB    $01,X                    ;14B2: E6 01          '..'
        EORB    M00B3                    ;14B4: D8 B3          '..'
        BMI     Z1487                    ;14B6: 2B CF          '+.'
Z14B8   LDAB    tmpstrlen                ;14B8: D6 AF          '..'
        CMPB    ,X                       ;14BA: E1 00          '..'
        BNE     Z14D5                    ;14BC: 26 17          '&.'
        LDAB    $01,X                    ;14BE: E6 01          '..'
        ORAB    #$7F                     ;14C0: CA 7F          '..'
        ANDB    DSCTMP                   ;14C2: D4 B0          '..'
        CMPB    $01,X                    ;14C4: E1 01          '..'
        BNE     Z14D5                    ;14C6: 26 0D          '&.'
        LDAB    DSCTMP+1                 ;14C8: D6 B1          '..'
        CMPB    $02,X                    ;14CA: E1 02          '..'
        BNE     Z14D5                    ;14CC: 26 07          '&.'
        LDAB    M00B2                    ;14CE: D6 B2          '..'
        SUBB    $03,X                    ;14D0: E0 03          '..'
        BNE     Z14D5                    ;14D2: 26 01          '&.'
        RTS                              ;14D4: 39             '9'
Z14D5   RORB                             ;14D5: 56             'V'
        EORB    M00B3                    ;14D6: D8 B3          '..'
        BRA     Z1489                    ;14D8: 20 AF          ' .'
Z14DA   LDAB    tmpstrlen                ;14DA: D6 AF          '..'
        BEQ     Z151F                    ;14DC: 27 41          ''A'
        SUBB    #$98                     ;14DE: C0 98          '..'
        LDAA    M00B3                    ;14E0: 96 B3          '..'
        BPL     Z14EA                    ;14E2: 2A 06          '*.'
        COM     M00B5                    ;14E4: 73 00 B5       's..'
        JSR     Z1270                    ;14E7: BD 12 70       '..p'
Z14EA   LDX     #tmpstrlen               ;14EA: CE 00 AF       '...'
        CMPB    #$F8                     ;14ED: C1 F8          '..'
        BGT     Z14F8                    ;14EF: 2E 07          '..'
        JSR     Z129C                    ;14F1: BD 12 9C       '...'
        CLR     M00B5                    ;14F4: 7F 00 B5       '...'
        RTS                              ;14F7: 39             '9'
Z14F8   CLR     M00B5                    ;14F8: 7F 00 B5       '...'
        LDAA    M00B3                    ;14FB: 96 B3          '..'
        ROLA                             ;14FD: 49             'I'
        ROR     DSCTMP                   ;14FE: 76 00 B0       'v..'
        JMP     Z12A8                    ;1501: 7E 12 A8       '~..'
Z1504   LDAB    tmpstrlen                ;1504: D6 AF          '..'
        CMPB    #$98                     ;1506: C1 98          '..'
        BCC     Z1525                    ;1508: 24 1B          '$.'
        BSR     Z14DA                    ;150A: 8D CE          '..'
        STAB    M00BC                    ;150C: D7 BC          '..'
        LDAA    M00B3                    ;150E: 96 B3          '..'
        STAB    M00B3                    ;1510: D7 B3          '..'
        SUBA    #$80                     ;1512: 80 80          '..'
        LDAA    #$98                     ;1514: 86 98          '..'
        STAA    tmpstrlen                ;1516: 97 AF          '..'
        LDAA    M00B2                    ;1518: 96 B2          '..'
        STAA    CHARAC                   ;151A: 97 58          '.X'
        JMP     Z1211                    ;151C: 7E 12 11       '~..'
Z151F   STAB    DSCTMP                   ;151F: D7 B0          '..'
        STAB    DSCTMP+1                 ;1521: D7 B1          '..'
        STAB    M00B2                    ;1523: D7 B2          '..'
Z1525   RTS                              ;1525: 39             '9'
Z1526   LDX     #START                   ;1526: CE 00 00       '...'
        STX     M00B3                    ;1529: DF B3          '..'
        STX     tmpstrlen                ;152B: DF AF          '..'
        STX     DSCTMP+1                 ;152D: DF B1          '..'
        STX     M00A9                    ;152F: DF A9          '..'
        STX     M00A7                    ;1531: DF A7          '..'
        BCS     Z15A0                    ;1533: 25 6B          '%k'
        CMPA    #$2D                     ;1535: 81 2D          '.-'
        BNE     Z153E                    ;1537: 26 05          '&.'
        COM     M00B4                    ;1539: 73 00 B4       's..'
        BRA     Z1542                    ;153C: 20 04          ' .'
Z153E   CMPA    #$2B                     ;153E: 81 2B          '.+'
        BNE     Z1547                    ;1540: 26 05          '&.'
;Z1542  JSR     Z00BF                    ;1542: BD 00 BF       '...'
Z1542   DB      $BD,$00,$BF
        BCS     Z15A0                    ;1545: 25 59          '%Y'
Z1547   CMPA    #$2E                     ;1547: 81 2E          '..'
        BEQ     Z1578                    ;1549: 27 2D          ''-'
        CMPA    #$45                     ;154B: 81 45          '.E'
        BNE     Z157D                    ;154D: 26 2E          '&.'
;       JSR     Z00BF                    ;154F: BD 00 BF       '...'
        DB      $BD,$00,$BF
        BCS     Z15BD                    ;1552: 25 69          '%i'
        CMPA    #$A2                     ;1554: 81 A2          '..'
        BEQ     Z1566                    ;1556: 27 0E          ''.'
        CMPA    #$2D                     ;1558: 81 2D          '.-'
        BEQ     Z1566                    ;155A: 27 0A          ''.'
        CMPA    #$A1                     ;155C: 81 A1          '..'
        BEQ     Z1569                    ;155E: 27 09          ''.'
        CMPA    #$2B                     ;1560: 81 2B          '.+'
        BEQ     Z1569                    ;1562: 27 05          ''.'
        BRA     Z156E                    ;1564: 20 08          ' .'
Z1566   COM     M00AA                    ;1566: 73 00 AA       's..'
;Z1569  JSR     Z00BF                    ;1569: BD 00 BF       '...'
Z1569   DB      $BD,$00,$BF
        BCS     Z15BD                    ;156C: 25 4F          '%O'
Z156E   TST     M00AA                    ;156E: 7D 00 AA       '}..'
        BEQ     Z157D                    ;1571: 27 0A          ''.'
        NEG     M00A9                    ;1573: 70 00 A9       'p..'
        BRA     Z157D                    ;1576: 20 05          ' .'
Z1578   COM     M00A8                    ;1578: 73 00 A8       's..'
        BNE     Z1542                    ;157B: 26 C5          '&.'
Z157D   LDAA    M00A9                    ;157D: 96 A9          '..'
        SUBA    M00A7                    ;157F: 90 A7          '..'
        STAA    M00A9                    ;1581: 97 A9          '..'
        BEQ     Z1599                    ;1583: 27 14          ''.'
        BPL     Z1591                    ;1585: 2A 0A          '*.'
Z1587   JSR     Z13B0                    ;1587: BD 13 B0       '...'
        INC     M00A9                    ;158A: 7C 00 A9       '|..'
        BNE     Z1587                    ;158D: 26 F8          '&.'
        BRA     Z1599                    ;158F: 20 08          ' .'
Z1591   JSR     Z1397                    ;1591: BD 13 97       '...'
        DEC     M00A9                    ;1594: 7A 00 A9       'z..'
        BNE     Z1591                    ;1597: 26 F8          '&.'
Z1599   LDAA    M00B4                    ;1599: 96 B4          '..'
        BPL     Z1525                    ;159B: 2A 88          '*.'
        JMP     Z173B                    ;159D: 7E 17 3B       '~.;'
Z15A0   LDAB    M00A7                    ;15A0: D6 A7          '..'
        SUBB    M00A8                    ;15A2: D0 A8          '..'
        STAB    M00A7                    ;15A4: D7 A7          '..'
        PSHA                             ;15A6: 36             '6'
        JSR     Z1397                    ;15A7: BD 13 97       '...'
        PULB                             ;15AA: 33             '3'
        SUBB    #$30                     ;15AB: C0 30          '.0'
        BSR     Z15B1                    ;15AD: 8D 02          '..'
        BRA     Z1542                    ;15AF: 20 91          ' .'
Z15B1   JSR     Z144E                    ;15B1: BD 14 4E       '..N'
        JSR     Z1492                    ;15B4: BD 14 92       '...'
        LDX     #M00A3                   ;15B7: CE 00 A3       '...'
        JMP     Z11C4                    ;15BA: 7E 11 C4       '~..'
Z15BD   LDAB    M00A9                    ;15BD: D6 A9          '..'
        ASLB                             ;15BF: 58             'X'
        ASLB                             ;15C0: 58             'X'
        ADDB    M00A9                    ;15C1: DB A9          '..'
        ASLB                             ;15C3: 58             'X'
        SUBA    #$30                     ;15C4: 80 30          '.0'
        ABA                              ;15C6: 1B             '.'
        STAA    M00A9                    ;15C7: 97 A9          '..'
Z15C9   BRA     Z1569                    ;15C9: 20 9E          ' .'
M15CB   CMPA    M0043                    ;15CB: 91 43          '.C'
        CLRA                             ;15CD: 4F             'O'
        EORB    $9474                    ;15CE: F8 94 74       '..t'
        BLS     Z15C9+1                  ;15D1: 23 F7          '#.'
M15D3   ANDA    M0074                    ;15D3: 94 74          '.t'
        BCC     Z15D7                    ;15D5: 24 00          '$.'
Z15D7   LDX     #$0292                   ;15D7: CE 02 92       '...'
        BSR     Z15EC                    ;15DA: 8D 10          '..'
        LDAA    M008A                    ;15DC: 96 8A          '..'
        LDAB    M008B                    ;15DE: D6 8B          '..'
Z15E0   STAA    DSCTMP                   ;15E0: 97 B0          '..'
        STAB    DSCTMP+1                 ;15E2: D7 B1          '..'
        LDAB    #$90                     ;15E4: C6 90          '..'
        SEC                              ;15E6: 0D             '.'
        JSR     Z149D                    ;15E7: BD 14 9D       '...'
        BSR     Z15EF                    ;15EA: 8D 03          '..'
Z15EC   JMP     STROUT                   ;15EC: 7E 08 79       '~.y'
Z15EF   LDX     #M0100                   ;15EF: CE 01 00       '...'
Z15F2   LDAA    #$20                     ;15F2: 86 20          '. '
        LDAB    M00B3                    ;15F4: D6 B3          '..'
        BPL     Z15FA                    ;15F6: 2A 02          '*.'
        LDAA    #$2D                     ;15F8: 86 2D          '.-'
Z15FA   STAA    ,X                       ;15FA: A7 00          '..'
        STAA    M00B3                    ;15FC: 97 B3          '..'
        STX     STRNG2                   ;15FE: DF BD          '..'
        INX                              ;1600: 08             '.'
        LDAA    #$30                     ;1601: 86 30          '.0'
        LDAB    tmpstrlen                ;1603: D6 AF          '..'
        BNE     Z160A                    ;1605: 26 03          '&.'
        JMP     Z16DE                    ;1607: 7E 16 DE       '~..'
Z160A   CLRA                             ;160A: 4F             'O'
        CMPB    #$80                     ;160B: C1 80          '..'
        BHI     Z1617                    ;160D: 22 08          '".'
        LDX     #M15D3                   ;160F: CE 15 D3       '...'
        JSR     Z1308                    ;1612: BD 13 08       '...'
        LDAA    #$FA                     ;1615: 86 FA          '..'
Z1617   STAA    M00A7                    ;1617: 97 A7          '..'
Z1619   LDX     #$15CF                   ;1619: CE 15 CF       '...'
        JSR     Z14B8                    ;161C: BD 14 B8       '...'
        BGT     Z1631                    ;161F: 2E 10          '..'
Z1621   LDX     #M15CB                   ;1621: CE 15 CB       '...'
        JSR     Z14B8                    ;1624: BD 14 B8       '...'
        BGT     Z1639                    ;1627: 2E 10          '..'
        JSR     Z1397                    ;1629: BD 13 97       '...'
        DEC     M00A7                    ;162C: 7A 00 A7       'z..'
        BRA     Z1621                    ;162F: 20 F0          ' .'
Z1631   JSR     Z13B0                    ;1631: BD 13 B0       '...'
        INC     M00A7                    ;1634: 7C 00 A7       '|..'
        BRA     Z1619                    ;1637: 20 E0          ' .'
Z1639   JSR     Z11B4                    ;1639: BD 11 B4       '...'
        JSR     Z14DA                    ;163C: BD 14 DA       '...'
        LDAB    #$01                     ;163F: C6 01          '..'
        LDAA    M00A7                    ;1641: 96 A7          '..'
        ADDA    #$07                     ;1643: 8B 07          '..'
        BMI     Z164F                    ;1645: 2B 08          '+.'
        CMPA    #$08                     ;1647: 81 08          '..'
        BCC     Z164F                    ;1649: 24 04          '$.'
        DECA                             ;164B: 4A             'J'
        TAB                              ;164C: 16             '.'
        LDAA    #$02                     ;164D: 86 02          '..'
Z164F   DECA                             ;164F: 4A             'J'
        DECA                             ;1650: 4A             'J'
        STAA    M00A9                    ;1651: 97 A9          '..'
        STAB    M00A7                    ;1653: D7 A7          '..'
        BGT     Z1668                    ;1655: 2E 11          '..'
        LDX     STRNG2                   ;1657: DE BD          '..'
        LDAA    #$2E                     ;1659: 86 2E          '..'
        INX                              ;165B: 08             '.'
        STAA    ,X                       ;165C: A7 00          '..'
        TSTB                             ;165E: 5D             ']'
        BEQ     Z1666                    ;165F: 27 05          ''.'
        LDAA    #$30                     ;1661: 86 30          '.0'
        INX                              ;1663: 08             '.'
        STAA    ,X                       ;1664: A7 00          '..'
Z1666   STX     STRNG2                   ;1666: DF BD          '..'
Z1668   LDX     #M16EA                   ;1668: CE 16 EA       '...'
        LDAB    #$80                     ;166B: C6 80          '..'
Z166D   LDAA    M00B2                    ;166D: 96 B2          '..'
        ADDA    $02,X                    ;166F: AB 02          '..'
        STAA    M00B2                    ;1671: 97 B2          '..'
        LDAA    DSCTMP+1                 ;1673: 96 B1          '..'
        ADCA    $01,X                    ;1675: A9 01          '..'
        STAA    DSCTMP+1                 ;1677: 97 B1          '..'
        LDAA    DSCTMP                   ;1679: 96 B0          '..'
        ADCA    ,X                       ;167B: A9 00          '..'
        STAA    DSCTMP                   ;167D: 97 B0          '..'
        INCB                             ;167F: 5C             '\'
        RORB                             ;1680: 56             'V'
        ROLB                             ;1681: 59             'Y'
        BVC     Z166D                    ;1682: 28 E9          '(.'
        BCC     Z1689                    ;1684: 24 03          '$.'
        SUBB    #$0B                     ;1686: C0 0B          '..'
        NEGB                             ;1688: 50             'P'
Z1689   ADDB    #$2F                     ;1689: CB 2F          './'
        INX                              ;168B: 08             '.'
        INX                              ;168C: 08             '.'
        INX                              ;168D: 08             '.'
        STX     M009C                    ;168E: DF 9C          '..'
        LDX     STRNG2                   ;1690: DE BD          '..'
        INX                              ;1692: 08             '.'
        TBA                              ;1693: 17             '.'
        ANDA    #$7F                     ;1694: 84 7F          '..'
        STAA    ,X                       ;1696: A7 00          '..'
        DEC     M00A7                    ;1698: 7A 00 A7       'z..'
        BNE     Z16A2                    ;169B: 26 05          '&.'
        LDAA    #$2E                     ;169D: 86 2E          '..'
        INX                              ;169F: 08             '.'
        STAA    ,X                       ;16A0: A7 00          '..'
Z16A2   STX     STRNG2                   ;16A2: DF BD          '..'
        LDX     M009C                    ;16A4: DE 9C          '..'
        COMB                             ;16A6: 53             'S'
        ANDB    #$80                     ;16A7: C4 80          '..'
        CPX     #M16FC                   ;16A9: 8C 16 FC       '...'
        BNE     Z166D                    ;16AC: 26 BF          '&.'
        LDX     STRNG2                   ;16AE: DE BD          '..'
Z16B0   LDAA    ,X                       ;16B0: A6 00          '..'
        DEX                              ;16B2: 09             '.'
        CMPA    #$30                     ;16B3: 81 30          '.0'
        BEQ     Z16B0                    ;16B5: 27 F9          ''.'
        CMPA    #$2E                     ;16B7: 81 2E          '..'
        BEQ     Z16BC                    ;16B9: 27 01          ''.'
        INX                              ;16BB: 08             '.'
Z16BC   LDAA    #$2B                     ;16BC: 86 2B          '.+'
        LDAB    M00A9                    ;16BE: D6 A9          '..'
        BEQ     Z16E0                    ;16C0: 27 1E          ''.'
        BPL     Z16C7                    ;16C2: 2A 03          '*.'
        LDAA    #$2D                     ;16C4: 86 2D          '.-'
        NEGB                             ;16C6: 50             'P'
Z16C7   STAA    $02,X                    ;16C7: A7 02          '..'
        LDAA    #$45                     ;16C9: 86 45          '.E'
        STAA    $01,X                    ;16CB: A7 01          '..'
        LDAA    #$2F                     ;16CD: 86 2F          './'
Z16CF   INCA                             ;16CF: 4C             'L'
        SUBB    #$0A                     ;16D0: C0 0A          '..'
        BCC     Z16CF                    ;16D2: 24 FB          '$.'
        ADDB    #$3A                     ;16D4: CB 3A          '.:'
        STAA    $03,X                    ;16D6: A7 03          '..'
        STAB    $04,X                    ;16D8: E7 04          '..'
        CLR     $05,X                    ;16DA: 6F 05          'o.'
        BRA     Z16E2                    ;16DC: 20 04          ' .'
Z16DE   STAA    ,X                       ;16DE: A7 00          '..'
Z16E0   CLR     $01,X                    ;16E0: 6F 01          'o.'
Z16E2   LDX     #M0100                   ;16E2: CE 01 00       '...'
Z16E5   RTS                              ;16E5: 39             '9'
M16E6   SUBA    #$00                     ;16E6: 80 00          '..'
        DB      $00                      ;16E8: 00             '.'
        DB      $00                      ;16E9: 00             '.'
M16EA   LDX     $7960                    ;16EA: FE 79 60       '.y`'
        DB      $00                      ;16ED: 00             '.'
        BEQ     $1700                    ;16EE: 27 10          ''.'
        STX     $FC18                    ;16F0: FF FC 18       '...'
        DB      $00                      ;16F3: 00             '.'
        DB      $00                      ;16F4: 00             '.'
        LSR     $FF,X                    ;16F5: 64 FF          'd.'
Z16F7   STX     $F600                    ;16F7: FF F6 00       '...'
        DB      $00                      ;16FA: 00             '.'
        NOP                              ;16FB: 01             '.'
M16FC   JSR     Z1476                    ;16FC: BD 14 76       '..v'
        LDX     #M16E6                   ;16FF: CE 16 E6       '...'
        JSR     Z1438                    ;1702: BD 14 38       '..8'
        BEQ     Z1768                    ;1705: 27 61          ''a'
        TSTA                             ;1707: 4D             'M'
        BNE     Z170D                    ;1708: 26 03          '&.'
        JMP     Z1230                    ;170A: 7E 12 30       '~.0'
Z170D   LDX     #M00AB                   ;170D: CE 00 AB       '...'
        JSR     Z1454                    ;1710: BD 14 54       '..T'
        CLRB                             ;1713: 5F             '_'
        LDAA    M00BA                    ;1714: 96 BA          '..'
        BPL     Z1728                    ;1716: 2A 10          '*.'
        JSR     Z1504                    ;1718: BD 15 04       '...'
        LDX     #M00AB                   ;171B: CE 00 AB       '...'
        LDAA    M00BA                    ;171E: 96 BA          '..'
        JSR     Z14B8                    ;1720: BD 14 B8       '...'
        BNE     Z1728                    ;1723: 26 03          '&.'
        COMA                             ;1725: 43             'C'
        LDAB    CHARAC                   ;1726: D6 58          '.X'
Z1728   JSR     Z146B                    ;1728: BD 14 6B       '..k'
        PSHB                             ;172B: 37             '7'
        JSR     Z12D2                    ;172C: BD 12 D2       '...'
        LDX     #M00AB                   ;172F: CE 00 AB       '...'
        JSR     Z1308                    ;1732: BD 13 08       '...'
        BSR     Z1768                    ;1735: 8D 31          '.1'
        PULA                             ;1737: 32             '2'
        RORA                             ;1738: 46             'F'
        BCC     Z16E5                    ;1739: 24 AA          '$.'
Z173B   LDAA    tmpstrlen                ;173B: 96 AF          '..'
        BEQ     Z1742                    ;173D: 27 03          ''.'
        COM     M00B3                    ;173F: 73 00 B3       's..'
Z1742   RTS                              ;1742: 39             '9'
M1743   CMPA    #$38                     ;1743: 81 38          '.8'
        ORAA    $3B,X                    ;1745: AA 3B          '.;'
M1747   TPA                              ;1747: 07             '.'
        LSR     $942E                    ;1748: 74 94 2E       't..'
        NEGA                             ;174B: 40             '@'
        ASR     $2E4F                    ;174C: 77 2E 4F       'w.O'
        NEG     $7A88                    ;174F: 70 7A 88       'pz.'
        DB      $02                      ;1752: 02             '.'
        JMP     $7C,X                    ;1753: 6E 7C          'n|'
        BPL     Z16F7                    ;1755: 2A A0          '*.'
        LDAB    $7E,X                    ;1757: E6 7E          '.~'
        ORAA    $AA,X                    ;1759: AA AA          '..'
        NEGB                             ;175B: 50             'P'
        CLR     $7FFF                    ;175C: 7F 7F FF       '...'
        STX     $8180                    ;175F: FF 81 80       '...'
        DB      $00                      ;1762: 00             '.'
        DB      $00                      ;1763: 00             '.'
        CMPA    #$00                     ;1764: 81 00          '..'
        DB      $00                      ;1766: 00             '.'
        DB      $00                      ;1767: 00             '.'
Z1768   JSR     Z144E                    ;1768: BD 14 4E       '..N'
        LDX     #M1743                   ;176B: CE 17 43       '..C'
        BSR     Z17AD                    ;176E: 8D 3D          '.='
        LDAA    tmpstrlen                ;1770: 96 AF          '..'
        CMPA    #$88                     ;1772: 81 88          '..'
        BCS     Z1779                    ;1774: 25 03          '%.'
Z1776   JMP     Z1388                    ;1776: 7E 13 88       '~..'
Z1779   JSR     Z1504                    ;1779: BD 15 04       '...'
        LDAA    CHARAC                   ;177C: 96 58          '.X'
        ADDA    #$81                     ;177E: 8B 81          '..'
        BEQ     Z1776                    ;1780: 27 F4          ''.'
        PSHA                             ;1782: 36             '6'
        LDX     #M12B1                   ;1783: CE 12 B1       '...'
        JSR     Z11C4                    ;1786: BD 11 C4       '...'
        JSR     Z1305                    ;1789: BD 13 05       '...'
        LDX     #M00A3                   ;178C: CE 00 A3       '...'
        JSR     Z11B9                    ;178F: BD 11 B9       '...'
        BSR     Z173B                    ;1792: 8D A7          '..'
        LDX     #M1747                   ;1794: CE 17 47       '..G'
        BSR     Z17B0                    ;1797: 8D 17          '..'
        CLR     STRNG1                   ;1799: 7F 00 BB       '...'
        PULA                             ;179C: 32             '2'
        JSR     Z1371                    ;179D: BD 13 71       '..q'
        RTS                              ;17A0: 39             '9'
Z17A1   STX     STRNG2                   ;17A1: DF BD          '..'
        JSR     Z144E                    ;17A3: BD 14 4E       '..N'
        BSR     Z17AD                    ;17A6: 8D 05          '..'
        BSR     Z17B2                    ;17A8: 8D 08          '..'
        LDX     #M00A3                   ;17AA: CE 00 A3       '...'
Z17AD   JMP     Z1308                    ;17AD: 7E 13 08       '~..'
Z17B0   STX     STRNG2                   ;17B0: DF BD          '..'
Z17B2   JSR     Z1449                    ;17B2: BD 14 49       '..I'
        LDX     STRNG2                   ;17B5: DE BD          '..'
        LDAB    ,X                       ;17B7: E6 00          '..'
        STAB    M00B4                    ;17B9: D7 B4          '..'
        INX                              ;17BB: 08             '.'
        STX     STRNG2                   ;17BC: DF BD          '..'
Z17BE   BSR     Z17AD                    ;17BE: 8D ED          '..'
        LDX     STRNG2                   ;17C0: DE BD          '..'
        INX                              ;17C2: 08             '.'
        INX                              ;17C3: 08             '.'
        INX                              ;17C4: 08             '.'
        INX                              ;17C5: 08             '.'
        STX     STRNG2                   ;17C6: DF BD          '..'
        JSR     Z11C4                    ;17C8: BD 11 C4       '...'
        LDX     #M00A7                   ;17CB: CE 00 A7       '...'
        DEC     M00B4                    ;17CE: 7A 00 B4       'z..'
        BNE     Z17BE                    ;17D1: 26 EB          '&.'
Z17D3   RTS                              ;17D3: 39             '9'
M17D4   EORA    M0035                    ;17D4: 98 35          '.5'
        LSRA                             ;17D6: 44             'D'
        DEC     $6828                    ;17D7: 7A 68 28       'zh('
        CMPA    $46BD                    ;17DA: B1 46 BD       '.F.'
        DB      $14                      ;17DD: 14             '.'
        DB      $83                      ;17DE: 83             '.'
        TBA                              ;17DF: 17             '.'
        BMI     Z17F6                    ;17E0: 2B 14          '+.'
        LDX     #M010D                   ;17E2: CE 01 0D       '...'
        JSR     Z1438                    ;17E5: BD 14 38       '..8'
        TSTA                             ;17E8: 4D             'M'
        BEQ     Z17D3                    ;17E9: 27 E8          ''.'
        LDX     #M17D4                   ;17EB: CE 17 D4       '...'
        BSR     Z17AD                    ;17EE: 8D BD          '..'
        LDX     #$17D8                   ;17F0: CE 17 D8       '...'
        JSR     Z11C4                    ;17F3: BD 11 C4       '...'
Z17F6   LDAB    M00B2                    ;17F6: D6 B2          '..'
        LDAA    DSCTMP                   ;17F8: 96 B0          '..'
        STAA    M00B2                    ;17FA: 97 B2          '..'
        STAB    DSCTMP                   ;17FC: D7 B0          '..'
        CLR     M00B3                    ;17FE: 7F 00 B3       '...'
        LDAA    tmpstrlen                ;1801: 96 AF          '..'
        STAA    M00BC                    ;1803: 97 BC          '..'
        LDAA    #$80                     ;1805: 86 80          '..'
        STAA    tmpstrlen                ;1807: 97 AF          '..'
        JSR     Z1215                    ;1809: BD 12 15       '...'
        LDX     #M010D                   ;180C: CE 01 0D       '...'
Z180F   JMP     Z1454                    ;180F: 7E 14 54       '~.T'
M1812   LDX     #M1881                   ;1812: CE 18 81       '...'
        JSR     Z11C4                    ;1815: BD 11 C4       '...'
Z1818   JSR     Z1476                    ;1818: BD 14 76       '..v'
        LDX     #$1885                   ;181B: CE 18 85       '...'
        LDAB    M00BA                    ;181E: D6 BA          '..'
        JSR     Z13B7                    ;1820: BD 13 B7       '...'
        JSR     Z1476                    ;1823: BD 14 76       '..v'
        JSR     Z1504                    ;1826: BD 15 04       '...'
        CLR     STRNG1                   ;1829: 7F 00 BB       '...'
        LDAA    M00B6                    ;182C: 96 B6          '..'
        LDAB    tmpstrlen                ;182E: D6 AF          '..'
        JSR     Z11BC                    ;1830: BD 11 BC       '...'
        LDX     #$1889                   ;1833: CE 18 89       '...'
        JSR     Z11B9                    ;1836: BD 11 B9       '...'
        LDAA    M00B3                    ;1839: 96 B3          '..'
        PSHA                             ;183B: 36             '6'
        BPL     Z1848                    ;183C: 2A 0A          '*.'
        JSR     Z11B4                    ;183E: BD 11 B4       '...'
        LDAA    M00B3                    ;1841: 96 B3          '..'
        BMI     Z184B                    ;1843: 2B 06          '+.'
        COM     M0060                    ;1845: 73 00 60       's.`'
Z1848   JSR     Z173B                    ;1848: BD 17 3B       '..;'
Z184B   LDX     #$1889                   ;184B: CE 18 89       '...'
        JSR     Z11C4                    ;184E: BD 11 C4       '...'
        PULA                             ;1851: 32             '2'
        TSTA                             ;1852: 4D             'M'
        BPL     Z1858                    ;1853: 2A 03          '*.'
        JSR     Z173B                    ;1855: BD 17 3B       '..;'
Z1858   LDX     #M188D                   ;1858: CE 18 8D       '...'
Z185B   JMP     Z17A1                    ;185B: 7E 17 A1       '~..'
        JSR     Z144E                    ;185E: BD 14 4E       '..N'
        CLR     M0060                    ;1861: 7F 00 60       '..`'
        BSR     Z1818                    ;1864: 8D B2          '..'
        LDX     #M00AB                   ;1866: CE 00 AB       '...'
        BSR     Z180F                    ;1869: 8D A4          '..'
        LDX     #M00A3                   ;186B: CE 00 A3       '...'
        JSR     Z1438                    ;186E: BD 14 38       '..8'
        CLR     M00B3                    ;1871: 7F 00 B3       '...'
        LDAA    M0060                    ;1874: 96 60          '.`'
        BSR     Z187E                    ;1876: 8D 06          '..'
        LDX     #M00AB                   ;1878: CE 00 AB       '...'
Z187B   JMP     Z13BB+1                  ;187B: 7E 13 BC       '~..'
Z187E   PSHA                             ;187E: 36             '6'
        BRA     Z1848                    ;187F: 20 C7          ' .'
M1881   CMPA    #$49                     ;1881: 81 49          '.I'
        SEI                              ;1883: 0F             '.'
        ADDB    M0083                    ;1884: DB 83          '..'
        ROLA                             ;1886: 49             'I'
        SEI                              ;1887: 0F             '.'
        ADDB    M007F                    ;1888: DB 7F          '..'
        DB      $00                      ;188A: 00             '.'
        DB      $00                      ;188B: 00             '.'
        DB      $00                      ;188C: 00             '.'
M188D   DB      $04                      ;188D: 04             '.'
        LDAA    #$1E                     ;188E: 86 1E          '..'
        STAB    M00BA                    ;1890: D7 BA          '..'
        DB      $87                      ;1892: 87             '.'
        ADCA    M0026                    ;1893: 99 26          '.&'
        LSR     $87,X                    ;1895: 64 87          'd.'
        BLS     Z18CD                    ;1897: 23 34          '#4'
        ASLB                             ;1899: 58             'X'
        LDAA    #$A5                     ;189A: 86 A5          '..'
        TSTB                             ;189C: 5D             ']'
        SUBB    $83,X                    ;189D: E0 83          '..'
        ROLA                             ;189F: 49             'I'
        SEI                              ;18A0: 0F             '.'
        ORAB    M0096                    ;18A1: DA 96          '..'
        DB      $B3                      ;18A3: B3             '.'
        PSHA                             ;18A4: 36             '6'
        BPL     Z18A9                    ;18A5: 2A 02          '*.'
        BSR     Z18C9                    ;18A7: 8D 20          '. '
Z18A9   LDAA    tmpstrlen                ;18A9: 96 AF          '..'
        PSHA                             ;18AB: 36             '6'
        CMPA    #$81                     ;18AC: 81 81          '..'
        BCS     Z18B5                    ;18AE: 25 05          '%.'
        LDX     #M12B1                   ;18B0: CE 12 B1       '...'
        BSR     Z187B                    ;18B3: 8D C6          '..'
Z18B5   LDX     #Z18CD                   ;18B5: CE 18 CD       '...'
        BSR     Z185B                    ;18B8: 8D A1          '..'
        PULA                             ;18BA: 32             '2'
        CMPA    #$81                     ;18BB: 81 81          '..'
        BCS     Z18C5                    ;18BD: 25 06          '%.'
        LDX     #M1881                   ;18BF: CE 18 81       '...'
        JSR     Z11B9                    ;18C2: BD 11 B9       '...'
Z18C5   PULA                             ;18C5: 32             '2'
        TSTA                             ;18C6: 4D             'M'
        BPL     Z18CC                    ;18C7: 2A 03          '*.'
Z18C9   JMP     Z173B                    ;18C9: 7E 17 3B       '~.;'
Z18CC   RTS                              ;18CC: 39             '9'
Z18CD   INX                              ;18CD: 08             '.'
        ASL     $3BD7                    ;18CE: 78 3B D7       'x;.'
        DECA                             ;18D1: 4A             'J'
        DB      $7B                      ;18D2: 7B             '{'
        ANDA    #$6E                     ;18D3: 84 6E          '.n'
        DB      $02                      ;18D5: 02             '.'
        INC     $2FC1                    ;18D6: 7C 2F C1       '|/.'
        LDX     $7D9A                    ;18D9: FE 7D 9A       '.}.'
        INS                              ;18DC: 31             '1'
        LSR     $7D5A                    ;18DD: 74 7D 5A       't}Z'
        DB      $3D                      ;18E0: 3D             '='
        ANDA    #$7E                     ;18E1: 84 7E          '.~'
        CMPA    M007F                    ;18E3: 91 7F          '..'
        EORB    #$7E                     ;18E5: C8 7E          '.~'
        INCA                             ;18E7: 4C             'L'
        ADDA    $E47F                    ;18E8: BB E4 7F       '...'
        ORAA    $AA,X                    ;18EB: AA AA          '..'
        INC     $81,X                    ;18ED: 6C 81          'l.'
        DB      $00                      ;18EF: 00             '.'
        DB      $00                      ;18F0: 00             '.'
        DB      $00                      ;18F1: 00             '.'
M18F2   DB      $00                      ;18F2: 00             '.'
Z18F3   LDX     #AUTTXT-1                ;18F3: CE 1A 1F       '...'
        JSR     STROUT                   ;18F6: BD 08 79       '..y'

INIT    LDX     #$FFFF                   ;18F9: CE FF FF       '...'
        STX     M008A                    ;18FC: DF 8A          '..'
        LDS     #$1B1B                   ;18FE: 8E 1B 1B       '...'
        STS     M0082                    ;1901: 9F 82          '..'
        CLR     M0111                    ;1903: 7F 01 11       '...'
        JSR     Z0834                    ;1906: BD 08 34       '..4'
        LDX     #M0065                   ;1909: CE 00 65       '..e'
        STX     TEMPPT                   ;190C: DF 61          '.a'
        LDX     #MEMORY-1                ;190E: CE 1A AA       '...'
        JSR     STROUT                   ;1911: BD 08 79       '..y'
        JSR     Z08F9                    ;1914: BD 08 F9       '...'
        STX     $00C8                    ;1917: DF C8          '..'
;       JSR     Z00BF                    ;1919: BD 00 BF       '...'
        DB      $BD,$00,$BF
        CMPA    #$41                     ;191C: 81 41          '.A'
        BEQ     Z18F3                    ;191E: 27 D3          ''.'
        TSTA                             ;1920: 4D             'M'
        BNE     Z1938                    ;1921: 26 15          '&.'
        LDX     #LASTWR                  ;1923: CE 1A B7       '...'
Z1926   INX                              ;1926: 08             '.'
        LDAA    #$37                     ;1927: 86 37          '.7'
        STAA    ,X                       ;1929: A7 00          '..'
        CMPA    ,X                       ;192B: A1 00          '..'
        BNE     Z1946                    ;192D: 26 17          '&.'
        DECA                             ;192F: 4A             'J'
        STAA    ,X                       ;1930: A7 00          '..'
        CMPA    ,X                       ;1932: A1 00          '..'
        BEQ     Z1926                    ;1934: 27 F0          ''.'
        BRA     Z1946                    ;1936: 20 0E          ' .'
Z1938   JSR     CHRGOT                   ;1938: BD 00 C7       '...'
        JSR     Z0767                    ;193B: BD 07 67       '..g'
        TSTA                             ;193E: 4D             'M'
        BEQ     Z1944                    ;193F: 27 03          ''.'
        JMP     Z0B49                    ;1941: 7E 0B 49       '~.I'
Z1944   LDX     M008E                    ;1944: DE 8E          '..'
Z1946   DEX                              ;1946: 09             '.'
        STX     M0088                    ;1947: DF 88          '..'
        STX     M0084                    ;1949: DF 84          '..'
Z194B   LDX     #TTYWID-1                ;194B: CE 1A 43       '..C'
        JSR     STROUT                   ;194E: BD 08 79       '..y'
        JSR     Z08F9                    ;1951: BD 08 F9       '...'
        STX     $00C8                    ;1954: DF C8          '..'
;       JSR     Z00BF                    ;1956: BD 00 BF       '...'
        DB      $BD,$00,$BF
        TAB                              ;1959: 16             '.'
        BEQ     Z1978                    ;195A: 27 1C          ''.'
        JSR     Z0767                    ;195C: BD 07 67       '..g'
        LDAA    M008E                    ;195F: 96 8E          '..'
        BNE     Z194B                    ;1961: 26 E8          '&.'
        LDAA    M008F                    ;1963: 96 8F          '..'
        CMPA    #$10                     ;1965: 81 10          '..'
        BCS     Z194B                    ;1967: 25 E2          '%.'
        STAA    M000C                    ;1969: 97 0C          '..'
Z196B   SUBA    #$0E                     ;196B: 80 0E          '..'
        BCC     Z196B                    ;196D: 24 FC          '$.'
        NEGA                             ;196F: 40             '@'
        SUBA    #$0E                     ;1970: 80 0E          '..'
        ADDA    M000C                    ;1972: 9B 0C          '..'
        STAA    M000D                    ;1974: 97 0D          '..'
        BRA     Z1980                    ;1976: 20 08          ' .'
Z1978   LDAA    #$48                     ;1978: 86 48          '.H'
        STAA    M000C                    ;197A: 97 0C          '..'
        LDAA    #$38                     ;197C: 86 38          '.8'
        STAA    M000D                    ;197E: 97 0D          '..'
Z1980   LDAB    #$CE                     ;1980: C6 CE          '..'
        LDAA    #$FF                     ;1982: 86 FF          '..'
        ADDB    M0089                    ;1984: DB 89          '..'
        ADCA    M0088                    ;1986: 99 88          '..'
        BCS     Z198D                    ;1988: 25 03          '%.'
Z198A   JMP     Z0311                    ;198A: 7E 03 11       '~..'
Z198D   STAA    M0082                    ;198D: 97 82          '..'
        STAB    M0083                    ;198F: D7 83          '..'
Z1991   LDX     #FNS-1                   ;1991: CE 1A 0A       '...'
        JSR     STROUT                   ;1994: BD 08 79       '..y'
        JSR     Z08F9                    ;1997: BD 08 F9       '...'
        STX     $00C8                    ;199A: DF C8          '..'
;       JSR     Z00BF                    ;199C: BD 00 BF       '...'
        DB      $BD,$00,$BF
        LDX     #M18F2                   ;199F: CE 18 F2       '...'
        CMPA    #$59                     ;19A2: 81 59          '.Y'
        BEQ     Z19CA                    ;19A4: 27 24          ''$'
        CMPA    #$41                     ;19A6: 81 41          '.A'
        BEQ     Z19AE                    ;19A8: 27 04          ''.'
        CMPA    #$4E                     ;19AA: 81 4E          '.N'
        BNE     Z1991                    ;19AC: 26 E3          '&.'
Z19AE   LDX     #Z0D4B+1                 ;19AE: CE 0D 4C       '..L'
        STX     M0133                    ;19B1: FF 01 33       '..3'
        LDX     #$18A2                   ;19B4: CE 18 A2       '...'
        CMPA    #$41                     ;19B7: 81 41          '.A'
        BEQ     Z19CA                    ;19B9: 27 0F          ''.'
        LDX     #Z0D4B+1                 ;19BB: CE 0D 4C       '..L'
        STX     M012D                    ;19BE: FF 01 2D       '..-'
        STX     M0131                    ;19C1: FF 01 31       '..1'
        STX     M012F                    ;19C4: FF 01 2F       '../'
        LDX     #M1812                   ;19C7: CE 18 12       '...'
Z19CA   CLRA                             ;19CA: 4F             'O'
        STAA    ,X                       ;19CB: A7 00          '..'
        INX                              ;19CD: 08             '.'
        STX     M007A                    ;19CE: DF 7A          '.z'
        LDX     M0082                    ;19D0: DE 82          '..'
        BMI     Z19D9                    ;19D2: 2B 05          '+.'
        CPX     #$1B1B                   ;19D4: 8C 1B 1B       '...'
        BMI     Z198A                    ;19D7: 2B B1          '+.'
Z19D9   STX     M0082                    ;19D9: DF 82          '..'
        LDAA    M007A                    ;19DB: 96 7A          '.z'
        LDAB    M007B                    ;19DD: D6 7B          '.{'
        JSR     Z02F0                    ;19DF: BD 02 F0       '...'
        JSR     Z0834                    ;19E2: BD 08 34       '..4'
        LDAB    M0083                    ;19E5: D6 83          '..'
        SUBB    M007B                    ;19E7: D0 7B          '.{'
        LDAA    M0082                    ;19E9: 96 82          '..'
        SBCA    M007A                    ;19EB: 92 7A          '.z'
        JSR     Z15E0                    ;19ED: BD 15 E0       '...'
        LDX     #WORDS-1                 ;19F0: CE 1A 52       '..R'
        JSR     STROUT                   ;19F3: BD 08 79       '..y'
        LDX     #STROUT                  ;19F6: CE 08 79       '..y'
        STX     x0112+1                  ;19F9: FF 01 13       '...'
        JSR     Z04E4                    ;19FC: BD 04 E4       '...'
        LDAA    #$BD                     ;19FF: 86 BD          '..'    JSR instruction
        STAA    RDYJSR                   ;1A01: 97 04          '..'
        LDX     #READY                   ;1A03: CE 05 00       '...'
        STX     RDYJSR+1                 ;1A06: DF 05          '..'
        JMP     Z033C                    ;1A08: 7E 03 3C       '~.<'

; Strings used by INIT routine
; XXX Both high-byte and \000 terminated?
FNS     ASC    "WANT SIN-COS-TAN-AT"     ;1A0B: 57 41 4E 54 20 53 49 4E 2D 43 4F 53 2D 54 41 4E 2D 41 54 'WANT SIN-COS-TAN-AT'
        DB      'N'|$80,$00              ;1A1E: CE 00          '..'    'N'|$80, \000
AUTTXT  DB      $0D,$0A,$0C              ;1A20: 0D 0A 0C       '...'
        ASC     "WRITTEN BY RICHARD W."  ;1A23: 57 52 49 54 54 45 4E 20 42 59 20 52 49 43 48 41 52 44 20 57 2E 'WRITTEN BY RICHARD W.'
        ASC     " WEILAND"               ;1A38: 20 57 45 49 4C 41 4E 44 ' WEILAND'
        DB      '.'|$80,$0d,$0a,$00      ;1A40: AE 0D 0A 00    '....'  '.'|$80, \000
TTYWID  ASC     "TERMINAL WIDT"          ;1A44: 54 45 52 4D 49 4E 41 4C 20 57 49 44 54 'TERMINAL WIDT'
        DB      'H'|$80,$00              ;1A51: C8 00          '..'    'H'|$80, \000
WORDS   ASC     " BYTES FRE"             ;1A53: 20 42 59 54 45 53 20 46 52 45 ' BYTES FRE'
        DB      'E'|$80,$0D,$0A,$0D,$0A  ;1A5D: C5 0D 0A 0D 0A '.....'
        ASC     "MITS ALTAIR 680 BASIC"  ;1A62: 4D 49 54 53 20 41 4C 54 41 49 52 20 36 38 30 20 42 41 53 49 43 'MITS ALTAIR 680 BASIC'
        ASC     " VERSION 1.1 REV 3."    ;1A77: 20 56 45 52 53 49 4F 4E 20 31 2E 31 20 52 45 56 20 33 2E ' VERSION 1.1 REV 3.'
        DB      '2'|$80,$0D,$0A          ;1A8A: B2 0D 0A       '...'
        ASC     "COPYRIGHT 1976 BY MIT"  ;1A8D: 43 4F 50 59 52 49 47 48 54 20 31 39 37 36 20 42 59 20 4D 49 54 'COPYRIGHT 1976 BY MIT'
        ASC     "S INC"                  ;1AA2: 53 20 49 4E 43 'S INC'
        DB      '.'|$80,$0D,$0A,$00      ;1AA7: AE 0D 0A 00    '....'
MEMORY  ASC     "MEMORY SIZ"             ;1AAB: 4D 45 4D 4F 52 59 20 53 49 5A 'MEMORY SIZ'
        DB      'E'|$80,$00              ;1AB5: C5 00          '..'
LASTWR  DB      $00                      ;1AB7: 00             '.'
        ASC     " IS IT RETURN"          ;1AB8: 20 49 53 20 49 54 20 52 45 54 55 52 4E ' IS IT RETURN'
        DB      $0D                      ;1AC5: 0D             '.'
        ASC     " BEQ OUT"               ;1AC6: 20 42 45 51 20 4F 55 54 ' BEQ OUT'
        DB      $0D                      ;1ACE: 0D             '.'
        ASC     " BRA INTAPE GET NEXT "  ;1ACF: 20 42 52 41 20 49 4E 54 41 50 45 20 47 45 54 20 4E 45 58 54 20 ' BRA INTAPE GET NEXT '
        ASC     "CHARACTER"              ;1AE4: 43 48 41 52 41 43 54 45 52 'CHARACTER'
        DB      $0D                      ;1AED: 0D             '.'
        ASC     " END"                   ;1AEE: 20 45 4E 44    ' END'
        DB      $0D,$00                  ;1AF2: 0D 00          '..'

; Fill unused locations with $FF

        DS      $1F00-*,$FF

;       END     START
